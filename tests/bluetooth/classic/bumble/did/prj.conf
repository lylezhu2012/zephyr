## CMakeLists.txt
```
# SPDX-FileCopyrightText: Copyright 2026 NXP
#
# SPDX-License-Identifier: Apache-2.0

cmake_minimum_required(VERSION 3.20.0)
set(NO_QEMU_SERIAL_BT_SERVER 1)

find_package(Zephyr REQUIRED HINTS $ENV{ZEPHYR_BASE})
project(bluetooth)

target_sources(app PRIVATE
  src/test_br.c
  src/test_common.c
  src/test_main.c
)

# The disabled scenario is built without the DID module and has its own suites.
target_sources_ifdef(CONFIG_BT_DID app PRIVATE
  src/test_client.c
  src/test_server.c
)
target_sources_ifndef(CONFIG_BT_DID app PRIVATE
  src/test_disabled.c
)
```

## Kconfig
```
# SPDX-FileCopyrightText: Copyright 2026 NXP
#
# SPDX-License-Identifier: Apache-2.0

if BT_DID

# Values of the Device ID record of the DID module, checked by the client role on the peer.
# The DID module sets VendorIDSource to 0x0001 (Bluetooth SIG), so VendorID is a Bluetooth SIG
# Company Identifier: 0x0025 is NXP B.V.
configdefault BT_DEVICE_VENDOR_ID
	default 0x0025

configdefault BT_DEVICE_PRODUCT_ID
	default 0xa5c3

configdefault BT_DEVICE_VERSION
	default 0x0207

endif # BT_DID

source "Kconfig.zephyr"

module = TEST_CLASSIC_DID_SIM
module-str = test_classic_did_sim
source "subsys/logging/Kconfig.template.log_config"

module = TEST_BR
module-str = test_br
source "subsys/logging/Kconfig.template.log_config"
```

## prj.conf
```kconfig
# SPDX-FileCopyrightText: Copyright 2026 NXP
#
# SPDX-License-Identifier: Apache-2.0

CONFIG_BT=y
CONFIG_BT_CLASSIC=y
CONFIG_BT_TESTING=y
CONFIG_LOG=y
CONFIG_ZTEST=y

CONFIG_BT_DEVICE_NAME="test_did"

CONFIG_BT_CREATE_CONN_TIMEOUT=30
CONFIG_BT_PAGE_TIMEOUT=0xFFFF

# The record values are set in Kconfig, the disabled scenario turns the module off.
CONFIG_BT_DID=y

CONFIG_TEST_CLASSIC_DID_SIM_LOG_LEVEL_DBG=y
```

## src/test_br.h
```c
/*
 * SPDX-FileCopyrightText: Copyright 2026 NXP
 *
 * SPDX-License-Identifier: Apache-2.0
 */

#ifndef TEST_BR_H_
#define TEST_BR_H_

#include <stdbool.h>

#include <zephyr/kernel.h>
#include <zephyr/bluetooth/bluetooth.h>
#include <zephyr/bluetooth/conn.h>

/*
 * ACL lifecycle and test synchronization shared by the two simulated devices.
 *
 * Both devices run a suite with the same test names, ztest runs them in name order. Before each
 * test the initiator (device 0) creates the ACL connection and the acceptor waits for it. Each
 * test then calls test_br_sync() once this side is ready (e.g. servers registered): both sides
 * exchange the test name in an L2CAP ECHO request/response, the initiator only returns when the
 * acceptor is in the same test. After each test the ACL connection is released, so every test
 * starts from a fresh ACL link.
 *
 * Test names must start with a unique, zero-padded index (test_NNN_...), the first
 * TEST_BR_SYNC_LEN characters are exchanged and compared in name order.
 */

enum test_br_role {
	TEST_BR_INITIATOR,
	TEST_BR_ACCEPTOR,
};

#define TEST_BR_SYNC_LEN 40

/* Default wait for a protocol step of the peer. */
#define TEST_BR_STEP_TIMEOUT K_SECONDS(10)

extern bt_addr_t peer_addr;

/* Enable Bluetooth and set the role of this device; the initiator waits until the peer is found. */
void test_br_setup(enum test_br_role role, bt_security_t sec_level);
void test_br_teardown(void);

/* Security level the ACL link is raised to before each test (BT_SECURITY_L1 for none). */
void test_br_set_security(bt_security_t sec_level);

enum test_br_role test_br_role(void);
struct bt_conn *test_br_conn(void);
bool test_br_connected(void);

/* Wait until the peer reached the same test; call once per test when this side is ready. */
void test_br_sync(void);

/* Take @p sem; return -ENOTCONN as soon as the ACL link is lost, -EAGAIN on timeout. */
int test_br_wait(struct k_sem *sem, k_timeout_t timeout);

/* ACL operations inside a test body; failures are reported with zassert. */
void test_br_connect(void);
void test_br_disconnect(void);
void test_br_wait_connected(k_timeout_t timeout);
void test_br_wait_disconnected(k_timeout_t timeout);
void test_br_security(bt_security_t sec_level);

#endif /* TEST_BR_H_ */
```

## src/test_client.c
```c
/*
 * SPDX-FileCopyrightText: Copyright 2026 NXP
 *
 * SPDX-License-Identifier: Apache-2.0
 */

#include <zephyr/kernel.h>
#include <zephyr/bluetooth/bluetooth.h>
#include <zephyr/bluetooth/conn.h>
#include <zephyr/bluetooth/classic/sdp.h>
#include <zephyr/logging/log.h>
#include <zephyr/ztest.h>

#include "test_br.h"
#include "test_common.h"

LOG_MODULE_REGISTER(test_did_client, CONFIG_TEST_CLASSIC_DID_SIM_LOG_LEVEL);

/* Record of the DID module on the peer; both roles are built from the same image. */
static const struct test_did_expect expect_primary = {
	.vendor_id = CONFIG_BT_DEVICE_VENDOR_ID,
	.product_id = CONFIG_BT_DEVICE_PRODUCT_ID,
	.version = CONFIG_BT_DEVICE_VERSION,
	.source = TEST_DID_SOURCE_BT_SIG,
	.primary = true,
};

/* Record registered by the server role only (src/test_server.c). */
static const struct test_did_expect expect_secondary = {
	.vendor_id = TEST_DID_SECONDARY_VENDOR_ID,
	.product_id = TEST_DID_SECONDARY_PRODUCT_ID,
	.version = TEST_DID_SECONDARY_VERSION,
	.source = TEST_DID_SOURCE_USB_IF,
	.primary = false,
};

/*
 * Attribute ID lists. The SDP client reads them again for continuation requests, so they must
 * outlive a test that fails while a request is still in progress.
 */
static struct bt_sdp_attribute_id_range handle_did_ranges[] = {
	BT_SDP_ATTR_ID_RANGE(BT_SDP_ATTR_RECORD_HANDLE, BT_SDP_ATTR_RECORD_HANDLE),
	BT_SDP_ATTR_ID_RANGE(BT_SDP_ATTR_SPECIFICATION_ID, BT_SDP_ATTR_VENDOR_ID_SOURCE),
};

static struct bt_sdp_attribute_id_list handle_did_ids = {
	.count = ARRAY_SIZE(handle_did_ranges),
	.ranges = handle_did_ranges,
};

/* A single attribute ID and a range; SpecificationID and ProductID are left out. */
static struct bt_sdp_attribute_id_range subset_ranges[] = {
	BT_SDP_ATTR_ID_RANGE(BT_SDP_ATTR_VENDOR_ID, BT_SDP_ATTR_VENDOR_ID),
	BT_SDP_ATTR_ID_RANGE(BT_SDP_ATTR_VERSION, BT_SDP_ATTR_VENDOR_ID_SOURCE),
};

static struct bt_sdp_attribute_id_list subset_ids = {
	.count = ARRAY_SIZE(subset_ranges),
	.ranges = subset_ranges,
};

/* VendorIDSource and the reserved attribute IDs after it (DID v1.3, section 5.7). */
static struct bt_sdp_attribute_id_range source_reserved_ranges[] = {
	BT_SDP_ATTR_ID_RANGE(BT_SDP_ATTR_VENDOR_ID_SOURCE, TEST_DID_ATTR_RESERVED_LAST),
};

static struct bt_sdp_attribute_id_list source_reserved_ids = {
	.count = ARRAY_SIZE(source_reserved_ranges),
	.ranges = source_reserved_ranges,
};

/* The reserved attribute IDs only. */
static struct bt_sdp_attribute_id_range reserved_ranges[] = {
	BT_SDP_ATTR_ID_RANGE(TEST_DID_ATTR_RESERVED_FIRST, TEST_DID_ATTR_RESERVED_LAST),
};

static struct bt_sdp_attribute_id_list reserved_ids = {
	.count = ARRAY_SIZE(reserved_ranges),
	.ranges = reserved_ranges,
};

static struct test_did_discover disc_a;
static struct test_did_discover disc_b;
static struct test_did_discover disc_c;

/*
 * Check that @p recs hold the record of the DID module and the secondary record of the server,
 * in any order. The server has one primary and one non-primary record; DID v1.3, section 5.5:
 * "the PrimaryRecord attribute is set to TRUE for that record and FALSE for all other records".
 */
static void check_two_records(const struct test_did_record *recs, uint8_t count, uint32_t found)
{
	const struct test_did_record *primary = NULL;
	const struct test_did_record *secondary = NULL;

	zassert_true((found & TEST_DID_HAS_PRIMARY) != 0U, "PrimaryRecord is needed to match");
	zassert_equal(count, 2U, "Got %u records, expected 2", count);

	for (uint8_t i = 0U; i < count; i++) {
		if (recs[i].primary) {
			zassert_is_null(primary, "More than one record with PrimaryRecord TRUE");
			primary = &recs[i];
		} else {
			zassert_is_null(secondary, "More than one record with PrimaryRecord FALSE");
			secondary = &recs[i];
		}
	}

	zassert_not_null(primary, "No record with PrimaryRecord TRUE");
	zassert_not_null(secondary, "No record with PrimaryRecord FALSE");

	test_did_check_record(primary, &expect_primary, found);
	test_did_check_record(secondary, &expect_secondary, found);

	if ((found & TEST_DID_HAS_HANDLE) != 0U) {
		zassert_not_equal(primary->handle, secondary->handle,
				  "Both records have handle 0x%08x", primary->handle);
	}
}

/* Service Search for the PnP Information UUID; the server has @p count records. */
static void search_handles(struct test_did_discover *d, uint8_t count)
{
	test_did_discover_init(d, BT_SDP_DISCOVER_SERVICE_SEARCH, &test_did_pnp_uuid.uuid, NULL);
	test_did_discover_run(d);

	zassert_equal(d->empty_count, 0U, "Service Search returned no handle");
	zassert_equal(d->handle_count, count, "Got %u handles, expected %u", d->handle_count,
		      count);

	for (uint8_t i = 1U; i < d->handle_count; i++) {
		zassert_not_equal(d->handles[i - 1U], d->handles[i], "Handle 0x%08x returned twice",
				  d->handles[i]);
	}
}

ZTEST(did_client_sdp, test_001_ssa_single_record)
{
	test_br_sync();

	/* Default attribute ID range 0x0000-0xffff */
	test_did_discover_init(&disc_a, BT_SDP_DISCOVER_SERVICE_SEARCH_ATTR,
			       &test_did_pnp_uuid.uuid, NULL);
	test_did_discover_run(&disc_a);

	/* A single Device ID record has PrimaryRecord TRUE (DID v1.3, section 5.5). */
	test_did_expect_records(&disc_a, 1U);
	test_did_check_record(&disc_a.records[0], &expect_primary, TEST_DID_HAS_ALL);
}

ZTEST(did_client_sdp, test_002_ss_sa_single_record)
{
	const struct test_did_record *rec;

	test_br_sync();

	search_handles(&disc_a, 1U);

	test_did_discover_init_handle(&disc_b, disc_a.handles[0], NULL);
	test_did_discover_run(&disc_b);
	test_did_expect_records(&disc_b, 1U);

	rec = &disc_b.records[0];
	test_did_check_record(rec, &expect_primary, TEST_DID_HAS_ALL);
	zassert_equal(rec->handle, disc_a.handles[0], "Record handle 0x%08x, requested 0x%08x",
		      rec->handle, disc_a.handles[0]);
}

ZTEST(did_client_sdp, test_003_ssa_two_records)
{
	test_br_sync();

	test_did_discover_init(&disc_a, BT_SDP_DISCOVER_SERVICE_SEARCH_ATTR,
			       &test_did_pnp_uuid.uuid, NULL);
	test_did_discover_run(&disc_a);

	test_did_expect_records(&disc_a, 2U);
	check_two_records(disc_a.records, disc_a.record_count, TEST_DID_HAS_ALL);
}

ZTEST(did_client_sdp, test_004_ss_sa_two_records)
{
	struct test_did_record recs[2];

	test_br_sync();

	search_handles(&disc_a, ARRAY_SIZE(recs));

	for (size_t i = 0U; i < ARRAY_SIZE(recs); i++) {
		test_did_discover_init_handle(&disc_b, disc_a.handles[i], &handle_did_ids);
		test_did_discover_run(&disc_b);
		test_did_expect_records(&disc_b, 1U);
		zassert_equal(disc_b.records[0].handle, disc_a.handles[i],
			      "Record handle 0x%08x, requested 0x%08x", disc_b.records[0].handle,
			      disc_a.handles[i]);
		recs[i] = disc_b.records[0];
	}

	/* ServiceClassIDList (0x0001) is not in the requested ranges. */
	check_two_records(recs, ARRAY_SIZE(recs), TEST_DID_HAS_HANDLE | TEST_DID_HAS_DID);
}

ZTEST(did_client_sdp, test_005_ssa_attr_subset)
{
	test_br_sync();

	test_did_discover_init(&disc_a, BT_SDP_DISCOVER_SERVICE_SEARCH_ATTR,
			       &test_did_pnp_uuid.uuid, &subset_ids);
	test_did_discover_run(&disc_a);

	test_did_expect_records(&disc_a, 2U);
	check_two_records(disc_a.records, disc_a.record_count,
			  TEST_DID_HAS_VENDOR_ID | TEST_DID_HAS_VERSION | TEST_DID_HAS_PRIMARY |
				  TEST_DID_HAS_SOURCE);
}

ZTEST(did_client_sdp, test_006_ssa_reserved_range)
{
	test_br_sync();

	/* A range that ends in the reserved IDs returns VendorIDSource of both records only. */
	test_did_discover_init(&disc_a, BT_SDP_DISCOVER_SERVICE_SEARCH_ATTR,
			       &test_did_pnp_uuid.uuid, &source_reserved_ids);
	test_did_discover_run(&disc_a);
	test_did_expect_records(&disc_a, 2U);

	for (uint8_t i = 0U; i < disc_a.record_count; i++) {
		const struct test_did_record *rec = &disc_a.records[i];

		test_did_check_record(rec,
				      (rec->source == TEST_DID_SOURCE_BT_SIG) ? &expect_primary
									      : &expect_secondary,
				      TEST_DID_HAS_SOURCE);
	}

	zassert_not_equal(disc_a.records[0].source, disc_a.records[1].source,
			  "Both records have VendorIDSource 0x%04x", disc_a.records[0].source);

	/*
	 * Neither record has an attribute in the reserved range, and the Zephyr SDP server leaves
	 * out a record without matching attributes, so the client reports an empty result.
	 */
	test_did_discover_init(&disc_b, BT_SDP_DISCOVER_SERVICE_SEARCH_ATTR,
			       &test_did_pnp_uuid.uuid, &reserved_ids);
	test_did_discover_run(&disc_b);
	test_did_expect_empty(&disc_b);
}

ZTEST(did_client_sdp, test_007_record_removed)
{
	test_br_sync();

	/* The server removed the secondary record: only the DID module record remains. */
	test_did_discover_init(&disc_a, BT_SDP_DISCOVER_SERVICE_SEARCH_ATTR,
			       &test_did_pnp_uuid.uuid, NULL);
	test_did_discover_run(&disc_a);

	test_did_expect_records(&disc_a, 1U);
	test_did_check_record(&disc_a.records[0], &expect_primary, TEST_DID_HAS_ALL);
}

ZTEST(did_client_sdp, test_008_discover_queue)
{
	int err;

	test_br_sync();

	test_did_discover_init(&disc_a, BT_SDP_DISCOVER_SERVICE_SEARCH, &test_did_pnp_uuid.uuid,
			       NULL);
	test_did_discover_init(&disc_b, BT_SDP_DISCOVER_SERVICE_SEARCH_ATTR,
			       &test_did_pnp_uuid.uuid, NULL);
	test_did_discover_init(&disc_c, BT_SDP_DISCOVER_SERVICE_SEARCH_ATTR,
			       &test_did_pnp_uuid.uuid, NULL);

	/* B stops after the first of the two records. */
	disc_b.stop_after = 1U;

	/* Queue all requests before the first one is resolved. */
	err = test_did_discover_start(&disc_a);
	zassert_equal(err, 0, "Failed to queue request A (err %d)", err);
	err = test_did_discover_start(&disc_b);
	zassert_equal(err, 0, "Failed to queue request B (err %d)", err);
	err = test_did_discover_start(&disc_c);
	zassert_equal(err, 0, "Failed to queue request C (err %d)", err);

	test_did_discover_wait(&disc_a);
	test_did_discover_wait(&disc_b);
	test_did_discover_wait(&disc_c);

	zassert_true(disc_a.done_order < disc_b.done_order, "Request B completed before A");
	zassert_true(disc_b.done_order < disc_c.done_order, "Request C completed before B");

	zassert_equal(disc_a.empty_count, 0U, "Service Search returned no handle");
	zassert_equal(disc_a.handle_count, 2U, "Got %u handles, expected 2", disc_a.handle_count);

	/* No further callback for B after it returned BT_SDP_DISCOVER_UUID_STOP. */
	zassert_equal(disc_b.cb_count, 1U, "Request B got %u callbacks, expected 1",
		      disc_b.cb_count);
	test_did_expect_records(&disc_b, 1U);

	test_did_expect_records(&disc_c, 2U);
	check_two_records(disc_c.records, disc_c.record_count, TEST_DID_HAS_ALL);
}

ZTEST(did_client_sdp, test_009_discover_cancel)
{
	int err;

	test_br_sync();

	test_did_discover_init(&disc_a, BT_SDP_DISCOVER_SERVICE_SEARCH_ATTR,
			       &test_did_pnp_uuid.uuid, NULL);
	test_did_discover_init(&disc_c, BT_SDP_DISCOVER_SERVICE_SEARCH_ATTR,
			       &test_did_pnp_uuid.uuid, NULL);

	/* A tries to cancel itself while it is being resolved. */
	disc_a.cancel_in_cb = true;

	err = bt_sdp_discover_cancel(NULL, &disc_c.params);
	zassert_equal(err, -EINVAL, "Cancel without connection returned %d", err);
	err = bt_sdp_discover_cancel(test_br_conn(), NULL);
	zassert_equal(err, -EINVAL, "Cancel without parameters returned %d", err);
	err = bt_sdp_discover_cancel(test_br_conn(), &disc_c.params);
	zassert_equal(err, -ESRCH, "Cancel of a request that is not queued returned %d", err);

	err = test_did_discover_start(&disc_a);
	zassert_equal(err, 0, "Failed to queue request A (err %d)", err);
	err = test_did_discover_start(&disc_c);
	zassert_equal(err, 0, "Failed to queue request C (err %d)", err);

	/*
	 * The requests wait for the SDP channel to the peer, and C waits for A as well. The test
	 * thread is cooperative and does not block until the cancel below, so C is still queued.
	 */
	err = bt_sdp_discover_cancel(test_br_conn(), &disc_c.params);
	zassert_equal(err, 0, "Failed to cancel queued request C (err %d)", err);
	err = bt_sdp_discover_cancel(test_br_conn(), &disc_c.params);
	zassert_equal(err, -ESRCH, "Second cancel of request C returned %d", err);

	/* A canceled request may be reused immediately. */
	err = test_did_discover_start(&disc_c);
	zassert_equal(err, 0, "Failed to queue request C again (err %d)", err);

	test_did_discover_wait(&disc_a);
	test_did_discover_wait(&disc_c);

	zassert_equal(disc_a.cancel_err, -EINPROGRESS, "Cancel in the callback returned %d",
		      disc_a.cancel_err);
	test_did_expect_records(&disc_a, 2U);
	check_two_records(disc_a.records, disc_a.record_count, TEST_DID_HAS_ALL);

	/* One callback per record of the second submission, none for the canceled one. */
	zassert_true(disc_a.done_order < disc_c.done_order, "Request C completed before A");
	zassert_equal(disc_c.cb_count, 2U, "Request C got %u callbacks, expected 2",
		      disc_c.cb_count);
	test_did_expect_records(&disc_c, 2U);
	check_two_records(disc_c.records, disc_c.record_count, TEST_DID_HAS_ALL);
}

ZTEST(did_client_sdp, test_010_sa_reserved_range)
{
	test_br_sync();

	search_handles(&disc_a, 2U);

	/*
	 * The Zephyr SDP server answers a Service Attribute request without matching attributes
	 * with an empty attribute list, which the client reports as an empty result.
	 */
	for (uint8_t i = 0U; i < disc_a.handle_count; i++) {
		test_did_discover_init_handle(&disc_b, disc_a.handles[i], &reserved_ids);
		test_did_discover_run(&disc_b);
		test_did_expect_empty(&disc_b);
	}
}

static void *setup(void)
{
	test_br_setup(TEST_BR_INITIATOR, BT_SECURITY_L1);
	return NULL;
}

static void teardown(void *f)
{
	test_br_teardown();
}

static void after(void *f)
{
	test_did_discover_release(&disc_a);
	test_did_discover_release(&disc_b);
	test_did_discover_release(&disc_c);
}

ZTEST_SUITE(did_client_sdp, NULL, setup, NULL, after, teardown);
```

## src/test_common.c
```c
/*
 * SPDX-FileCopyrightText: Copyright 2026 NXP
 *
 * SPDX-License-Identifier: Apache-2.0
 */

#include <string.h>

#include <zephyr/kernel.h>
#include <zephyr/sys/byteorder.h>
#include <zephyr/bluetooth/bluetooth.h>
#include <zephyr/bluetooth/conn.h>
#include <zephyr/bluetooth/uuid.h>
#include <zephyr/bluetooth/classic/sdp.h>
#include <zephyr/logging/log.h>
#include <zephyr/net_buf.h>
#include <zephyr/ztest.h>

#include "test_br.h"
#include "test_common.h"

LOG_MODULE_REGISTER(test_did_common, CONFIG_TEST_CLASSIC_DID_SIM_LOG_LEVEL);

/*
 * The SDP client holds one buffer while a request is resolved and may take a second one when a
 * response is continued. A buffer holds the responses of both Device ID records.
 */
#define SDP_POOL_COUNT    2
#define SDP_POOL_BUF_SIZE 512

NET_BUF_POOL_FIXED_DEFINE(did_sdp_pool, SDP_POOL_COUNT, SDP_POOL_BUF_SIZE,
			  CONFIG_BT_CONN_TX_USER_DATA_SIZE, NULL);

const struct bt_uuid_16 test_did_pnp_uuid = BT_UUID_INIT_16(BT_SDP_PNP_INFO_SVCLASS);

static const struct {
	uint16_t id;
	uint32_t bit;
} known_attrs[] = {
	{BT_SDP_ATTR_RECORD_HANDLE, TEST_DID_HAS_HANDLE},
	{BT_SDP_ATTR_SVCLASS_ID_LIST, TEST_DID_HAS_SVCLASS},
	{BT_SDP_ATTR_RECORD_STATE, TEST_DID_HAS_STATE},
	{BT_SDP_ATTR_BROWSE_GRP_LIST, TEST_DID_HAS_BROWSE},
	{BT_SDP_ATTR_LANG_BASE_ATTR_ID_LIST, TEST_DID_HAS_LANG},
	{BT_SDP_ATTR_SPECIFICATION_ID, TEST_DID_HAS_SPEC_ID},
	{BT_SDP_ATTR_VENDOR_ID, TEST_DID_HAS_VENDOR_ID},
	{BT_SDP_ATTR_PRODUCT_ID, TEST_DID_HAS_PRODUCT_ID},
	{BT_SDP_ATTR_VERSION, TEST_DID_HAS_VERSION},
	{BT_SDP_ATTR_PRIMARY_RECORD, TEST_DID_HAS_PRIMARY},
	{BT_SDP_ATTR_VENDOR_ID_SOURCE, TEST_DID_HAS_SOURCE},
};

static atomic_t done_count;

static bool record_attr_cb(const struct bt_sdp_attribute *attr, void *user_data)
{
	struct test_did_record *rec = user_data;

	ARRAY_FOR_EACH(known_attrs, i) {
		if (known_attrs[i].id == attr->id) {
			rec->found |= known_attrs[i].bit;
			return true;
		}
	}

	rec->unknown_count++;
	return true;
}

static bool svclass_cb(const struct bt_sdp_attr_value_pair *value, void *user_data)
{
	struct test_did_record *rec = user_data;

	rec->svclass_count++;

	if ((value->uuid != NULL) && (value->value == NULL) &&
	    (bt_uuid_cmp(value->uuid, &test_did_pnp_uuid.uuid) == 0)) {
		rec->svclass_pnp_count++;
	}

	return true;
}

static int read_value(const struct net_buf *buf, uint16_t attr_id, struct bt_sdp_attr_value *value)
{
	struct bt_sdp_attribute attr;
	int err;

	err = bt_sdp_get_attr(buf, attr_id, &attr);
	if (err != 0) {
		LOG_ERR("Attribute 0x%04x not found (err %d)", attr_id, err);
		return err;
	}

	err = bt_sdp_attr_read(&attr, NULL, value);
	if (err != 0) {
		LOG_ERR("Failed to read attribute 0x%04x (err %d)", attr_id, err);
		return err;
	}

	return 0;
}

static int read_uint(const struct net_buf *buf, uint16_t attr_id, uint8_t size,
		     struct bt_sdp_attr_value *value)
{
	int err;

	err = read_value(buf, attr_id, value);
	if (err != 0) {
		return err;
	}

	if ((value->type != BT_SDP_ATTR_VALUE_TYPE_UINT) || (value->uint.size != size)) {
		LOG_ERR("Attribute 0x%04x: type %d size %u, expected uint%u", attr_id, value->type,
			value->uint.size, size * 8U);
		return -EINVAL;
	}

	return 0;
}

/* Read the uint16 attribute @p attr_id if the record has it. */
static int read_u16_if(const struct test_did_record *rec, const struct net_buf *buf, uint32_t bit,
		       uint16_t attr_id, uint16_t *out)
{
	struct bt_sdp_attr_value value;
	int err;

	if ((rec->found & bit) == 0U) {
		return 0;
	}

	err = read_uint(buf, attr_id, sizeof(uint16_t), &value);
	if (err == 0) {
		*out = value.uint.u16;
	}

	return err;
}

static int read_svclass(struct test_did_record *rec, const struct net_buf *buf)
{
	struct bt_sdp_attribute attr;
	int err;

	err = bt_sdp_get_attr(buf, BT_SDP_ATTR_SVCLASS_ID_LIST, &attr);
	if (err != 0) {
		return err;
	}

	return bt_sdp_attr_value_parse(&attr, svclass_cb, rec);
}

static int read_primary(struct test_did_record *rec, const struct net_buf *buf)
{
	struct bt_sdp_attr_value value;
	int err;

	err = read_value(buf, BT_SDP_ATTR_PRIMARY_RECORD, &value);
	if (err != 0) {
		return err;
	}

	if (value.type != BT_SDP_ATTR_VALUE_TYPE_BOOL) {
		LOG_ERR("PrimaryRecord: type %d, expected bool", value.type);
		return -EINVAL;
	}

	rec->primary = value.value;
	return 0;
}

/* Runs in the SDP callback: only collect values, the test thread checks them. */
static void parse_record(struct test_did_record *rec, const struct net_buf *buf)
{
	struct bt_sdp_attr_value value;
	uint16_t version;
	uint16_t features;
	int err;

	memset(rec, 0, sizeof(*rec));

	err = bt_sdp_record_parse(buf, record_attr_cb, rec);
	if (err != 0) {
		LOG_ERR("Failed to parse record (err %d)", err);
		rec->err = err;
		return;
	}

	if ((rec->found & TEST_DID_HAS_HANDLE) != 0U) {
		err = read_uint(buf, BT_SDP_ATTR_RECORD_HANDLE, sizeof(uint32_t), &value);
		if (err == 0) {
			rec->handle = value.uint.u32;
		}
	}

	if ((err == 0) && ((rec->found & TEST_DID_HAS_SVCLASS) != 0U)) {
		err = read_svclass(rec, buf);
	}

	if (err == 0) {
		err = read_u16_if(rec, buf, TEST_DID_HAS_SPEC_ID, BT_SDP_ATTR_SPECIFICATION_ID,
				  &rec->spec_id);
	}

	if (err == 0) {
		err = read_u16_if(rec, buf, TEST_DID_HAS_VENDOR_ID, BT_SDP_ATTR_VENDOR_ID,
				  &rec->vendor_id);
	}

	if (err == 0) {
		err = read_u16_if(rec, buf, TEST_DID_HAS_PRODUCT_ID, BT_SDP_ATTR_PRODUCT_ID,
				  &rec->product_id);
	}

	if (err == 0) {
		err = read_u16_if(rec, buf, TEST_DID_HAS_VERSION, BT_SDP_ATTR_VERSION,
				  &rec->version);
	}

	if (err == 0) {
		err = read_u16_if(rec, buf, TEST_DID_HAS_SOURCE, BT_SDP_ATTR_VENDOR_ID_SOURCE,
				  &rec->source);
	}

	if ((err == 0) && ((rec->found & TEST_DID_HAS_PRIMARY) != 0U)) {
		err = read_primary(rec, buf);
	}

	rec->err = err;

	rec->vendor_id_err = bt_sdp_get_vendor_id(buf, &rec->vendor_id_val);
	rec->product_id_err = bt_sdp_get_product_id(buf, &rec->product_id_val);
	rec->profile_version_err =
		bt_sdp_get_profile_version(buf, BT_SDP_PNP_INFO_SVCLASS, &version);
	rec->features_err = bt_sdp_get_features(buf, &features);

	LOG_DBG("Record: attrs 0x%03x handle 0x%08x spec 0x%04x vid 0x%04x pid 0x%04x "
		"ver 0x%04x primary %d src 0x%04x",
		rec->found, rec->handle, rec->spec_id, rec->vendor_id, rec->product_id,
		rec->version, rec->primary, rec->source);
}

static void discover_set_err(struct test_did_discover *d, int err)
{
	if (d->err == 0) {
		d->err = err;
	}
}

static void parse_handles(struct test_did_discover *d, const struct net_buf *buf)
{
	if ((buf->len % sizeof(uint32_t)) != 0U) {
		LOG_ERR("Invalid record handle list length %u", buf->len);
		discover_set_err(d, -EINVAL);
	}

	for (uint16_t off = 0U; (off + sizeof(uint32_t)) <= buf->len; off += sizeof(uint32_t)) {
		if (d->handle_count >= ARRAY_SIZE(d->handles)) {
			LOG_ERR("Too many record handles");
			discover_set_err(d, -ENOMEM);
			break;
		}

		d->handles[d->handle_count++] = sys_get_be32(&buf->data[off]);
	}
}

static void discover_done(struct test_did_discover *d)
{
	d->done_order = atomic_inc(&done_count) + 1;
	k_sem_give(&d->done_sem);
}

static uint8_t discover_cb(struct bt_conn *conn, struct bt_sdp_client_result *result,
			   const struct bt_sdp_discover_params *params)
{
	struct test_did_discover *d = CONTAINER_OF(params, struct test_did_discover, params);

	d->cb_count++;

	if (d->cancel_in_cb) {
		d->cancel_in_cb = false;
		d->cancel_err = bt_sdp_discover_cancel(conn, &d->params);
	}

	if ((result == NULL) || (result->resp_buf == NULL)) {
		LOG_DBG("No (more) result");
		d->empty_count++;
		discover_done(d);
		return BT_SDP_DISCOVER_UUID_STOP;
	}

	LOG_HEXDUMP_DBG(result->resp_buf->data, result->resp_buf->len, "SDP result:");

	if (params->type == BT_SDP_DISCOVER_SERVICE_SEARCH) {
		parse_handles(d, result->resp_buf);
	} else if (d->record_count < ARRAY_SIZE(d->records)) {
		parse_record(&d->records[d->record_count], result->resp_buf);
		d->record_count++;
	} else {
		LOG_ERR("Too many records");
		discover_set_err(d, -ENOMEM);
	}

	if (result->next_record_hint &&
	    ((d->stop_after == 0U) || (d->record_count < d->stop_after))) {
		return BT_SDP_DISCOVER_UUID_CONTINUE;
	}

	discover_done(d);
	return BT_SDP_DISCOVER_UUID_STOP;
}

void test_did_discover_init(struct test_did_discover *d, uint8_t type, const struct bt_uuid *uuid,
			    struct bt_sdp_attribute_id_list *ids)
{
	memset(d, 0, sizeof(*d));
	k_sem_init(&d->done_sem, 0, 1);

	d->params.uuid = uuid;
	d->params.func = discover_cb;
	d->params.pool = &did_sdp_pool;
	d->params.type = type;
	d->params.ids = ids;
}

void test_did_discover_init_handle(struct test_did_discover *d, uint32_t handle,
				   struct bt_sdp_attribute_id_list *ids)
{
	test_did_discover_init(d, BT_SDP_DISCOVER_SERVICE_ATTR, NULL, ids);
	d->params.handle = handle;
}

int test_did_discover_start(struct test_did_discover *d)
{
	return bt_sdp_discover(test_br_conn(), &d->params);
}

void test_did_discover_release(struct test_did_discover *d)
{
	struct bt_conn *conn = test_br_conn();
	int err;

	if (conn == NULL) {
		return;
	}

	/* A request left queued by a failed test must not be reused while it is queued. */
	err = bt_sdp_discover_cancel(conn, &d->params);
	if (err == 0) {
		LOG_WRN("Canceled a queued SDP request");
	} else if (err == -EINPROGRESS) {
		LOG_WRN("SDP request still in progress");
	}
}

void test_did_discover_wait(struct test_did_discover *d)
{
	int err;

	err = test_br_wait(&d->done_sem, TEST_BR_STEP_TIMEOUT);
	zassert_equal(err, 0, "SDP discovery not complete (err %d)", err);
	zassert_equal(d->err, 0, "SDP result parsing failed (err %d)", d->err);
}

void test_did_discover_run(struct test_did_discover *d)
{
	int err;

	err = test_did_discover_start(d);
	zassert_equal(err, 0, "Failed to start SDP discovery (err %d)", err);

	test_did_discover_wait(d);
}

void test_did_expect_records(const struct test_did_discover *d, uint8_t count)
{
	zassert_equal(d->empty_count, 0U, "SDP discovery returned an empty result");
	zassert_equal(d->record_count, count, "Got %u records, expected %u", d->record_count,
		      count);
}

void test_did_expect_empty(const struct test_did_discover *d)
{
	zassert_equal(d->cb_count, 1U, "Got %u callbacks, expected 1", d->cb_count);
	zassert_equal(d->empty_count, 1U, "Expected an empty result");
	zassert_equal(d->record_count, 0U, "Got %u records, expected none", d->record_count);
	zassert_equal(d->handle_count, 0U, "Got %u handles, expected none", d->handle_count);
}

void test_did_check_record(const struct test_did_record *rec, const struct test_did_expect *exp,
			   uint32_t found)
{
	zassert_equal(rec->err, 0, "Record parsing failed (err %d)", rec->err);
	zassert_equal(rec->found, found, "Record has attributes 0x%03x, expected 0x%03x",
		      rec->found, found);
	zassert_equal(rec->unknown_count, 0U, "Record has %u other attributes", rec->unknown_count);

	if ((found & TEST_DID_HAS_SVCLASS) != 0U) {
		zassert_equal(rec->svclass_count, 1U, "ServiceClassIDList has %u elements",
			      rec->svclass_count);
		zassert_equal(rec->svclass_pnp_count, 1U,
			      "ServiceClassIDList has no PnP Information UUID");
	}

	if ((found & TEST_DID_HAS_SPEC_ID) != 0U) {
		zassert_equal(rec->spec_id, TEST_DID_SPEC_ID, "SpecificationID 0x%04x",
			      rec->spec_id);
	}

	if ((found & TEST_DID_HAS_VENDOR_ID) != 0U) {
		zassert_equal(rec->vendor_id, exp->vendor_id, "VendorID 0x%04x, expected 0x%04x",
			      rec->vendor_id, exp->vendor_id);
		zassert_equal(rec->vendor_id_err, 0, "bt_sdp_get_vendor_id() failed (err %d)",
			      rec->vendor_id_err);
		zassert_equal(rec->vendor_id_val, exp->vendor_id,
			      "bt_sdp_get_vendor_id() 0x%04x, expected 0x%04x", rec->vendor_id_val,
			      exp->vendor_id);
	} else {
		zassert_equal(rec->vendor_id_err, -ENODATA,
			      "bt_sdp_get_vendor_id() without VendorID returned %d",
			      rec->vendor_id_err);
	}

	if ((found & TEST_DID_HAS_PRODUCT_ID) != 0U) {
		zassert_equal(rec->product_id, exp->product_id, "ProductID 0x%04x, expected 0x%04x",
			      rec->product_id, exp->product_id);
		zassert_equal(rec->product_id_err, 0, "bt_sdp_get_product_id() failed (err %d)",
			      rec->product_id_err);
		zassert_equal(rec->product_id_val, exp->product_id,
			      "bt_sdp_get_product_id() 0x%04x, expected 0x%04x",
			      rec->product_id_val, exp->product_id);
	} else {
		zassert_equal(rec->product_id_err, -ENODATA,
			      "bt_sdp_get_product_id() without ProductID returned %d",
			      rec->product_id_err);
	}

	if ((found & TEST_DID_HAS_VERSION) != 0U) {
		zassert_equal(rec->version, exp->version, "Version 0x%04x, expected 0x%04x",
			      rec->version, exp->version);
	}

	if ((found & TEST_DID_HAS_PRIMARY) != 0U) {
		zassert_equal(rec->primary, exp->primary, "PrimaryRecord %d, expected %d",
			      rec->primary, exp->primary);
	}

	if ((found & TEST_DID_HAS_SOURCE) != 0U) {
		zassert_equal(rec->source, exp->source, "VendorIDSource 0x%04x, expected 0x%04x",
			      rec->source, exp->source);
	}

	/* The records of this test have no ProfileDescriptorList and no SupportedFeatures. */
	zassert_equal(rec->profile_version_err, -ENODATA,
		      "bt_sdp_get_profile_version() returned %d", rec->profile_version_err);
	zassert_equal(rec->features_err, -ENODATA, "bt_sdp_get_features() returned %d",
		      rec->features_err);
}
```

## src/test_common.h
```c
/*
 * SPDX-FileCopyrightText: Copyright 2026 NXP
 *
 * SPDX-License-Identifier: Apache-2.0
 */

#ifndef TEST_DID_COMMON_H_
#define TEST_DID_COMMON_H_

#include <stdbool.h>
#include <stdint.h>

#include <zephyr/kernel.h>
#include <zephyr/bluetooth/uuid.h>
#include <zephyr/bluetooth/classic/sdp.h>

/* SpecificationID of Device ID v1.3 (DID v1.3, section 5.1), set by the DID module. */
#define TEST_DID_SPEC_ID 0x0103

/* VendorIDSource values (DID v1.3, section 5.6). */
#define TEST_DID_SOURCE_BT_SIG 0x0001
#define TEST_DID_SOURCE_USB_IF 0x0002

/*
 * Values of the second, non-primary PnP Information record that only the server role registers.
 * Both roles run the same image, so both have the record of the DID module. Finding this record
 * proves that the client read the SDP database of the peer.
 */
#define TEST_DID_SECONDARY_VENDOR_ID  0x4d21
#define TEST_DID_SECONDARY_PRODUCT_ID 0x3c5a
#define TEST_DID_SECONDARY_VERSION    0x0102

/* Reserved attribute IDs (DID v1.3, section 5.7). */
#define TEST_DID_ATTR_RESERVED_FIRST 0x0206
#define TEST_DID_ATTR_RESERVED_LAST  0x02ff

/* Bits of test_did_record.found, one per attribute of the records of this test. */
#define TEST_DID_HAS_HANDLE     BIT(0)
#define TEST_DID_HAS_SVCLASS    BIT(1)
#define TEST_DID_HAS_SPEC_ID    BIT(2)
#define TEST_DID_HAS_VENDOR_ID  BIT(3)
#define TEST_DID_HAS_PRODUCT_ID BIT(4)
#define TEST_DID_HAS_VERSION    BIT(5)
#define TEST_DID_HAS_PRIMARY    BIT(6)
#define TEST_DID_HAS_SOURCE     BIT(7)
#define TEST_DID_HAS_STATE      BIT(8)
#define TEST_DID_HAS_BROWSE     BIT(9)
#define TEST_DID_HAS_LANG       BIT(10)

/* Attributes that BT_SDP_NEW_SERVICE adds next to the record handle. */
#define TEST_DID_HAS_NEW_SERVICE (TEST_DID_HAS_STATE | TEST_DID_HAS_BROWSE | TEST_DID_HAS_LANG)

/* The mandatory attributes of DID v1.3, table 5.1 (0x0200 to 0x0205). */
#define TEST_DID_HAS_DID                                                                           \
	(TEST_DID_HAS_SPEC_ID | TEST_DID_HAS_VENDOR_ID | TEST_DID_HAS_PRODUCT_ID |                 \
	 TEST_DID_HAS_VERSION | TEST_DID_HAS_PRIMARY | TEST_DID_HAS_SOURCE)

/* Every attribute of the Device ID records of this test. */
#define TEST_DID_HAS_ALL                                                                           \
	(TEST_DID_HAS_HANDLE | TEST_DID_HAS_NEW_SERVICE | TEST_DID_HAS_SVCLASS | TEST_DID_HAS_DID)

#define TEST_DID_MAX_RECORDS 4

/* Content of one service record, parsed in the SDP discovery callback. */
struct test_did_record {
	/* TEST_DID_HAS_* bits of the attributes in the record */
	uint32_t found;
	/* Number of attributes that are not one of TEST_DID_HAS_* */
	uint8_t unknown_count;
	/* First parsing error, 0 if none */
	int err;
	uint32_t handle;
	/* Number of elements and of PnP Information UUIDs in ServiceClassIDList */
	uint8_t svclass_count;
	uint8_t svclass_pnp_count;
	uint16_t spec_id;
	uint16_t vendor_id;
	uint16_t product_id;
	uint16_t version;
	uint16_t source;
	bool primary;
	/* Results of the SDP client helpers on the record */
	int vendor_id_err;
	uint16_t vendor_id_val;
	int product_id_err;
	uint16_t product_id_val;
	int profile_version_err;
	int features_err;
};

/* Expected values of a Device ID record. */
struct test_did_expect {
	uint16_t vendor_id;
	uint16_t product_id;
	uint16_t version;
	uint16_t source;
	bool primary;
};

/* One SDP discovery request and its results. */
struct test_did_discover {
	struct bt_sdp_discover_params params;
	struct k_sem done_sem;
	/*
	 * Return BT_SDP_DISCOVER_UUID_STOP after this many records of a Service Attribute or
	 * Service Search Attribute request, 0 to read all records
	 */
	uint8_t stop_after;
	/* Call bt_sdp_discover_cancel() for this request in its first callback */
	bool cancel_in_cb;
	int cancel_err;
	/* Number of callbacks, and of callbacks without result */
	uint8_t cb_count;
	uint8_t empty_count;
	/* Completion order of the requests, starting at 1 */
	atomic_val_t done_order;
	/* Record handles of Service Search responses */
	uint32_t handles[TEST_DID_MAX_RECORDS];
	uint8_t handle_count;
	/* Records of Service Attribute and Service Search Attribute responses */
	struct test_did_record records[TEST_DID_MAX_RECORDS];
	uint8_t record_count;
	/* First error found in the callback, 0 if none */
	int err;
};

extern const struct bt_uuid_16 test_did_pnp_uuid;

/* Prepare a Service Search or Service Search Attribute request for @p uuid. */
void test_did_discover_init(struct test_did_discover *d, uint8_t type, const struct bt_uuid *uuid,
			    struct bt_sdp_attribute_id_list *ids);

/* Prepare a Service Attribute request for the record @p handle. */
void test_did_discover_init_handle(struct test_did_discover *d, uint32_t handle,
				   struct bt_sdp_attribute_id_list *ids);

/* Queue the request on the ACL link of the test, return the bt_sdp_discover() result. */
int test_did_discover_start(struct test_did_discover *d);

/* Cancel the request if a failed test left it queued; for the suite after() hook. */
void test_did_discover_release(struct test_did_discover *d);

/* Wait until the request is complete. */
void test_did_discover_wait(struct test_did_discover *d);

/* Start the request and wait until it is complete. */
void test_did_discover_run(struct test_did_discover *d);

/* Check that the request returned @p count records and no empty result. */
void test_did_expect_records(const struct test_did_discover *d, uint8_t count);

/* Check that the request ended with one empty result only. */
void test_did_expect_empty(const struct test_did_discover *d);

/*
 * Check that @p rec holds exactly the attributes @p found with the values of @p exp.
 */
void test_did_check_record(const struct test_did_record *rec, const struct test_did_expect *exp,
			   uint32_t found);

#endif /* TEST_DID_COMMON_H_ */
```

## src/test_disabled.c
```c
/*
 * SPDX-FileCopyrightText: Copyright 2026 NXP
 *
 * SPDX-License-Identifier: Apache-2.0
 */

#include <zephyr/kernel.h>
#include <zephyr/bluetooth/bluetooth.h>
#include <zephyr/bluetooth/conn.h>
#include <zephyr/bluetooth/uuid.h>
#include <zephyr/bluetooth/classic/sdp.h>
#include <zephyr/logging/log.h>
#include <zephyr/ztest.h>

#include "test_br.h"
#include "test_common.h"

LOG_MODULE_REGISTER(test_did_disabled, CONFIG_TEST_CLASSIC_DID_SIM_LOG_LEVEL);

/*
 * Without CONFIG_BT_DID the peer has no PnP Information record. The server registers this Serial
 * Port record instead, so the client can show that the SDP server of the peer answers.
 */
static struct bt_sdp_attribute control_attrs[] = {
	BT_SDP_NEW_SERVICE,
	BT_SDP_LIST(
		BT_SDP_ATTR_SVCLASS_ID_LIST,
		BT_SDP_TYPE_SIZE_VAR(BT_SDP_SEQ8, 3),
		BT_SDP_DATA_ELEM_LIST(
		{
			BT_SDP_TYPE_SIZE(BT_SDP_UUID16),
			BT_SDP_ARRAY_16(BT_SDP_SERIAL_PORT_SVCLASS)
		},
		)
	),
};

static struct bt_sdp_record control_rec = BT_SDP_RECORD(control_attrs);

static const struct bt_uuid_16 control_uuid = BT_UUID_INIT_16(BT_SDP_SERIAL_PORT_SVCLASS);

static struct test_did_discover disc;

ZTEST(did_client_disabled, test_001_no_record)
{
	const struct test_did_record *rec;

	test_br_sync();

	test_did_discover_init(&disc, BT_SDP_DISCOVER_SERVICE_SEARCH_ATTR, &control_uuid.uuid,
			       NULL);
	test_did_discover_run(&disc);
	test_did_expect_records(&disc, 1U);

	rec = &disc.records[0];
	zassert_equal(rec->err, 0, "Record parsing failed (err %d)", rec->err);
	zassert_equal(rec->found,
		      TEST_DID_HAS_HANDLE | TEST_DID_HAS_NEW_SERVICE | TEST_DID_HAS_SVCLASS,
		      "Control record has attributes 0x%03x", rec->found);
	zassert_equal(rec->svclass_pnp_count, 0U, "Control record has a PnP Information UUID");

	/* DID v1.3, appendix D 12.2 (informative): no Device ID record, no handle. */
	test_did_discover_init(&disc, BT_SDP_DISCOVER_SERVICE_SEARCH, &test_did_pnp_uuid.uuid,
			       NULL);
	test_did_discover_run(&disc);
	test_did_expect_empty(&disc);

	test_did_discover_init(&disc, BT_SDP_DISCOVER_SERVICE_SEARCH_ATTR, &test_did_pnp_uuid.uuid,
			       NULL);
	test_did_discover_run(&disc);
	test_did_expect_empty(&disc);
}

ZTEST(did_server_disabled, test_001_no_record)
{
	test_br_sync();
}

static void *client_setup(void)
{
	test_br_setup(TEST_BR_INITIATOR, BT_SECURITY_L1);
	return NULL;
}

static void *server_setup(void)
{
	int err;

	test_br_setup(TEST_BR_ACCEPTOR, BT_SECURITY_L1);

	err = bt_sdp_register_service(&control_rec);
	zassert_equal(err, 0, "Failed to register the control record (err %d)", err);

	return NULL;
}

static void teardown(void *f)
{
	test_br_teardown();
}

static void client_after(void *f)
{
	test_did_discover_release(&disc);
}

ZTEST_SUITE(did_client_disabled, NULL, client_setup, NULL, client_after, teardown);
ZTEST_SUITE(did_server_disabled, NULL, server_setup, NULL, NULL, teardown);
```

## src/test_main.c
```c
/*
 * SPDX-FileCopyrightText: Copyright 2026 NXP
 *
 * SPDX-License-Identifier: Apache-2.0
 */

#include <zephyr/kernel.h>
#include <zephyr/bluetooth/bluetooth.h>
#include <zephyr/bluetooth/conn.h>
#include <zephyr/logging/log.h>
#include <zephyr/ztest.h>

#include "nsi_host_trampolines.h"
#include "nsi_errno.h"
#include "nsi_main.h"
#include "soc.h"
#include "cmdline.h" /* native_sim command line options header */

#define LOG_MODULE_NAME test_classic_did_sim_main
LOG_MODULE_REGISTER(LOG_MODULE_NAME, CONFIG_TEST_CLASSIC_DID_SIM_LOG_LEVEL);

bt_addr_t peer_addr;

static void cmd_peer_bd_address_found(char *argv, int offset)
{
	char *addr_str = &argv[offset];
	int err;

	err = bt_addr_from_str(addr_str, &peer_addr);
	if (err != 0) {
		LOG_ERR("Failed to parse peer Bluetooth address: %s (err %d)", addr_str, err);
		nsi_exit(err);
	}
}

static void test_did_args(void)
{
	static struct args_struct_t args[] = {
		{
			.is_mandatory = true,
			.option = "peer_bd_address",
			.name = "XX:XX:XX:XX:XX:XX",
			.type = 's',
			.call_when_found = cmd_peer_bd_address_found,
			.descript = "Bluetooth peer device address for DID test",
		},
		ARG_TABLE_ENDMARKER
	};

	native_add_command_line_opts(args);
}

NATIVE_TASK(test_did_args, PRE_BOOT_1, 20);
```

## src/test_server.c
```c
/*
 * SPDX-FileCopyrightText: Copyright 2026 NXP
 *
 * SPDX-License-Identifier: Apache-2.0
 */

#include <zephyr/kernel.h>
#include <zephyr/bluetooth/bluetooth.h>
#include <zephyr/bluetooth/conn.h>
#include <zephyr/bluetooth/classic/sdp.h>
#include <zephyr/logging/log.h>
#include <zephyr/ztest.h>

#include "test_br.h"
#include "test_common.h"

LOG_MODULE_REGISTER(test_did_server, CONFIG_TEST_CLASSIC_DID_SIM_LOG_LEVEL);

/* Second, non-primary PnP Information record, laid out like the record of the DID module. */
static struct bt_sdp_attribute secondary_attrs[] = {
	BT_SDP_NEW_SERVICE,
	BT_SDP_LIST(
		BT_SDP_ATTR_SVCLASS_ID_LIST,
		BT_SDP_TYPE_SIZE_VAR(BT_SDP_SEQ8, 3),
		BT_SDP_DATA_ELEM_LIST(
		{
			BT_SDP_TYPE_SIZE(BT_SDP_UUID16),
			BT_SDP_ARRAY_16(BT_SDP_PNP_INFO_SVCLASS)
		},
		)
	),
	BT_SDP_LIST(
		BT_SDP_ATTR_SPECIFICATION_ID,
		BT_SDP_TYPE_SIZE(BT_SDP_UINT16),
		BT_SDP_ARRAY_16(TEST_DID_SPEC_ID)
	),
	BT_SDP_LIST(
		BT_SDP_ATTR_VENDOR_ID,
		BT_SDP_TYPE_SIZE(BT_SDP_UINT16),
		BT_SDP_ARRAY_16(TEST_DID_SECONDARY_VENDOR_ID)
	),
	BT_SDP_LIST(
		BT_SDP_ATTR_PRODUCT_ID,
		BT_SDP_TYPE_SIZE(BT_SDP_UINT16),
		BT_SDP_ARRAY_16(TEST_DID_SECONDARY_PRODUCT_ID)
	),
	BT_SDP_LIST(
		BT_SDP_ATTR_VERSION,
		BT_SDP_TYPE_SIZE(BT_SDP_UINT16),
		BT_SDP_ARRAY_16(TEST_DID_SECONDARY_VERSION)
	),
	BT_SDP_LIST(
		BT_SDP_ATTR_PRIMARY_RECORD,
		BT_SDP_TYPE_SIZE(BT_SDP_BOOL),
		BT_SDP_ARRAY_8(0)
	),
	BT_SDP_LIST(
		BT_SDP_ATTR_VENDOR_ID_SOURCE,
		BT_SDP_TYPE_SIZE(BT_SDP_UINT16),
		BT_SDP_ARRAY_16(TEST_DID_SOURCE_USB_IF)
	),
};

static struct bt_sdp_record secondary_rec = BT_SDP_RECORD(secondary_attrs);
static bool secondary_registered;

/*
 * Register or unregister the secondary record. Tests call this before test_br_sync(): the client
 * starts SDP only after the sync and the previous ACL link is gone, so no SDP channel is open.
 */
static void secondary_set(bool registered)
{
	int err;

	if (registered == secondary_registered) {
		return;
	}

	if (registered) {
		err = bt_sdp_register_service(&secondary_rec);
		zassert_equal(err, 0, "Failed to register the secondary record (err %d)", err);
		zassert_not_equal(secondary_rec.handle, 0U, "Secondary record has no handle");
		LOG_DBG("Secondary record registered, handle 0x%08x", secondary_rec.handle);
	} else {
		err = bt_sdp_unregister_service(&secondary_rec);
		zassert_equal(err, 0, "Failed to unregister the secondary record (err %d)", err);
		LOG_DBG("Secondary record unregistered");
	}

	secondary_registered = registered;
}

ZTEST(did_server_sdp, test_001_ssa_single_record)
{
	secondary_set(false);
	test_br_sync();
}

ZTEST(did_server_sdp, test_002_ss_sa_single_record)
{
	secondary_set(false);
	test_br_sync();
}

ZTEST(did_server_sdp, test_003_ssa_two_records)
{
	int err;

	secondary_set(true);

	err = bt_sdp_register_service(&secondary_rec);
	zassert_equal(err, -EEXIST, "Second registration of a record returned %d", err);

	test_br_sync();
}

ZTEST(did_server_sdp, test_004_ss_sa_two_records)
{
	secondary_set(true);
	test_br_sync();
}

ZTEST(did_server_sdp, test_005_ssa_attr_subset)
{
	secondary_set(true);
	test_br_sync();
}

ZTEST(did_server_sdp, test_006_ssa_reserved_range)
{
	secondary_set(true);
	test_br_sync();
}

ZTEST(did_server_sdp, test_007_record_removed)
{
	int err;

	secondary_set(true);
	secondary_set(false);

	err = bt_sdp_unregister_service(&secondary_rec);
	zassert_equal(err, -ENOENT, "Unregistration of a removed record returned %d", err);

	err = bt_sdp_unregister_service(NULL);
	zassert_equal(err, -EINVAL, "Unregistration of NULL returned %d", err);

	test_br_sync();
}

ZTEST(did_server_sdp, test_008_discover_queue)
{
	secondary_set(true);
	test_br_sync();
}

ZTEST(did_server_sdp, test_009_discover_cancel)
{
	secondary_set(true);
	test_br_sync();
}

ZTEST(did_server_sdp, test_010_sa_reserved_range)
{
	secondary_set(true);
	test_br_sync();
}

static void *setup(void)
{
	/* With CONFIG_BT_DID, bt_enable() registers the record of the DID module. */
	test_br_setup(TEST_BR_ACCEPTOR, BT_SECURITY_L1);
	return NULL;
}

static void teardown(void *f)
{
	test_br_teardown();
}

ZTEST_SUITE(did_server_sdp, NULL, setup, NULL, NULL, teardown);
```
