## Kconfig
```
# SPDX-FileCopyrightText: Copyright 2026 NXP
#
# SPDX-License-Identifier: Apache-2.0

source "Kconfig.zephyr"

module = TEST_CLASSIC_A2DP_SIM
module-str = test_classic_a2dp_sim
source "subsys/logging/Kconfig.template.log_config"

module = TEST_BR
module-str = test_br
source "subsys/logging/Kconfig.template.log_config"

config TEST_A2DP_INT_SINK
	bool "The initiator of the signaling tests uses the sink endpoint"
	default y
	help
	  The initiator (device 0) creates the A2DP connection and sends the AVDTP commands of
	  the signaling tests. If enabled, it uses its sink endpoint and the acceptor its source
	  endpoint, as in the board-to-board a2dp_sink tests. If disabled, the initiator uses its
	  source endpoint and the acceptor its sink endpoint.
```

## prj.conf
```kconfig
# SPDX-FileCopyrightText: Copyright 2026 NXP
#
# SPDX-License-Identifier: Apache-2.0

CONFIG_BT=y
CONFIG_BT_CLASSIC=y
CONFIG_BT_TESTING=y
CONFIG_LOG=y
CONFIG_ZTEST=y

CONFIG_BT_DEVICE_NAME="test_a2dp"

CONFIG_BT_CREATE_CONN_TIMEOUT=30
CONFIG_BT_PAGE_TIMEOUT=0xFFFF

# Both devices register a sink and a source endpoint; each test chooses the endpoints it uses.
CONFIG_BT_A2DP=y
CONFIG_BT_A2DP_SINK=y
CONFIG_BT_A2DP_SOURCE=y

CONFIG_TEST_CLASSIC_A2DP_SIM_LOG_LEVEL_DBG=y
```

## src/test_acp_robustness.c
```c
/*
 * SPDX-FileCopyrightText: Copyright 2026 NXP
 *
 * SPDX-License-Identifier: Apache-2.0
 */

/* Robustness tests of the acceptor (device 1), counterpart of test_int_robustness.c. */

#include <zephyr/kernel.h>
#include <zephyr/bluetooth/classic/a2dp.h>
#include <zephyr/bluetooth/classic/avdtp.h>
#include <zephyr/ztest.h>

#include "test_br.h"
#include "test_common.h"

static void fragmentation(void)
{
	test_br_sync();

	test_acp_wait_connected();
	test_avdtp_set_tx_mtu(TEST_FRAG_MTU);

	test_br_sync();

	test_expect_rsp(EVT_CONFIG_REQ, BT_AVDTP_SUCCESS);
	test_expect(EVT_CONFIGURED);

	test_br_sync();
}

ZTEST(a2dp_acp_robustness, test_001_fragmentation_sink_int)
{
	fragmentation();
}

ZTEST(a2dp_acp_robustness, test_002_fragmentation_source_int)
{
	fragmentation();
}

ZTEST(a2dp_acp_robustness, test_003_random_procedure)
{
	test_br_sync();

	/* Every request of the random commands is accepted. */
	test_acp_wait_connected();

	test_br_sync();

	/* Drops the events of the random commands. */
	test_wait_disconnected();
	test_br_sync();

	test_acp_wait_connected();
	test_expect_rsp(EVT_CONFIG_REQ, BT_AVDTP_SUCCESS);
	test_expect(EVT_CONFIGURED);
	test_expect(EVT_ESTABLISH_REQ);
	test_expect(EVT_ESTABLISHED);
	test_expect(EVT_START_REQ);
	test_expect(EVT_STARTED);
	test_expect(EVT_SUSPEND_REQ);
	test_expect(EVT_SUSPENDED);
	test_expect(EVT_RELEASE_REQ);
	test_expect(EVT_RELEASED);

	test_br_sync();
}

static void *setup(void)
{
	test_a2dp_suite_setup(TEST_BR_ACCEPTOR);
	return NULL;
}

static void teardown(void *f)
{
	test_a2dp_suite_teardown();
}

static void before(void *f)
{
	test_a2dp_before();
}

ZTEST_SUITE(a2dp_acp_robustness, NULL, setup, before, NULL, teardown);
```

## src/test_acp_signaling.c
```c
/*
 * SPDX-FileCopyrightText: Copyright 2026 NXP
 *
 * SPDX-License-Identifier: Apache-2.0
 */

/*
 * Signaling tests of the acceptor (device 1), counterpart of test_int_signaling.c. Commands to
 * an unknown endpoint (an abort is not answered) and configurations outside the capabilities are
 * refused by the stack and not reported to the application.
 */

#include <zephyr/kernel.h>
#include <zephyr/bluetooth/l2cap.h>
#include <zephyr/bluetooth/classic/a2dp.h>
#include <zephyr/bluetooth/classic/a2dp_codec_sbc.h>
#include <zephyr/bluetooth/classic/avdtp.h>
#include <zephyr/ztest.h>

#include "test_br.h"
#include "test_common.h"

#define LOCAL_TSEP test_peer_tsep(TEST_INT_TSEP)

static void run_twice(void (*body)(void))
{
	test_br_sync();
	body();

	/* Waits for the release of the stream and drops the events of the first connection. */
	test_wait_disconnected();

	test_br_sync();
	body();

	test_br_sync();
}

/* The A2DP connection and the configuration of the board-to-board preparation. */
static void prepare(void)
{
	test_acp_wait_connected();

	test_expect_rsp(EVT_CONFIG_REQ, BT_AVDTP_SUCCESS);
	zassert_equal(test_req_cfg.codec_ie[2], TEST_MIN_BITPOOL, "Minimum bitpool %u",
		      test_req_cfg.codec_ie[2]);
	zassert_false(test_req_delay_report, "Delay reporting configured");
	zassert_equal_ptr(test_stream.local_ep, test_local_ep(LOCAL_TSEP, false),
			  "Unexpected local endpoint");
	test_expect(EVT_CONFIGURED);
}

static void establish(void)
{
	test_expect(EVT_ESTABLISH_REQ);
	test_expect(EVT_ESTABLISHED);
}

static void start(void)
{
	test_expect(EVT_START_REQ);
	test_expect(EVT_STARTED);
}

static void suspend(void)
{
	test_expect(EVT_SUSPEND_REQ);
	test_expect(EVT_SUSPENDED);
}

static void set_configuration(void)
{
	prepare();

	/* The configuration with the invalid minimum bitpool is not reported. */
	test_evt_none(EVT_CONFIG_REQ, K_NO_WAIT);
}

ZTEST(a2dp_acp_signaling, test_001_set_configuration)
{
	run_twice(set_configuration);
}

static void establish_cmd(void)
{
	prepare();
	establish();
}

ZTEST(a2dp_acp_signaling, test_002_establish)
{
	run_twice(establish_cmd);
}

static void release_cmd(void)
{
	prepare();
	establish();

	test_expect(EVT_RELEASE_REQ);
	test_expect(EVT_RELEASED);
}

ZTEST(a2dp_acp_signaling, test_003_release)
{
	run_twice(release_cmd);
}

static void start_cmd(void)
{
	prepare();
	establish();
	start();
}

ZTEST(a2dp_acp_signaling, test_004_start)
{
	run_twice(start_cmd);
}

static void suspend_cmd(void)
{
	prepare();
	establish();
	start();
	suspend();
}

ZTEST(a2dp_acp_signaling, test_005_suspend)
{
	run_twice(suspend_cmd);
}

static void reconfigure_cmd(void)
{
	prepare();
	establish();
	start();
	suspend();

	/* Only the reconfiguration within the capabilities is reported. */
	test_expect(EVT_RECONFIG_REQ);
	zassert_equal(test_req_cfg.codec_ie[2], TEST_MIN_BITPOOL_RECONF, "Minimum bitpool %u",
		      test_req_cfg.codec_ie[2]);
	test_expect(EVT_CONFIGURED);
}

ZTEST(a2dp_acp_signaling, test_006_reconfigure)
{
	run_twice(reconfigure_cmd);
}

static void abort_cmd(void)
{
	prepare();
	establish();

	/* The abort of the unknown endpoint is not answered, and not reported. */
	test_expect(EVT_ABORT_REQ);
	test_expect(EVT_RELEASED);
}

ZTEST(a2dp_acp_signaling, test_007_abort)
{
	run_twice(abort_cmd);
}

static void get_configuration_cmd(void)
{
	prepare();

	test_expect(EVT_GET_CONFIG_REQ);
}

ZTEST(a2dp_acp_signaling, test_008_get_configuration)
{
	run_twice(get_configuration_cmd);
}

static void get_mtu(void)
{
	uint32_t mtu;

	prepare();
	establish();

	mtu = bt_a2dp_get_mtu(&test_stream);
	zassert_equal(mtu, BT_L2CAP_RX_MTU, "Media MTU %u, expected %u", mtu, BT_L2CAP_RX_MTU);
}

ZTEST(a2dp_acp_signaling, test_009_get_mtu)
{
	run_twice(get_mtu);
}

static void delay_report_cmd(void)
{
	struct test_event evt;

	prepare();

	if (LOCAL_TSEP == BT_AVDTP_SINK) {
		test_set_acp_seid(TEST_BAD_SEID);
		test_delay_report_cmd(TEST_DELAY_REPORT, BT_AVDTP_BAD_ACP_SEID);
		test_restore_acp_seid();

		test_delay_report_cmd(TEST_DELAY_REPORT, BT_AVDTP_SUCCESS);
	} else {
		TEST_EXPECT(EVT_DELAY_REPORT_REQ, TEST_A2DP_TIMEOUT, &evt);
		zassert_equal(evt.value, TEST_DELAY_REPORT, "Delay report %d", evt.value);
		TEST_EXPECT(EVT_DELAY_REPORT, TEST_A2DP_TIMEOUT, &evt);
		zassert_equal(evt.value, TEST_DELAY_REPORT, "Delay report %d", evt.value);
	}

	test_br_sync();
}

ZTEST(a2dp_acp_signaling, test_010_delay_report)
{
	run_twice(delay_report_cmd);
}

static void *setup(void)
{
	test_a2dp_suite_setup(TEST_BR_ACCEPTOR);
	return NULL;
}

static void teardown(void *f)
{
	test_a2dp_suite_teardown();
}

static void before(void *f)
{
	test_a2dp_before();
}

ZTEST_SUITE(a2dp_acp_signaling, NULL, setup, before, NULL, teardown);
```

## src/test_acp_stream.c
```c
/*
 * SPDX-FileCopyrightText: Copyright 2026 NXP
 *
 * SPDX-License-Identifier: Apache-2.0
 */

/* Stream tests of the acceptor (device 1), counterpart of test_int_stream.c. */

#include <zephyr/kernel.h>
#include <zephyr/bluetooth/classic/a2dp.h>
#include <zephyr/bluetooth/classic/a2dp_codec_sbc.h>
#include <zephyr/bluetooth/classic/avdtp.h>
#include <zephyr/ztest.h>

#include "test_br.h"
#include "test_common.h"

/* The A2DP connection and an accepted configuration of the endpoint of type @p tsep. */
static void configured(enum bt_avdtp_sep_type tsep, bool delay_report)
{
	test_acp_wait_connected();

	test_expect_rsp(EVT_CONFIG_REQ, BT_AVDTP_SUCCESS);
	zassert_equal(test_req_delay_report, delay_report, "Delay reporting %u",
		      test_req_delay_report);
	zassert_equal_ptr(test_stream.local_ep, test_local_ep(tsep, delay_report),
			  "Unexpected local endpoint");
	test_expect(EVT_CONFIGURED);
}

static void establish(void)
{
	test_expect(EVT_ESTABLISH_REQ);
	test_expect(EVT_ESTABLISHED);
}

static void start(void)
{
	test_expect(EVT_START_REQ);
	test_expect(EVT_STARTED);
}

static void suspend(void)
{
	test_expect(EVT_SUSPEND_REQ);
	test_expect(EVT_SUSPENDED);
}

static void release(void)
{
	test_expect(EVT_RELEASE_REQ);
	test_expect(EVT_RELEASED);
}

ZTEST(a2dp_acp_stream, test_001_media_source_int)
{
	test_br_sync();

	configured(BT_AVDTP_SINK, false);
	establish();
	start();
	test_media_expect(TEST_MEDIA_PKTS);

	test_br_sync();

	suspend();
	start();
	test_media_expect(TEST_MEDIA_PKTS);

	test_br_sync();

	release();

	test_br_sync();
}

ZTEST(a2dp_acp_stream, test_002_delay_report_configured)
{
	struct test_event evt;

	test_br_sync();

	configured(BT_AVDTP_SOURCE, true);
	zassert_true(test_stream.delay_report, "Delay reporting not configured");

	TEST_EXPECT(EVT_DELAY_REPORT_REQ, TEST_A2DP_TIMEOUT, &evt);
	zassert_equal(evt.value, TEST_DELAY_REPORT_STREAM, "Delay report %d", evt.value);
	TEST_EXPECT(EVT_DELAY_REPORT, TEST_A2DP_TIMEOUT, &evt);
	zassert_equal(evt.value, TEST_DELAY_REPORT_STREAM, "Delay report %d", evt.value);

	establish();

	test_br_sync();
}

ZTEST(a2dp_acp_stream, test_003_reconfigure_48k)
{
	struct bt_a2dp_codec_sbc_params *sbc;

	test_br_sync();

	configured(BT_AVDTP_SINK, false);
	establish();

	test_expect(EVT_RECONFIG_REQ);
	sbc = (struct bt_a2dp_codec_sbc_params *)&test_req_cfg.codec_ie[0];
	zassert_equal(bt_a2dp_sbc_get_sampling_frequency(sbc), 48000U, "Sampling frequency %u",
		      bt_a2dp_sbc_get_sampling_frequency(sbc));
	test_expect(EVT_CONFIGURED);
	test_expect(EVT_GET_CONFIG_REQ);

	test_br_sync();
}

ZTEST(a2dp_acp_stream, test_004_config_rejected)
{
	/* The application rejects the next configuration request. */
	test_config_req_err = BT_AVDTP_UNSUPPORTED_CONFIGURATION;

	test_br_sync();

	test_acp_wait_connected();

	/* The configuration outside the capabilities is rejected by the stack and not reported. */
	test_expect_rsp(EVT_CONFIG_REQ, BT_AVDTP_UNSUPPORTED_CONFIGURATION);
	test_expect_rsp(EVT_CONFIG_REQ, BT_AVDTP_SUCCESS);
	test_expect(EVT_CONFIGURED);
	test_evt_none(EVT_CONFIGURED, K_NO_WAIT);

	test_br_sync();
}

ZTEST(a2dp_acp_stream, test_005_media_sink_int)
{
	test_br_sync();

	configured(BT_AVDTP_SOURCE, false);
	establish();
	start();
	test_media_send(TEST_MEDIA_PKTS);
	suspend();
	release();

	test_br_sync();
}

ZTEST(a2dp_acp_stream, test_006_abort_configured)
{
	test_br_sync();

	configured(BT_AVDTP_SOURCE, false);
	test_expect(EVT_ABORT_REQ);
	test_expect(EVT_RELEASED);

	test_br_sync();
}

ZTEST(a2dp_acp_stream, test_007_avdtp_1_2_peer)
{
	test_br_sync();

	test_acp_wait_connected();

	/* The configuration with delay reporting is refused by the initiator stack, not sent. */
	test_expect_rsp(EVT_CONFIG_REQ, BT_AVDTP_SUCCESS);
	zassert_false(test_req_delay_report, "Delay reporting configured");
	zassert_equal_ptr(test_stream.local_ep, test_local_ep(BT_AVDTP_SOURCE, true),
			  "Unexpected local endpoint");
	test_expect(EVT_CONFIGURED);
	test_evt_none(EVT_CONFIG_REQ, K_NO_WAIT);

	test_br_sync();
}

/* The initiator only checks local API calls. */
ZTEST(a2dp_acp_stream, test_008_unconfigured_stream)
{
	test_br_sync();
	test_br_sync();
}

ZTEST(a2dp_acp_stream, test_009_null_stream)
{
	test_br_sync();
	test_br_sync();
}

/* The stream released by the initiator is refused on this side too. */
ZTEST(a2dp_acp_stream, test_010_released_stream)
{
	test_br_sync();

	configured(BT_AVDTP_SOURCE, false);
	establish();
	release();

	test_stream_cmds_refused();

	test_br_sync();
}

/* The value of the next event of @p type of the test stream: the result of the callback action. */
static int32_t expect_value(enum test_evt type)
{
	struct test_event evt;

	TEST_EXPECT(type, TEST_A2DP_TIMEOUT, &evt);
	zassert_equal_ptr(evt.obj, &test_stream, "%s of an unexpected stream", test_evt_str(type));

	return evt.value;
}

/*
 * An application sends media once the stream is started, possibly from the started callback, and
 * no more once it is suspended.
 */
ZTEST(a2dp_acp_stream, test_011_media_from_started_cb)
{
	int32_t err;

	test_act_in_cb = true;

	test_br_sync();

	configured(BT_AVDTP_SOURCE, false);
	establish();

	test_expect(EVT_START_REQ);
	err = expect_value(EVT_STARTED);
	zassert_equal(err, 0, "Media packet not sent from the started callback (err %d)", err);

	test_expect(EVT_SUSPEND_REQ);
	err = expect_value(EVT_SUSPENDED);
	zassert_equal(err, -EIO, "Media packet sent from the suspended callback (err %d)", err);

	release();

	test_br_sync();
}

/* A sink sends the first delay report from the configured callback (AVDTP v1.3, 8.19.1). */
ZTEST(a2dp_acp_stream, test_012_delay_report_from_configured_cb)
{
	int32_t err;

	test_act_in_cb = true;

	test_br_sync();

	test_acp_wait_connected();
	test_expect_rsp(EVT_CONFIG_REQ, BT_AVDTP_SUCCESS);
	zassert_true(test_req_delay_report, "Delay reporting not configured");
	zassert_equal_ptr(test_stream.local_ep, test_local_ep(BT_AVDTP_SINK, true),
			  "Unexpected local endpoint");

	err = expect_value(EVT_CONFIGURED);
	zassert_equal(err, 0, "Delay report not sent from the configured callback (err %d)", err);
	test_expect_rsp(EVT_DELAY_REPORT_RSP, BT_AVDTP_SUCCESS);

	test_br_sync();
}

ZTEST(a2dp_acp_stream, test_013_config_endpoint_in_use)
{
	test_br_sync();

	configured(BT_AVDTP_SOURCE, false);
	test_expect(EVT_ABORT_REQ);
	test_expect(EVT_RELEASED);

	test_br_sync();
}

/* The configuration outside the capabilities is rejected by the stack and not reported. */
ZTEST(a2dp_acp_stream, test_014_rejected_config_stream)
{
	test_br_sync();

	test_acp_wait_connected();
	test_expect_rsp(EVT_CONFIG_REQ, BT_AVDTP_SUCCESS);
	test_expect(EVT_CONFIGURED);
	test_evt_none(EVT_CONFIGURED, K_NO_WAIT);

	test_br_sync();
}

static struct bt_a2dp_stream collision_stream;
static int collision_err;

/* From the configuration request of the initiator: configure the endpoint of the initiator. */
static void collision_config(void)
{
	collision_err =
		test_stream_config_send(&collision_stream, test_local_ep(BT_AVDTP_SOURCE, true),
					A2DP_SBC_SAMP_FREQ_44100, TEST_MIN_BITPOOL, false);
}

ZTEST(a2dp_acp_stream, test_015_config_collision)
{
	struct test_event evt;

	memset(&collision_stream, 0, sizeof(collision_stream));
	collision_err = -EAGAIN;

	test_br_sync();

	/* The sink endpoint of the initiator. */
	test_acp_wait_connected();
	test_int_discover(BT_AVDTP_SOURCE, true, 0U);

	test_config_req_err = BT_AVDTP_SEP_IN_USE;
	test_config_req_hook = collision_config;

	test_br_sync();

	test_expect_rsp(EVT_CONFIG_REQ, BT_AVDTP_SEP_IN_USE);
	zassert_equal(collision_err, 0, "Failed to send the configuration (err %d)", collision_err);

	TEST_EXPECT(EVT_CONFIG_RSP, TEST_A2DP_TIMEOUT, &evt);
	zassert_equal_ptr(evt.obj, &collision_stream, "config_rsp of an unexpected stream");
	zassert_equal(evt.value, BT_AVDTP_SEP_IN_USE, "Configuration error 0x%02x", evt.value);

	/* The initiator configures its endpoint again. */
	test_expect_rsp(EVT_CONFIG_REQ, BT_AVDTP_SUCCESS);
	test_expect(EVT_CONFIGURED);

	test_br_sync();
}

static void *setup(void)
{
	test_a2dp_suite_setup(TEST_BR_ACCEPTOR);
	return NULL;
}

static void teardown(void *f)
{
	test_a2dp_suite_teardown();
}

static void before(void *f)
{
	test_a2dp_before();
}

ZTEST_SUITE(a2dp_acp_stream, NULL, setup, before, NULL, teardown);
```

## src/test_br.h
```c
/*
 * SPDX-FileCopyrightText: Copyright 2026 NXP
 *
 * SPDX-License-Identifier: Apache-2.0
 */

#ifndef TEST_BR_H_
#define TEST_BR_H_

#include <stdbool.h>

#include <zephyr/kernel.h>
#include <zephyr/bluetooth/bluetooth.h>
#include <zephyr/bluetooth/conn.h>

/*
 * ACL lifecycle and test synchronization shared by the two simulated devices.
 *
 * Both devices run a suite with the same test names, ztest runs them in name order. Before each
 * test the initiator (device 0) creates the ACL connection and the acceptor waits for it. Each
 * test then calls test_br_sync() once this side is ready (e.g. servers registered): both sides
 * exchange the test name in an L2CAP ECHO request/response, the initiator only returns when the
 * acceptor is in the same test. After each test the ACL connection is released, so every test
 * starts from a fresh ACL link.
 *
 * Test names must start with a unique, zero-padded index (test_NNN_...), the first
 * TEST_BR_SYNC_LEN characters are exchanged and compared in name order.
 */

enum test_br_role {
	TEST_BR_INITIATOR,
	TEST_BR_ACCEPTOR,
};

#define TEST_BR_SYNC_LEN 40

/* Default wait for a protocol step of the peer. */
#define TEST_BR_STEP_TIMEOUT K_SECONDS(10)

extern bt_addr_t peer_addr;

/* Enable Bluetooth and set the role of this device; the initiator waits until the peer is found. */
void test_br_setup(enum test_br_role role, bt_security_t sec_level);
void test_br_teardown(void);

/* Security level the ACL link is raised to before each test (BT_SECURITY_L1 for none). */
void test_br_set_security(bt_security_t sec_level);

enum test_br_role test_br_role(void);
struct bt_conn *test_br_conn(void);
bool test_br_connected(void);

/*
 * Wait until the peer calls test_br_sync() in the same test (an L2CAP ECHO with the test name).
 * Both sides call it the same number of times in a test.
 */
void test_br_sync(void);

/* Take @p sem; return -ENOTCONN as soon as the ACL link is lost, -EAGAIN on timeout. */
int test_br_wait(struct k_sem *sem, k_timeout_t timeout);

/* ACL operations inside a test body; failures are reported with zassert. */
void test_br_connect(void);
void test_br_disconnect(void);
void test_br_wait_connected(k_timeout_t timeout);
void test_br_wait_disconnected(k_timeout_t timeout);
void test_br_security(bt_security_t sec_level);

#endif /* TEST_BR_H_ */
```

## src/test_common.h
```c
/*
 * SPDX-FileCopyrightText: Copyright 2026 NXP
 *
 * SPDX-License-Identifier: Apache-2.0
 */

#ifndef TEST_A2DP_COMMON_H_
#define TEST_A2DP_COMMON_H_

#include <stdbool.h>
#include <stdint.h>

#include <zephyr/kernel.h>
#include <zephyr/bluetooth/bluetooth.h>
#include <zephyr/bluetooth/conn.h>
#include <zephyr/bluetooth/classic/a2dp.h>
#include <zephyr/bluetooth/classic/a2dp_codec_sbc.h>
#include <zephyr/bluetooth/classic/avdtp.h>
#include <zephyr/sys/atomic.h>
#include <zephyr/ztest.h>

#include "test_br.h"

/* Events reported by the A2DP and stream callbacks. */
enum test_evt {
	EVT_CONNECTED,
	EVT_DISCONNECTED,
	EVT_CONFIG_REQ,
	EVT_RECONFIG_REQ,
	EVT_CONFIG_RSP,
	EVT_ESTABLISH_REQ,
	EVT_ESTABLISH_RSP,
	EVT_RELEASE_REQ,
	EVT_RELEASE_RSP,
	EVT_START_REQ,
	EVT_START_RSP,
	EVT_SUSPEND_REQ,
	EVT_SUSPEND_RSP,
	EVT_ABORT_REQ,
	EVT_ABORT_RSP,
	EVT_GET_CONFIG_REQ,
	EVT_GET_CONFIG_RSP,
	EVT_DELAY_REPORT_REQ,
	EVT_DELAY_REPORT_RSP,
	EVT_CONFIGURED,
	EVT_ESTABLISHED,
	EVT_RELEASED,
	EVT_STARTED,
	EVT_SUSPENDED,
	EVT_RECV,
	EVT_DELAY_REPORT,

	EVT_COUNT,
};

struct test_event {
	enum test_evt type;
	/* A2DP connection or stream the event refers to. */
	void *obj;
	/* Error code of a request or response, or the value of the event. */
	int32_t value;
	int32_t value2;
};

/* Timeout of one A2DP procedure of the peer; the AVDTP response timeout of the stack is 6 s. */
#define TEST_A2DP_TIMEOUT K_SECONDS(10)

/* Values of the board-to-board tests. */
#define TEST_BAD_SEID              5U
#define TEST_MIN_BITPOOL_INVALID   1U
#define TEST_MIN_BITPOOL           20U
#define TEST_MIN_BITPOOL_RECONF_NS 13U
#define TEST_MIN_BITPOOL_RECONF    22U
#define TEST_DELAY_REPORT          1U
#define TEST_FRAG_MTU              4U
#define TEST_RANDOM_STEPS          50U

/* Delay report value of the stream tests, in 1/10 ms. */
#define TEST_DELAY_REPORT_STREAM 1500U

/* Media packets sent by a source in the stream tests. */
#define TEST_MEDIA_PKTS        10U
#define TEST_MEDIA_PAYLOAD_LEN 64U
#define TEST_MEDIA_TS_STEP     128U

/* Local endpoint type of the initiator in the signaling tests. */
#define TEST_INT_TSEP (IS_ENABLED(CONFIG_TEST_A2DP_INT_SINK) ? BT_AVDTP_SINK : BT_AVDTP_SOURCE)

static inline enum bt_avdtp_sep_type test_peer_tsep(enum bt_avdtp_sep_type tsep)
{
	return (tsep == BT_AVDTP_SINK) ? BT_AVDTP_SOURCE : BT_AVDTP_SINK;
}

/* A2DP connection of the current test. */
extern struct bt_a2dp *test_a2dp;

/* Stream of the current test, on both devices. */
extern struct bt_a2dp_stream test_stream;

/* Remote endpoint found by test_int_discover(). */
extern struct bt_a2dp_ep test_remote_ep;

/* Response error code of the acceptor to the next configuration request, 0 accepts it. */
extern uint8_t test_config_req_err;

/* Called from the next configuration request, before it is answered. */
extern void (*test_config_req_hook)(void);

/* Configuration of the last (re)configuration request seen by the acceptor. */
extern struct bt_a2dp_codec_ie test_req_cfg;
extern bool test_req_delay_report;

/* Configuration of the last get configuration response. */
extern struct bt_a2dp_codec_ie test_rsp_cfg;

/* Media packets received with an unexpected payload. */
extern atomic_t test_media_bad;

/*
 * The stream callbacks act as an application does (set by a test, cleared before each test):
 * configured sends a delay report on a sink with delay reporting, started and suspended send a
 * media packet on a source. The value of their event is the result of the call, 0 otherwise.
 */
extern bool test_act_in_cb;

void test_evt_reset(void);
void test_evt_post(enum test_evt type, void *obj, int32_t value, int32_t value2);

/*
 * Wait for the oldest unconsumed event of @p type and consume it. Events of other types stay
 * queued. Returns 0, -EAGAIN on timeout or -ENOTCONN if the ACL link is lost.
 */
int test_evt_wait(enum test_evt type, k_timeout_t timeout, struct test_event *evt);

/* Check that no event of @p type arrives within @p timeout. */
void test_evt_none(enum test_evt type, k_timeout_t timeout);

const char *test_evt_str(enum test_evt type);

#define TEST_EXPECT(type, timeout, evt)                                                            \
	do {                                                                                       \
		int _err = test_evt_wait((type), (timeout), (evt));                                \
                                                                                                   \
		zassert_equal(_err, 0, "No %s event (err %d)", test_evt_str(type), _err);          \
	} while (false)

/* Suite and test fixtures of both roles. */
void test_a2dp_suite_setup(enum test_br_role role);
void test_a2dp_suite_teardown(void);
void test_a2dp_before(void);

/*
 * Endpoints registered on both devices: an SBC sink with delay reporting, an SBC source without
 * and an SBC source with delay reporting.
 */
struct bt_a2dp_ep *test_local_ep(enum bt_avdtp_sep_type tsep, bool delay_report);

/* Wait for an event of the test stream; for responses, check the error code. */
void test_expect(enum test_evt type);
void test_expect_rsp(enum test_evt type, uint8_t err);

/* Initiator: A2DP connection, discovery and configuration. */
void test_int_connect(void);
void test_int_disconnect(void);

/*
 * Discover the endpoints of the peer and select the SBC endpoint of the other type than
 * @p local_tsep, with or without delay reporting. The AVDTP version given to the stack is read
 * from the A2DP SDP record of the peer if @p avdtp_version is 0.
 */
void test_int_discover(enum bt_avdtp_sep_type local_tsep, bool delay_report,
		       uint16_t avdtp_version);

/* As test_int_discover(), selecting the endpoint with the identifier @p seid. */
void test_int_discover_seid(enum bt_avdtp_sep_type local_tsep, uint8_t seid,
			    uint16_t avdtp_version);

/*
 * Configure the stream with SBC @p freq and @p min_bitpool, from the local endpoint of type
 * @p local_tsep to the discovered endpoint; @p err is the expected response error code.
 * test_int_config_send() only sends the request and returns the result of the API call;
 * test_stream_config_send() does so for @p stream from @p local_ep.
 */
int test_stream_config_send(struct bt_a2dp_stream *stream, struct bt_a2dp_ep *local_ep,
			    uint8_t freq, uint8_t min_bitpool, bool delay_report);
int test_int_config_send(enum bt_avdtp_sep_type local_tsep, uint8_t freq, uint8_t min_bitpool,
			 bool delay_report);
void test_int_config(enum bt_avdtp_sep_type local_tsep, uint8_t freq, uint8_t min_bitpool,
		     bool delay_report, uint8_t err);

/* Reconfigure the stream with SBC @p freq and @p min_bitpool; _send() only sends the request. */
int test_int_reconfig_send(uint8_t freq, uint8_t min_bitpool);
void test_int_reconfig(uint8_t freq, uint8_t min_bitpool, uint8_t err);

/* Board-to-board preparation: connect, discover and configure with min bitpool 20. */
void test_int_prepare(enum bt_avdtp_sep_type local_tsep);

/* Acceptor: wait for the A2DP connection. */
void test_acp_wait_connected(void);

/*
 * Wait for the release of the A2DP connection, and of the test stream if it is configured, then
 * drop the remaining events of the connection.
 */
void test_wait_disconnected(void);

/*
 * Replace the stream end point identifier of the peer used in the next commands by @p seid, or
 * restore it, as the modify_acp_seid command of the board-to-board tests.
 */
void test_set_acp_seid(uint8_t seid);
void test_restore_acp_seid(void);

/* Send a stream command and wait for its response with error code @p err. */
void test_stream_cmd(int (*cmd)(struct bt_a2dp_stream *stream), enum test_evt rsp, uint8_t err);
void test_delay_report_cmd(uint16_t value, uint8_t err);

/* Source: send @p count media packets; sink: receive them. */
void test_media_send(uint16_t count);
void test_media_expect(uint16_t count);

/* Send one media packet on @p stream and return the result of bt_a2dp_stream_send(). */
int test_media_send_on(struct bt_a2dp_stream *stream);

#define CHECK_EINVAL(call)                                                                         \
	do {                                                                                       \
		int _err = (call);                                                                 \
                                                                                                   \
		zassert_equal(_err, -EINVAL, "%s returned %d", #call, _err);                       \
	} while (false)

/* Check that every stream command on the test stream is refused, and that it has no MTU. */
void test_stream_cmds_refused(void);

/*
 * Set the transmit MTU of the AVDTP L2CAP channels of the ACL link to @p mtu, for the rest of the
 * link, as the modify_mtu command of the board-to-board tests (white-box, test_mtu.c).
 */
void test_avdtp_set_tx_mtu(uint16_t mtu);

#endif /* TEST_A2DP_COMMON_H_ */
```

## src/test_int_robustness.c
```c
/*
 * SPDX-FileCopyrightText: Copyright 2026 NXP
 *
 * SPDX-License-Identifier: Apache-2.0
 */

/*
 * Robustness tests of the initiator (device 0): signaling with fragmented AVDTP messages in both
 * directions (board-to-board fragmentation tests of a2dp_sink and a2dp_source) and a random
 * sequence of stream commands (board-to-board a2dp_sink random_procedure).
 */

#include <zephyr/kernel.h>
#include <zephyr/bluetooth/classic/a2dp.h>
#include <zephyr/bluetooth/classic/a2dp_codec_sbc.h>
#include <zephyr/bluetooth/classic/avdtp.h>
#include <zephyr/logging/log.h>
#include <zephyr/ztest.h>

#include "test_br.h"
#include "test_common.h"

LOG_MODULE_REGISTER(test_a2dp_int_robustness, CONFIG_TEST_CLASSIC_A2DP_SIM_LOG_LEVEL);

static void fragmentation(enum bt_avdtp_sep_type tsep)
{
	test_br_sync();

	test_int_connect();
	test_avdtp_set_tx_mtu(TEST_FRAG_MTU);

	/* The acceptor has set its transmit MTU too. */
	test_br_sync();

	test_int_discover(tsep, tsep == BT_AVDTP_SOURCE, 0U);
	test_int_config(tsep, A2DP_SBC_SAMP_FREQ_44100, TEST_MIN_BITPOOL, false, BT_AVDTP_SUCCESS);

	test_br_sync();
}

/* b2b: a2dp_sink fragmentation - AVDTP transmit MTU of 4 on both sides. */
ZTEST(a2dp_int_robustness, test_001_fragmentation_sink_int)
{
	fragmentation(BT_AVDTP_SINK);
}

/* b2b: a2dp_source fragmentation */
ZTEST(a2dp_int_robustness, test_002_fragmentation_source_int)
{
	fragmentation(BT_AVDTP_SOURCE);
}

enum random_cmd {
	CMD_CONFIGURE,
	CMD_ESTABLISH,
	CMD_RECONFIGURE,
	CMD_RELEASE,
	CMD_START,
	CMD_SUSPEND,
	CMD_ABORT,
	CMD_GET_CONFIG,
	CMD_GET_MTU,
	CMD_DELAY_REPORT,

	CMD_COUNT,
};

static uint32_t rand_state;

/* Fixed sequence, so that a failure can be reproduced. */
static uint32_t rand_next(void)
{
	rand_state = (rand_state * 1103515245U) + 12345U;

	return rand_state >> 16;
}

static void random_cmd(enum random_cmd cmd)
{
	struct test_event evt;
	enum test_evt rsp;
	int err;

	switch (cmd) {
	case CMD_CONFIGURE:
		err = test_int_config_send(BT_AVDTP_SINK, A2DP_SBC_SAMP_FREQ_44100,
					   TEST_MIN_BITPOOL, false);
		rsp = EVT_CONFIG_RSP;
		break;
	case CMD_ESTABLISH:
		err = bt_a2dp_stream_establish(&test_stream);
		rsp = EVT_ESTABLISH_RSP;
		break;
	case CMD_RECONFIGURE:
		err = test_int_reconfig_send(A2DP_SBC_SAMP_FREQ_44100, TEST_MIN_BITPOOL_RECONF);
		rsp = EVT_CONFIG_RSP;
		break;
	case CMD_RELEASE:
		err = bt_a2dp_stream_release(&test_stream);
		rsp = EVT_RELEASE_RSP;
		break;
	case CMD_START:
		err = bt_a2dp_stream_start(&test_stream);
		rsp = EVT_START_RSP;
		break;
	case CMD_SUSPEND:
		err = bt_a2dp_stream_suspend(&test_stream);
		rsp = EVT_SUSPEND_RSP;
		break;
	case CMD_ABORT:
		err = bt_a2dp_stream_abort(&test_stream);
		rsp = EVT_ABORT_RSP;
		break;
	case CMD_GET_CONFIG:
		err = bt_a2dp_stream_get_config(&test_stream);
		rsp = EVT_GET_CONFIG_RSP;
		break;
	case CMD_GET_MTU:
		LOG_DBG("Media MTU %u", bt_a2dp_get_mtu(&test_stream));
		return;
	case CMD_DELAY_REPORT:
	default:
		err = bt_a2dp_stream_delay_report(&test_stream, TEST_DELAY_REPORT);
		rsp = EVT_DELAY_REPORT_RSP;
		break;
	}

	if (err != 0) {
		LOG_DBG("Command %u not sent (err %d)", cmd, err);
		return;
	}

	/* Responses of the commands are not checked, only that the procedure goes on. */
	err = test_evt_wait(rsp, TEST_A2DP_TIMEOUT, &evt);
	zassert_not_equal(err, -ENOTCONN, "ACL link lost");
	if (err != 0) {
		LOG_WRN("No %s for command %u", test_evt_str(rsp), cmd);
	} else {
		LOG_DBG("Command %u: %s 0x%02x", cmd, test_evt_str(rsp), evt.value);
	}
}

/*
 * b2b: a2dp_sink random_procedure - 50 random stream commands; then a complete stream procedure
 * on a new A2DP connection still works.
 */
ZTEST(a2dp_int_robustness, test_003_random_procedure)
{
	test_br_sync();

	test_int_connect();
	test_int_discover(BT_AVDTP_SINK, false, 0U);

	rand_state = 0x0a2d9U;
	for (uint32_t i = 0; i < TEST_RANDOM_STEPS; i++) {
		/* Only the events of the current command are waited for. */
		test_evt_reset();
		random_cmd((enum random_cmd)(rand_next() % CMD_COUNT));
	}

	/* The acceptor has seen all commands. */
	test_br_sync();

	test_int_disconnect();

	/* The acceptor has seen the A2DP connection released. */
	test_br_sync();

	test_int_prepare(BT_AVDTP_SINK);
	test_stream_cmd(bt_a2dp_stream_establish, EVT_ESTABLISH_RSP, BT_AVDTP_SUCCESS);
	test_expect(EVT_ESTABLISHED);
	test_stream_cmd(bt_a2dp_stream_start, EVT_START_RSP, BT_AVDTP_SUCCESS);
	test_expect(EVT_STARTED);
	test_stream_cmd(bt_a2dp_stream_suspend, EVT_SUSPEND_RSP, BT_AVDTP_SUCCESS);
	test_expect(EVT_SUSPENDED);
	test_stream_cmd(bt_a2dp_stream_release, EVT_RELEASE_RSP, BT_AVDTP_SUCCESS);
	test_expect(EVT_RELEASED);

	test_br_sync();
}

static void *setup(void)
{
	test_a2dp_suite_setup(TEST_BR_INITIATOR);
	return NULL;
}

static void teardown(void *f)
{
	test_a2dp_suite_teardown();
}

static void before(void *f)
{
	test_a2dp_before();
}

ZTEST_SUITE(a2dp_int_robustness, NULL, setup, before, NULL, teardown);
```

## src/test_int_signaling.c
```c
/*
 * SPDX-FileCopyrightText: Copyright 2026 NXP
 *
 * SPDX-License-Identifier: Apache-2.0
 */

/*
 * Signaling tests of the initiator (device 0): the board-to-board a2dp_sink tests. As there, each
 * test body runs twice, with the A2DP connection released in between. With
 * CONFIG_TEST_A2DP_INT_SINK=n the same tests run with the initiator on the source side; the
 * board-to-board a2dp_source counterparts are disabled there.
 */

#include <zephyr/kernel.h>
#include <zephyr/bluetooth/l2cap.h>
#include <zephyr/bluetooth/classic/a2dp.h>
#include <zephyr/bluetooth/classic/a2dp_codec_sbc.h>
#include <zephyr/bluetooth/classic/avdtp.h>
#include <zephyr/ztest.h>

#include "test_br.h"
#include "test_common.h"

static void run_twice(void (*body)(void))
{
	test_br_sync();
	body();

	/* Waits for the release of the stream and drops the events of the first connection. */
	test_int_disconnect();

	/* The acceptor has seen the A2DP connection released. */
	test_br_sync();
	body();

	test_br_sync();
}

/* The command to an unknown endpoint is rejected, then the command to the peer is accepted. */
static void cmd_bad_seid_then_good(int (*cmd)(struct bt_a2dp_stream *stream), enum test_evt rsp,
				   uint8_t bad_seid_err)
{
	test_set_acp_seid(TEST_BAD_SEID);
	test_stream_cmd(cmd, rsp, bad_seid_err);
	test_restore_acp_seid();

	test_stream_cmd(cmd, rsp, BT_AVDTP_SUCCESS);
}

static void establish(void)
{
	test_stream_cmd(bt_a2dp_stream_establish, EVT_ESTABLISH_RSP, BT_AVDTP_SUCCESS);
	test_expect(EVT_ESTABLISHED);
}

static void start(void)
{
	test_stream_cmd(bt_a2dp_stream_start, EVT_START_RSP, BT_AVDTP_SUCCESS);
	test_expect(EVT_STARTED);
}

static void suspend(void)
{
	test_stream_cmd(bt_a2dp_stream_suspend, EVT_SUSPEND_RSP, BT_AVDTP_SUCCESS);
	test_expect(EVT_SUSPENDED);
}

static void set_configuration(void)
{
	enum bt_avdtp_sep_type tsep = TEST_INT_TSEP;

	test_int_connect();
	test_int_discover(tsep, tsep == BT_AVDTP_SOURCE, 0U);

	/* Rejected by the stack of the peer (SBC capability check). */
	test_int_config(tsep, A2DP_SBC_SAMP_FREQ_44100, TEST_MIN_BITPOOL_INVALID, false,
			BT_A2DP_INVALID_MINIMUM_BITPOOL_VALUE);

	test_int_config(tsep, A2DP_SBC_SAMP_FREQ_44100, TEST_MIN_BITPOOL, false, BT_AVDTP_SUCCESS);
}

/* b2b: set_configuration_cmd - invalid minimum bitpool rejected, then a valid configuration. */
ZTEST(a2dp_int_signaling, test_001_set_configuration)
{
	run_twice(set_configuration);
}

static void establish_cmd(void)
{
	test_int_prepare(TEST_INT_TSEP);

	cmd_bad_seid_then_good(bt_a2dp_stream_establish, EVT_ESTABLISH_RSP, BT_AVDTP_BAD_ACP_SEID);
	test_expect(EVT_ESTABLISHED);
}

/* b2b: establish_cmd */
ZTEST(a2dp_int_signaling, test_002_establish)
{
	run_twice(establish_cmd);
}

static void release_cmd(void)
{
	test_int_prepare(TEST_INT_TSEP);
	establish();

	cmd_bad_seid_then_good(bt_a2dp_stream_release, EVT_RELEASE_RSP, BT_AVDTP_BAD_ACP_SEID);
	test_expect(EVT_RELEASED);
}

/* b2b: release_cmd */
ZTEST(a2dp_int_signaling, test_003_release)
{
	run_twice(release_cmd);
}

static void start_cmd(void)
{
	test_int_prepare(TEST_INT_TSEP);
	establish();

	cmd_bad_seid_then_good(bt_a2dp_stream_start, EVT_START_RSP, BT_AVDTP_BAD_ACP_SEID);
	test_expect(EVT_STARTED);
}

/* b2b: start_cmd */
ZTEST(a2dp_int_signaling, test_004_start)
{
	run_twice(start_cmd);
}

static void suspend_cmd(void)
{
	test_int_prepare(TEST_INT_TSEP);
	establish();
	start();

	cmd_bad_seid_then_good(bt_a2dp_stream_suspend, EVT_SUSPEND_RSP, BT_AVDTP_BAD_ACP_SEID);
	test_expect(EVT_SUSPENDED);
}

/* b2b: suspend_cmd */
ZTEST(a2dp_int_signaling, test_005_suspend)
{
	run_twice(suspend_cmd);
}

static void reconfigure_cmd(void)
{
	test_int_prepare(TEST_INT_TSEP);
	establish();
	start();
	suspend();

	/* Below the minimum bitpool of the capabilities of the peer endpoint. */
	test_int_reconfig(A2DP_SBC_SAMP_FREQ_44100, TEST_MIN_BITPOOL_RECONF_NS,
			  BT_A2DP_NOT_SUPPORTED_MINIMUM_BITPOOL_VALUE);

	test_int_reconfig(A2DP_SBC_SAMP_FREQ_44100, TEST_MIN_BITPOOL_RECONF, BT_AVDTP_SUCCESS);
}

/* b2b: reconfigure_cmd - unsupported minimum bitpool rejected, then a valid one. */
ZTEST(a2dp_int_signaling, test_006_reconfigure)
{
	run_twice(reconfigure_cmd);
}

static void abort_cmd(void)
{
	test_int_prepare(TEST_INT_TSEP);
	establish();

	/*
	 * AVDTP v1.3, 8.16.2: "If an AVDTP_ABORT_CMD contains an invalid SEID, no response shall
	 * be sent." The stack reports the abort with BT_AVDTP_TIME_OUT after its 6 s timeout.
	 */
	cmd_bad_seid_then_good(bt_a2dp_stream_abort, EVT_ABORT_RSP, BT_AVDTP_TIME_OUT);
	test_expect(EVT_RELEASED);
}

/* b2b: abort_cmd - in the OPEN state. */
ZTEST(a2dp_int_signaling, test_007_abort)
{
	run_twice(abort_cmd);
}

static void get_configuration_cmd(void)
{
	test_int_prepare(TEST_INT_TSEP);

	cmd_bad_seid_then_good(bt_a2dp_stream_get_config, EVT_GET_CONFIG_RSP,
			       BT_AVDTP_BAD_ACP_SEID);
	zassert_equal(test_rsp_cfg.len, BT_A2DP_SBC_IE_LENGTH, "Configuration length %u",
		      test_rsp_cfg.len);
	zassert_equal(test_rsp_cfg.codec_ie[2], TEST_MIN_BITPOOL, "Minimum bitpool %u",
		      test_rsp_cfg.codec_ie[2]);
}

/* b2b: get_configuration_cmd - in the CONFIGURED state. */
ZTEST(a2dp_int_signaling, test_008_get_configuration)
{
	run_twice(get_configuration_cmd);
}

static void get_mtu(void)
{
	uint32_t mtu;

	test_int_prepare(TEST_INT_TSEP);
	establish();

	/* Receive MTU of the media channel of the peer, the same build. */
	mtu = bt_a2dp_get_mtu(&test_stream);
	zassert_equal(mtu, BT_L2CAP_RX_MTU, "Media MTU %u, expected %u", mtu, BT_L2CAP_RX_MTU);
}

/* b2b: get_mtu */
ZTEST(a2dp_int_signaling, test_009_get_mtu)
{
	run_twice(get_mtu);
}

static void delay_report_cmd(void)
{
	struct test_event evt;

	test_int_prepare(TEST_INT_TSEP);

	/*
	 * Delay reporting is not configured. AVDTP v1.3, 8.19.1: "Delay reports are sent from SNK
	 * to SRC." With CONFIG_TEST_A2DP_INT_SINK=n the acceptor is the sink and sends the reports.
	 */
	if (TEST_INT_TSEP == BT_AVDTP_SINK) {
		test_set_acp_seid(TEST_BAD_SEID);
		test_delay_report_cmd(TEST_DELAY_REPORT, BT_AVDTP_BAD_ACP_SEID);
		test_restore_acp_seid();

		test_delay_report_cmd(TEST_DELAY_REPORT, BT_AVDTP_SUCCESS);
	} else {
		TEST_EXPECT(EVT_DELAY_REPORT_REQ, TEST_A2DP_TIMEOUT, &evt);
		zassert_equal(evt.value, TEST_DELAY_REPORT, "Delay report %d", evt.value);
		TEST_EXPECT(EVT_DELAY_REPORT, TEST_A2DP_TIMEOUT, &evt);
		zassert_equal(evt.value, TEST_DELAY_REPORT, "Delay report %d", evt.value);
	}

	/* The sink has the response of its last delay report before the release. */
	test_br_sync();
}

/* b2b: delay_report_cmd - in the CONFIGURED state, without delay reporting configured. */
ZTEST(a2dp_int_signaling, test_010_delay_report)
{
	run_twice(delay_report_cmd);
}

static void *setup(void)
{
	test_a2dp_suite_setup(TEST_BR_INITIATOR);
	return NULL;
}

static void teardown(void *f)
{
	test_a2dp_suite_teardown();
}

static void before(void *f)
{
	test_a2dp_before();
}

ZTEST_SUITE(a2dp_int_signaling, NULL, setup, before, NULL, teardown);
```

## src/test_main.c
```c
/*
 * SPDX-FileCopyrightText: Copyright 2026 NXP
 *
 * SPDX-License-Identifier: Apache-2.0
 */

#include <zephyr/kernel.h>
#include <zephyr/bluetooth/bluetooth.h>
#include <zephyr/logging/log.h>
#include <zephyr/ztest.h>

#include "nsi_host_trampolines.h"
#include "nsi_errno.h"
#include "nsi_main.h"
#include "soc.h"
#include "cmdline.h" /* native_sim command line options header */

#define LOG_MODULE_NAME test_classic_a2dp_sim_main
LOG_MODULE_REGISTER(LOG_MODULE_NAME, CONFIG_TEST_CLASSIC_A2DP_SIM_LOG_LEVEL);

bt_addr_t peer_addr;

static void cmd_peer_bd_address_found(char *argv, int offset)
{
	char *addr_str = &argv[offset];
	int err;

	err = bt_addr_from_str(addr_str, &peer_addr);
	if (err != 0) {
		LOG_ERR("Failed to parse peer Bluetooth address: %s (err %d)", addr_str, err);
		nsi_exit(err);
	}
}

static void test_a2dp_args(void)
{
	static struct args_struct_t args[] = {
		{
			.is_mandatory = true,
			.option = "peer_bd_address",
			.name = "XX:XX:XX:XX:XX:XX",
			.type = 's',
			.call_when_found = cmd_peer_bd_address_found,
			.descript = "Bluetooth peer device address for A2DP test",
		},
		ARG_TABLE_ENDMARKER
	};

	native_add_command_line_opts(args);
}

NATIVE_TASK(test_a2dp_args, PRE_BOOT_1, 20);
```

## src/test_mtu.c
```c
/*
 * SPDX-FileCopyrightText: Copyright 2026 NXP
 *
 * SPDX-License-Identifier: Apache-2.0
 */

/*
 * White-box helper of the fragmentation tests, as the modify_mtu command of the board-to-board
 * tests: it changes the transmit MTU of the AVDTP L2CAP channels, which is only possible with the
 * host internal headers. No other file of the test includes them.
 */

#include <zephyr/kernel.h>
#include <zephyr/bluetooth/bluetooth.h>
#include <zephyr/bluetooth/conn.h>
#include <zephyr/bluetooth/l2cap.h>
#include <zephyr/sys/slist.h>
#include <zephyr/ztest.h>

#include <host/conn_internal.h>
#include <host/classic/l2cap_br_internal.h>

#include "test_br.h"
#include "test_common.h"

/* PSM of AVDTP, BT_L2CAP_PSM_AVDTP of the stack. */
#define TEST_PSM_AVDTP 0x0019

void test_avdtp_set_tx_mtu(uint16_t mtu)
{
	struct bt_conn *conn = test_br_conn();
	struct bt_l2cap_chan *chan;
	size_t count = 0;

	zassert_not_null(conn, "No ACL connection");

	SYS_SLIST_FOR_EACH_CONTAINER(&conn->channels, chan, node) {
		struct bt_l2cap_br_chan *br_chan = BR_CHAN(chan);

		if (br_chan->psm == TEST_PSM_AVDTP) {
			br_chan->tx.mtu = mtu;
			count++;
		}
	}

	zassert_true(count > 0, "No AVDTP channel");
}
```
