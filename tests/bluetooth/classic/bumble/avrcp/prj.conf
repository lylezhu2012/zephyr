## CMakeLists.txt
```
# SPDX-FileCopyrightText: Copyright 2026 NXP
#
# SPDX-License-Identifier: Apache-2.0

cmake_minimum_required(VERSION 3.20.0)
set(NO_QEMU_SERIAL_BT_SERVER 1)

find_package(Zephyr REQUIRED HINTS $ENV{ZEPHYR_BASE})
project(bluetooth)

file(GLOB app_sources src/*.c)
target_sources(app PRIVATE ${app_sources})
target_include_directories(app PRIVATE ${ZEPHYR_BASE}/subsys/bluetooth/host)
zephyr_ld_options(-Wl,--wrap=bt_avctp_connect)
```

## Kconfig
```
# SPDX-FileCopyrightText: Copyright 2026 NXP
#
# SPDX-License-Identifier: Apache-2.0

source "Kconfig.zephyr"

module = TEST_CLASSIC_AVRCP_SIM
module-str = test_classic_avrcp_sim
source "subsys/logging/Kconfig.template.log_config"

module = TEST_BR
module-str = test_br
source "subsys/logging/Kconfig.template.log_config"
```

## prj.conf
```kconfig
# SPDX-FileCopyrightText: Copyright 2026 NXP
#
# SPDX-License-Identifier: Apache-2.0

CONFIG_BT=y
CONFIG_BT_CLASSIC=y
CONFIG_BT_TESTING=y
CONFIG_LOG=y
CONFIG_ZTEST=y

CONFIG_BT_DEVICE_NAME="test_avrcp"

CONFIG_BT_CREATE_CONN_TIMEOUT=30
CONFIG_BT_PAGE_TIMEOUT=0xFFFF

# Both devices register the controller and the target role, as in the board-to-board tests.
CONFIG_BT_AVRCP=y
CONFIG_BT_AVRCP_CONTROLLER=y
CONFIG_BT_AVRCP_TARGET=y
CONFIG_BT_AVRCP_BROWSING=y

# The tests keep copies of the received events (up to 640 bytes each) on the stack.
CONFIG_ZTEST_STACK_SIZE=4096

CONFIG_TEST_CLASSIC_AVRCP_SIM_LOG_LEVEL_DBG=y
```

## src/test_br.c
```c
/*
 * SPDX-FileCopyrightText: Copyright 2026 NXP
 *
 * SPDX-License-Identifier: Apache-2.0
 */

#include <string.h>

#include <zephyr/kernel.h>
#include <zephyr/sys/byteorder.h>
#include <zephyr/bluetooth/bluetooth.h>
#include <zephyr/bluetooth/conn.h>
#include <zephyr/bluetooth/hci.h>
#include <zephyr/bluetooth/l2cap.h>
#include <zephyr/bluetooth/classic/classic.h>
#include <zephyr/bluetooth/classic/l2cap_br.h>
#include <zephyr/logging/log.h>
#include <zephyr/net_buf.h>
#include <zephyr/ztest.h>

#include "test_br.h"

LOG_MODULE_REGISTER(test_br, CONFIG_TEST_BR_LOG_LEVEL);

#define POLL_INTERVAL K_MSEC(20)

/* Time for the peer to reach the next test, including its own ACL release. */
#define SYNC_TIMEOUT K_SECONDS(60)

/* Time the acceptor waits for the initiator to release the ACL link after a test. */
#define RELEASE_TIMEOUT K_SECONDS(30)

#define DISCONNECT_TIMEOUT K_SECONDS(10)

#define DISCOVERY_RESULT_COUNT 10

NET_BUF_POOL_FIXED_DEFINE(sync_pool, 2, BT_L2CAP_BUF_SIZE(4 + TEST_BR_SYNC_LEN),
			  CONFIG_BT_CONN_TX_USER_DATA_SIZE, NULL);

struct sync_msg {
	uint8_t ident;
	uint8_t len;
	char name[TEST_BR_SYNC_LEN];
};

K_MSGQ_DEFINE(sync_req_msgq, sizeof(struct sync_msg), 4, 4);
K_MSGQ_DEFINE(sync_rsp_msgq, sizeof(struct sync_msg), 4, 4);

static bool active;
static enum test_br_role role;
static bt_security_t required_sec = BT_SECURITY_L1;
static const char *current_test;

static struct bt_conn *default_conn;
static atomic_t conn_err;
static atomic_t sec_err;

/* A sync request of a later test, kept until this side reaches that test. */
static struct sync_msg pending_req;
static bool pending_valid;

static struct bt_br_discovery_param discovery_param;
static struct bt_br_discovery_result discovery_result[DISCOVERY_RESULT_COUNT];
static K_SEM_DEFINE(peer_found_sem, 0, 1);

static void acl_connected(struct bt_conn *conn, uint8_t err)
{
	struct bt_conn_info info;

	if ((bt_conn_get_info(conn, &info) != 0) || (info.type != BT_CONN_TYPE_BR)) {
		return;
	}

	LOG_DBG("ACL connected: conn %p err 0x%02x", (void *)conn, err);

	if (err != 0) {
		atomic_set(&conn_err, err);
		return;
	}

	if (default_conn == NULL) {
		default_conn = bt_conn_ref(conn);
	}
}

static void acl_disconnected(struct bt_conn *conn, uint8_t reason)
{
	LOG_DBG("ACL disconnected: conn %p reason 0x%02x", (void *)conn, reason);

	if (conn == default_conn) {
		bt_conn_unref(default_conn);
		default_conn = NULL;
	}
}

static void security_changed(struct bt_conn *conn, bt_security_t level, enum bt_security_err err)
{
	LOG_DBG("Security changed: conn %p level %u err %d", (void *)conn, level, err);

	if ((conn == default_conn) && (err != BT_SECURITY_ERR_SUCCESS)) {
		atomic_set(&sec_err, err);
	}
}

BT_CONN_CB_DEFINE(test_br_conn_cb) = {
	.connected = acl_connected,
	.disconnected = acl_disconnected,
	.security_changed = security_changed,
};

static void sync_msg_from_buf(struct sync_msg *msg, uint8_t ident, struct net_buf *buf)
{
	msg->ident = ident;
	msg->len = MIN(buf->len, TEST_BR_SYNC_LEN);
	memcpy(msg->name, buf->data, msg->len);
}

static void echo_req(struct bt_conn *conn, uint8_t identifier, struct net_buf *buf)
{
	struct sync_msg msg;

	sync_msg_from_buf(&msg, identifier, buf);
	if (k_msgq_put(&sync_req_msgq, &msg, K_NO_WAIT) != 0) {
		LOG_WRN("Sync request queue full");
	}
}

static void echo_rsp(struct bt_conn *conn, struct net_buf *buf)
{
	struct sync_msg msg;

	sync_msg_from_buf(&msg, 0, buf);
	if (k_msgq_put(&sync_rsp_msgq, &msg, K_NO_WAIT) != 0) {
		LOG_WRN("Sync response queue full");
	}
}

static struct bt_l2cap_br_echo_cb echo_cb = {
	.req = echo_req,
	.rsp = echo_rsp,
};

static void discovery_recv(const struct bt_br_discovery_result *result)
{
	if (bt_addr_eq(&peer_addr, &result->addr)) {
		k_sem_give(&peer_found_sem);
	}
}

static struct bt_br_discovery_cb discovery_cb = {
	.recv = discovery_recv,
};

static void sync_token(const char *name, struct sync_msg *msg)
{
	msg->len = MIN(strlen(name), TEST_BR_SYNC_LEN);
	memcpy(msg->name, name, msg->len);
}

static int sync_cmp(const struct sync_msg *a, const struct sync_msg *b)
{
	int cmp = memcmp(a->name, b->name, MIN(a->len, b->len));

	if (cmp != 0) {
		return cmp;
	}

	return (int)a->len - (int)b->len;
}

static struct net_buf *sync_buf(const struct sync_msg *msg)
{
	struct net_buf *buf;

	buf = net_buf_alloc(&sync_pool, K_SECONDS(1));
	if (buf != NULL) {
		net_buf_reserve(buf, BT_L2CAP_BR_ECHO_REQ_RESERVE);
		net_buf_add_mem(buf, msg->name, msg->len);
	}

	return buf;
}

static void sync_initiator(const char *name)
{
	struct sync_msg own;
	struct sync_msg rsp;
	struct net_buf *buf;
	int err;

	sync_token(name, &own);
	k_msgq_purge(&sync_rsp_msgq);

	/* The signaling channel serves one request at a time; the Information Request sent after
	 * the ACL connection is established makes the stack log "Waiting for ECHO RSP" and return
	 * -EBUSY until it is answered.
	 */
	for (int i = 0; i < 50; i++) {
		buf = sync_buf(&own);
		zassert_not_null(buf, "No sync buffer");

		err = bt_l2cap_br_echo_req(default_conn, buf);
		if (err == 0) {
			break;
		}

		net_buf_unref(buf);
		if (err != -EBUSY) {
			break;
		}
		k_sleep(K_MSEC(200));
	}
	zassert_equal(err, 0, "Failed to send sync request (err %d)", err);

	err = -EAGAIN;
	for (k_timepoint_t end = sys_timepoint_calc(SYNC_TIMEOUT); !sys_timepoint_expired(end);) {
		err = k_msgq_get(&sync_rsp_msgq, &rsp, POLL_INTERVAL);
		if ((err == 0) || (default_conn == NULL)) {
			break;
		}
	}
	zassert_equal(err, 0, "No sync response from peer for %s", name);
	zassert_equal(sync_cmp(&rsp, &own), 0, "Peer is at test %.*s, this side at %s", rsp.len,
		      rsp.name, name);
}

static void sync_send_rsp(const struct sync_msg *req, const struct sync_msg *own)
{
	struct net_buf *buf;
	int err;

	if (default_conn == NULL) {
		return;
	}

	buf = sync_buf(own);
	if (buf == NULL) {
		LOG_ERR("No sync buffer");
		return;
	}

	err = bt_l2cap_br_echo_rsp(default_conn, req->ident, buf);
	if (err != 0) {
		LOG_ERR("Failed to send sync response (err %d)", err);
		net_buf_unref(buf);
	}
}

static void sync_acceptor(const char *name)
{
	k_timepoint_t end = sys_timepoint_calc(SYNC_TIMEOUT);
	struct sync_msg own;
	struct sync_msg req;
	int cmp;
	int err;

	sync_token(name, &own);

	while (true) {
		if (pending_valid) {
			req = pending_req;
			pending_valid = false;
		} else {
			err = k_msgq_get(&sync_req_msgq, &req, sys_timepoint_timeout(end));
			zassert_equal(err, 0, "No sync request from peer for %s", name);
		}

		cmp = sync_cmp(&req, &own);
		if (cmp == 0) {
			sync_send_rsp(&req, &own);
			return;
		}

		if (cmp < 0) {
			/* The peer is behind; it fails its test and connects again. */
			LOG_WRN("Peer is at earlier test %.*s, this side at %s", req.len, req.name,
				name);
			sync_send_rsp(&req, &own);
			continue;
		}

		/* The peer is ahead; answer it once this side reaches the same test. */
		pending_req = req;
		pending_valid = true;
		zassert_unreachable("Peer is at test %.*s, this side at %s", req.len, req.name,
				    name);
	}
}

static bool wait_for(bool (*cond)(void), k_timeout_t timeout)
{
	k_timepoint_t end = sys_timepoint_calc(timeout);

	while (!cond()) {
		if (sys_timepoint_expired(end)) {
			return false;
		}
		k_sleep(POLL_INTERVAL);
	}

	return true;
}

static bool is_connected(void)
{
	return default_conn != NULL;
}

static bool is_disconnected(void)
{
	return default_conn == NULL;
}

static bool is_released(void)
{
	struct bt_conn *conn = bt_conn_lookup_addr_br(&peer_addr);

	if (conn != NULL) {
		bt_conn_unref(conn);
		return false;
	}

	return true;
}

static bt_security_t wait_sec_level;

static bool is_secure(void)
{
	return (default_conn == NULL) || (atomic_get(&sec_err) != 0) ||
	       (bt_conn_get_security(default_conn) >= wait_sec_level);
}

enum test_br_role test_br_role(void)
{
	return role;
}

struct bt_conn *test_br_conn(void)
{
	return default_conn;
}

bool test_br_connected(void)
{
	return default_conn != NULL;
}

void test_br_sync(void)
{
	zassert_not_null(current_test, "No test running");
	zassert_not_null(default_conn, "ACL not connected");

	if (role == TEST_BR_INITIATOR) {
		sync_initiator(current_test);
	} else {
		sync_acceptor(current_test);
	}
}

int test_br_wait(struct k_sem *sem, k_timeout_t timeout)
{
	k_timepoint_t end = sys_timepoint_calc(timeout);

	while (k_sem_take(sem, POLL_INTERVAL) != 0) {
		if (default_conn == NULL) {
			return (k_sem_take(sem, K_NO_WAIT) == 0) ? 0 : -ENOTCONN;
		}

		if (sys_timepoint_expired(end)) {
			return -EAGAIN;
		}
	}

	return 0;
}

void test_br_connect(void)
{
	struct bt_conn *conn;

	zassert_is_null(default_conn, "ACL already connected");

	atomic_set(&conn_err, 0);
	conn = bt_conn_create_br(&peer_addr, BT_BR_CONN_PARAM_DEFAULT);
	zassert_not_null(conn, "Failed to create ACL connection");
	bt_conn_unref(conn);

	test_br_wait_connected(K_SECONDS(CONFIG_BT_CREATE_CONN_TIMEOUT));
}

void test_br_wait_connected(k_timeout_t timeout)
{
	bool ok = wait_for(is_connected, timeout);

	zassert_true(ok, "ACL connection timeout (err 0x%02lx)", atomic_get(&conn_err));
}

void test_br_disconnect(void)
{
	int err;

	zassert_not_null(default_conn, "ACL not connected");

	err = bt_conn_disconnect(default_conn, BT_HCI_ERR_REMOTE_USER_TERM_CONN);
	zassert_equal(err, 0, "Failed to disconnect ACL (err %d)", err);

	test_br_wait_disconnected(DISCONNECT_TIMEOUT);
}

void test_br_wait_disconnected(k_timeout_t timeout)
{
	bool ok = wait_for(is_disconnected, timeout);

	zassert_true(ok, "ACL disconnection timeout");
}

void test_br_security(bt_security_t sec_level)
{
	int err;
	bool ok;

	zassert_not_null(default_conn, "ACL not connected");

	atomic_set(&sec_err, 0);
	if (role == TEST_BR_INITIATOR) {
		err = bt_conn_set_security(default_conn, sec_level);
		zassert_equal(err, 0, "Failed to set security (err %d)", err);
	}

	wait_sec_level = sec_level;
	ok = wait_for(is_secure, K_SECONDS(30));
	zassert_true(ok, "Security timeout");
	zassert_not_null(default_conn, "ACL lost during pairing");
	zassert_equal(atomic_get(&sec_err), 0, "Security failed (err %ld)", atomic_get(&sec_err));
}

void test_br_set_security(bt_security_t sec_level)
{
	required_sec = sec_level;
}

void test_br_setup(enum test_br_role test_role, bt_security_t sec_level)
{
	int err;

	role = test_role;
	required_sec = sec_level;
	pending_valid = false;

	err = bt_enable(NULL);
	zassert_equal(err, 0, "bt_enable failed (err %d)", err);

	err = bt_l2cap_br_echo_cb_register(&echo_cb);
	zassert_true((err == 0) || (err == -EEXIST), "Failed to register echo cb (err %d)", err);

	err = bt_br_set_connectable(true, NULL);
	zassert_equal(err, 0, "Failed to set connectable (err %d)", err);

	err = bt_br_set_discoverable(true, false);
	zassert_equal(err, 0, "Failed to set discoverable (err %d)", err);

	if (role == TEST_BR_INITIATOR) {
		/* The peer is discoverable once its host is up and able to accept connections. */
		bt_br_discovery_cb_register(&discovery_cb);

		discovery_param.length = DISCOVERY_RESULT_COUNT;
		discovery_param.limited = false;
		err = bt_br_discovery_start(&discovery_param, discovery_result,
					    ARRAY_SIZE(discovery_result));
		zassert_equal(err, 0, "Failed to start inquiry (err %d)", err);

		err = k_sem_take(&peer_found_sem, K_MSEC(DISCOVERY_RESULT_COUNT * 1280));
		zassert_equal(err, 0, "Peer not found by inquiry");

		err = bt_br_discovery_stop();
		if ((err != 0) && (err != -EALREADY)) {
			LOG_WRN("Failed to stop inquiry (err %d)", err);
		}

		bt_br_discovery_cb_unregister(&discovery_cb);
	}

	active = true;
}

void test_br_teardown(void)
{
	int err;

	active = false;

	err = bt_disable();
	zassert_ok(err, "bt_disable failed (err %d)", err);
}

static void before_each(const struct ztest_unit_test *test, void *data)
{
	ARG_UNUSED(data);

	if (!active) {
		return;
	}

	LOG_INF("=== %s", test->name);
	current_test = test->name;

	if (role == TEST_BR_INITIATOR) {
		if (default_conn == NULL) {
			test_br_connect();
		}
	} else {
		test_br_wait_connected(K_SECONDS(30));
	}

	if (required_sec > BT_SECURITY_L1) {
		test_br_security(required_sec);
	}
}

static bool release(void)
{
	bool cleanup_ok = true;
	int err;

	if (default_conn != NULL) {
		err = bt_conn_disconnect(default_conn, BT_HCI_ERR_REMOTE_USER_TERM_CONN);
		if (err != 0) {
			LOG_ERR("Failed to disconnect ACL (err %d)", err);
			cleanup_ok = false;
		}

		if (!wait_for(is_disconnected, DISCONNECT_TIMEOUT)) {
			LOG_ERR("ACL disconnection timeout");
			cleanup_ok = false;
		}
	}

	return cleanup_ok;
}

static void after_each(const struct ztest_unit_test *test, void *data)
{
	bool cleanup_ok = true;
	int err;

	ARG_UNUSED(data);

	if (!active) {
		return;
	}

	if (role == TEST_BR_INITIATOR) {
		cleanup_ok = release();

		/* The connection object is reused only after every reference is gone. */
		if (!wait_for(is_released, DISCONNECT_TIMEOUT)) {
			LOG_ERR("ACL connection object of %s not released", test->name);
			cleanup_ok = false;
		}
	} else if (!pending_valid) {
		/* The initiator releases the link; take over if it does not. */
		if (!wait_for(is_disconnected, RELEASE_TIMEOUT)) {
			LOG_WRN("Initiator did not release the ACL link");
			release();
			cleanup_ok = false;
		}
	}

	if ((required_sec > BT_SECURITY_L1) && !pending_valid) {
		err = bt_br_unpair(&peer_addr);
		if ((err != 0) && (err != -ENOENT)) {
			LOG_WRN("Failed to unpair (err %d)", err);
			cleanup_ok = false;
		}
	}

	current_test = NULL;
	zassert_true(cleanup_ok, "ACL cleanup failed after %s", test->name);
}

ZTEST_RULE(test_br_rule, before_each, after_each);
```

## src/test_common.h
```c
/*
 * SPDX-FileCopyrightText: Copyright 2026 NXP
 *
 * SPDX-License-Identifier: Apache-2.0
 */

#ifndef TEST_AVRCP_COMMON_H_
#define TEST_AVRCP_COMMON_H_

#include <stdbool.h>
#include <stdint.h>

#include <zephyr/kernel.h>
#include <zephyr/bluetooth/conn.h>
#include <zephyr/net_buf.h>
#include <zephyr/bluetooth/classic/avrcp.h>
#include <zephyr/ztest.h>

#include "test_br.h"

/*
 * Events reported by the AVRCP callbacks. Both devices register the CT and the TG callbacks, so
 * a connection or a disconnection is reported twice on each device (EVT_CT_* and EVT_TG_*).
 */
enum test_evt {
	EVT_CT_CONNECTED,
	EVT_CT_DISCONNECTED,
	EVT_CT_BROWSING_CONNECTED,
	EVT_CT_BROWSING_DISCONNECTED,
	EVT_TG_CONNECTED,
	EVT_TG_DISCONNECTED,
	EVT_TG_BROWSING_CONNECTED,
	EVT_TG_BROWSING_DISCONNECTED,

	/* Responses received by the CT. */
	EVT_CT_UNIT_INFO,
	EVT_CT_SUBUNIT_INFO,
	EVT_CT_PASSTHROUGH,
	EVT_CT_GET_CAPS,
	EVT_CT_NOTIFICATION,
	EVT_CT_NOTIFY_CHANGED,
	EVT_CT_LIST_ATTRS,
	EVT_CT_LIST_VALS,
	EVT_CT_GET_CURR_VAL,
	EVT_CT_SET_VAL,
	EVT_CT_ATTR_TEXT,
	EVT_CT_VAL_TEXT,
	EVT_CT_DISPLAYABLE_CHAR_SET,
	EVT_CT_BATT_STATUS,
	EVT_CT_ABSOLUTE_VOLUME,
	EVT_CT_ELEMENT_ATTRS,
	EVT_CT_PLAY_STATUS,
	EVT_CT_ADDRESSED_PLAYER,
	EVT_CT_PLAY_ITEM,
	EVT_CT_ADD_TO_NOW_PLAYING,
	EVT_CT_BROWSED_PLAYER,
	EVT_CT_FOLDER_ITEMS,
	EVT_CT_CHANGE_PATH,
	EVT_CT_ITEM_ATTRS,
	EVT_CT_TOTAL_ITEMS,
	EVT_CT_SEARCH,
	EVT_CT_GENERAL_REJECT,

	/* Commands received by the TG. */
	EVT_TG_UNIT_INFO,
	EVT_TG_SUBUNIT_INFO,
	EVT_TG_PASSTHROUGH,
	EVT_TG_GET_CAPS,
	EVT_TG_REGISTER_NOTIFICATION,
	EVT_TG_LIST_ATTRS,
	EVT_TG_LIST_VALS,
	EVT_TG_GET_CURR_VAL,
	EVT_TG_SET_VAL,
	EVT_TG_ATTR_TEXT,
	EVT_TG_VAL_TEXT,
	EVT_TG_DISPLAYABLE_CHAR_SET,
	EVT_TG_BATT_STATUS,
	EVT_TG_ABSOLUTE_VOLUME,
	EVT_TG_ELEMENT_ATTRS,
	EVT_TG_PLAY_STATUS,
	EVT_TG_ADDRESSED_PLAYER,
	EVT_TG_PLAY_ITEM,
	EVT_TG_ADD_TO_NOW_PLAYING,
	EVT_TG_BROWSED_PLAYER,
	EVT_TG_FOLDER_ITEMS,
	EVT_TG_CHANGE_PATH,
	EVT_TG_ITEM_ATTRS,
	EVT_TG_TOTAL_ITEMS,
	EVT_TG_SEARCH,

	EVT_COUNT,
};

/* Largest payload kept by an event: the fragmented GetElementAttributes response (575 bytes). */
#define TEST_EVT_DATA_LEN 640

struct test_event {
	enum test_evt type;
	uint8_t tid;
	/*
	 * Status of a CT response. For the browsing responses that only have a buffer, the first
	 * byte of the buffer.
	 */
	uint8_t status;
	/* Event ID of a notification or of a registration. */
	uint8_t event_id;
	/*
	 * Scalar parameters: unit/subunit type, passthrough result, capability ID, volume, battery
	 * status, scope, player ID, number of items, notification interval or event values.
	 */
	uint32_t value;
	uint32_t value2;
	/* The callback had a buffer or event data (false for a rejected CT response). */
	bool has_data;
	uint16_t len;
	/* Copy of the buffer of the callback, or of the variable event data. */
	uint8_t data[TEST_EVT_DATA_LEN];
};

/* Timeout of one AVRCP step of the peer; the CT of the stack has no response timer. */
#define TEST_AVRCP_TIMEOUT K_SECONDS(10)

/* AVRCP CT and TG objects of the current connection, on both devices. */
extern struct bt_avrcp_ct *test_ct;
extern struct bt_avrcp_tg *test_tg;

/*
 * Callbacks registered by both devices. The stack keeps the pointers to these structures, so a
 * test can clear an optional callback; test_avrcp_before() restores them.
 */
extern struct bt_avrcp_ct_cb test_ct_cb;
extern struct bt_avrcp_tg_cb test_tg_cb;

void test_evt_reset(void);

/*
 * Wait for the oldest unconsumed event of @p type and consume it. Events of other types stay
 * queued. Returns 0, -EAGAIN on timeout or -ENOTCONN if the ACL link is lost.
 */
int test_evt_wait(enum test_evt type, k_timeout_t timeout, struct test_event *evt);

/* Check that no event of @p type arrives within @p timeout. */
void test_evt_none(enum test_evt type, k_timeout_t timeout);

const char *test_evt_str(enum test_evt type);

#define TEST_EXPECT(type, evt)                                                                     \
	do {                                                                                       \
		int _err = test_evt_wait((type), TEST_AVRCP_TIMEOUT, (evt));                       \
                                                                                                   \
		zassert_equal(_err, 0, "No %s event (err %d)", test_evt_str(type), _err);          \
	} while (false)

#define TEST_OK(call)                                                                              \
	do {                                                                                       \
		int _err = (call);                                                                 \
                                                                                                   \
		zassert_equal(_err, 0, "%s returned %d", #call, _err);                             \
	} while (false)

#define TEST_ERR(call, expected)                                                                   \
	do {                                                                                       \
		int _err = (call);                                                                 \
                                                                                                   \
		zassert_equal(_err, (expected), "%s returned %d", #call, _err);                    \
	} while (false)

/* Suite and test fixtures of both roles. */
void test_avrcp_suite_setup(enum test_br_role role);
void test_avrcp_suite_teardown(void);
void test_avrcp_before(void);

/* Restore the callbacks of test_ct_cb and test_tg_cb cleared by a test. */
void test_avrcp_restore_cb(void);

/* Transaction label of the next CT command (0 to 15). */
uint8_t test_next_tid(void);

/*
 * Control channel: connect from this device or wait for the connection, both reported by the CT
 * and the TG callbacks of this device.
 */
void test_avrcp_connect(void);
void test_avrcp_wait_connected(void);

/* Disconnect the control channel (and the browsing channel first, if it is connected). */
void test_avrcp_disconnect(void);
void test_avrcp_wait_disconnected(void);

/* Browsing channel. */
void test_browsing_connect(void);
void test_browsing_wait_connected(void);
void test_browsing_disconnect(void);
void test_browsing_wait_disconnected(void);

/*
 * Run @p body twice on a new AVRCP connection of the CT (device 0): the CT releases the first
 * connection and the TG the second one, as the board-to-board avrcp_ct and avrcp_tg tests do.
 * With @p browsing the browsing channel is connected after the control channel. The CT
 * disconnects it before the control channel; the TG only disconnects the control channel and the
 * stack closes the browsing channel first.
 */
void test_ct_run_twice(void (*body)(void), bool browsing);
void test_tg_run_twice(void (*body)(void), bool browsing);

/*
 * Buffers for commands and responses: vendor dependent PDUs, and the other PDUs (passthrough
 * responses and browsing PDUs).
 */
struct net_buf *test_vendor_buf(void);
struct net_buf *test_pdu_buf(void);

/* Send @p buf with @p call; the caller still owns the buffer if the call fails. */
#define TEST_SEND(call, buf)                                                                       \
	do {                                                                                       \
		int _err = (call);                                                                 \
                                                                                                   \
		if (_err != 0) {                                                                   \
			net_buf_unref(buf);                                                        \
		}                                                                                  \
		zassert_equal(_err, 0, "%s returned %d", #call, _err);                             \
	} while (false)

/* Changed notification callback given to bt_avrcp_ct_register_notification(). */
void test_ct_notify_changed(struct bt_avrcp_ct *ct, uint8_t event_id,
			    struct bt_avrcp_event_data *data);

/*
 * Event data of the notification tests: the TG sends test_event_data() (interim or changed), the
 * CT checks the event with test_check_event_data().
 */
void test_event_data(uint8_t event_id, bool changed, struct bt_avrcp_event_data *data);
void test_check_event_data(const struct test_event *evt, bool changed);

/* Media attribute; the value is padded with zeros to @p len bytes if @p len is larger. */
struct test_media_attr {
	uint32_t id;
	const char *val;
	uint16_t len;
};

/* GetElementAttributes responses: the 7 attributes and the 3 large ones (575 bytes). */
extern const struct test_media_attr test_attrs_std[7];
extern const struct test_media_attr test_attrs_large[3];
/* Attribute of the GetItemAttributes response and of the media element item. */
extern const struct test_media_attr test_attr_item;

/* Add the attribute tuples (ID, character set, length, value) of @p attrs to @p buf. */
void test_add_media_attrs(struct net_buf *buf, const struct test_media_attr *attrs, size_t count);

/* Check @p count attribute tuples at @p data, which must take exactly @p len bytes. */
void test_check_media_attrs(const uint8_t *data, size_t len, const struct test_media_attr *attrs,
			    size_t count);

/* Text of a player application setting attribute and of a value. */
const char *test_attr_text(uint8_t attr_id);
const char *test_val_text(uint8_t val_id);

/* CT: wait for the response @p type to the command with @p tid. */
void test_ct_expect(enum test_evt type, uint8_t tid, struct test_event *evt);

/* CT: wait for a rejected response (no data) with @p status. */
void test_ct_expect_status(enum test_evt type, uint8_t tid, uint8_t status);

/* CT: wait for a browsing response that only contains @p status. */
void test_ct_expect_browsing_status(enum test_evt type, uint8_t tid, uint8_t status);

#endif /* TEST_AVRCP_COMMON_H_ */
```

## src/test_ct_browsing.c
```c
/*
 * SPDX-FileCopyrightText: Copyright 2026 NXP
 *
 * SPDX-License-Identifier: Apache-2.0
 */

/*
 * Browsing tests of the CT (device 0): the board-to-board avrcp_ct and avrcp_tg tests of the
 * browsing commands and of PlayItem and AddToNowPlaying, which run with the browsing channel
 * connected as in the avrcp_tg tests. Each test body runs twice on a new AVRCP connection with a
 * browsing channel, released by the CT and then by the TG.
 */

#include <string.h>

#include <zephyr/kernel.h>
#include <zephyr/bluetooth/conn.h>
#include <zephyr/net_buf.h>
#include <zephyr/bluetooth/classic/avrcp.h>
#include <zephyr/sys/byteorder.h>
#include <zephyr/sys/util.h>
#include <zephyr/ztest.h>

#include "test_br.h"
#include "test_common.h"
#include "test_values.h"

static uint8_t browsed_player_send(uint16_t player_id)
{
	uint8_t tid = test_next_tid();

	TEST_OK(bt_avrcp_ct_set_browsed_player(test_ct, tid, player_id));

	return tid;
}

static void check_browsed_player(uint8_t tid, uint16_t charset, const uint8_t *name,
				 size_t name_len)
{
	const struct bt_avrcp_set_browsed_player_rsp *rsp;
	const struct bt_avrcp_folder_name *folder;
	struct test_event evt;

	test_ct_expect(EVT_CT_BROWSED_PLAYER, tid, &evt);
	zassert_equal(evt.len, sizeof(*rsp) + sizeof(*folder) + name_len, "Length %u", evt.len);
	rsp = (const struct bt_avrcp_set_browsed_player_rsp *)evt.data;
	zassert_equal(rsp->status, BT_AVRCP_STATUS_SUCCESS, "Status 0x%02x", rsp->status);
	zassert_equal(sys_be16_to_cpu(rsp->uid_counter), TEST_BROWSED_UID_COUNTER, "UID counter %u",
		      sys_be16_to_cpu(rsp->uid_counter));
	zassert_equal(sys_be32_to_cpu(rsp->num_items), TEST_TOTAL_ITEMS, "%u items",
		      sys_be32_to_cpu(rsp->num_items));
	zassert_equal(sys_be16_to_cpu(rsp->charset_id), charset, "Charset 0x%04x",
		      sys_be16_to_cpu(rsp->charset_id));
	zassert_equal(rsp->folder_depth, 1U, "Folder depth %u", rsp->folder_depth);

	folder = (const struct bt_avrcp_folder_name *)&evt.data[sizeof(*rsp)];
	zassert_equal(sys_be16_to_cpu(folder->folder_name_len), name_len, "Name length %u",
		      sys_be16_to_cpu(folder->folder_name_len));
	zassert_mem_equal(folder->folder_name, name, name_len, "Unexpected folder name");
}

static void set_browsed_player(void)
{
	static const uint8_t raw_name[] = TEST_BROWSED_FOLDER_RAW;

	check_browsed_player(browsed_player_send(TEST_PLAYER_UTF8), BT_AVRCP_CHARSET_UTF8,
			     (const uint8_t *)TEST_BROWSED_FOLDER, strlen(TEST_BROWSED_FOLDER));
	check_browsed_player(browsed_player_send(TEST_PLAYER_CHARSET), TEST_BROWSED_CHARSET,
			     raw_name, sizeof(raw_name));
	test_ct_expect_browsing_status(EVT_CT_BROWSED_PLAYER,
				       browsed_player_send(TEST_PLAYER_REJECT),
				       BT_AVRCP_STATUS_INVALID_PARAMETER);
}

/* b2b: avrcp_ct set_browsed_player, avrcp_tg set_browsed_player_rsp */
ZTEST(avrcp_ct_browsing, test_001_set_browsed_player)
{
	test_ct_run_twice(set_browsed_player, true);
}

static uint8_t folder_items_send(uint8_t scope, uint32_t end, const uint32_t *attr_ids, uint8_t num)
{
	struct bt_avrcp_get_folder_items_cmd *cmd;
	struct net_buf *buf = test_pdu_buf();
	uint8_t tid = test_next_tid();

	cmd = net_buf_add(buf, sizeof(*cmd));
	cmd->scope = scope;
	cmd->start_item = sys_cpu_to_be32(0U);
	cmd->end_item = sys_cpu_to_be32(end);
	cmd->attr_count = num;
	for (uint8_t i = 0U; i < num; i++) {
		net_buf_add_be32(buf, attr_ids[i]);
	}

	TEST_SEND(bt_avrcp_ct_get_folder_items(test_ct, tid, buf), buf);

	return tid;
}

/* Check the header of a GetFolderItems response and return the offset of the first item. */
static size_t check_folder_items_hdr(const struct test_event *evt, uint16_t num_items)
{
	const struct bt_avrcp_get_folder_items_rsp *rsp;

	zassert_true(evt->len >= sizeof(*rsp), "Length %u", evt->len);
	rsp = (const struct bt_avrcp_get_folder_items_rsp *)evt->data;
	zassert_equal(rsp->status, BT_AVRCP_STATUS_SUCCESS, "Status 0x%02x", rsp->status);
	zassert_equal(sys_be16_to_cpu(rsp->uid_counter), TEST_UID_COUNTER, "UID counter %u",
		      sys_be16_to_cpu(rsp->uid_counter));
	zassert_equal(sys_be16_to_cpu(rsp->num_items), num_items, "%u items",
		      sys_be16_to_cpu(rsp->num_items));

	return sizeof(*rsp);
}

/* Check the item header at @p off; return the offset of the item end. */
static size_t check_item_hdr(const struct test_event *evt, size_t off, uint8_t type,
			     size_t item_len)
{
	zassert_true((off + sizeof(struct bt_avrcp_item_hdr) + item_len) <= evt->len,
		     "Item at %zu truncated", off);
	zassert_equal(evt->data[off], type, "Item type %u", evt->data[off]);
	zassert_equal(sys_get_be16(&evt->data[off + 1U]), item_len, "Item length %u",
		      sys_get_be16(&evt->data[off + 1U]));

	return off + sizeof(struct bt_avrcp_item_hdr) + item_len;
}

static void check_media_player_item(const struct test_event *evt, size_t off)
{
	static const uint8_t no_features[16];
	const struct bt_avrcp_media_player_item *item;
	size_t name_len = strlen(TEST_PLAYER_NAME);
	size_t end;

	end = check_item_hdr(evt, off, BT_AVRCP_ITEM_TYPE_MEDIA_PLAYER,
			     sizeof(*item) - sizeof(struct bt_avrcp_item_hdr) + name_len);
	item = (const struct bt_avrcp_media_player_item *)&evt->data[off];
	zassert_equal(sys_be16_to_cpu(item->player_id), 1U, "Player %u",
		      sys_be16_to_cpu(item->player_id));
	zassert_equal(item->major_type, 1U, "Major type %u", item->major_type);
	zassert_equal(sys_be32_to_cpu(item->player_subtype), 0U, "Subtype %u",
		      sys_be32_to_cpu(item->player_subtype));
	zassert_equal(item->play_status, BT_AVRCP_PLAYBACK_STATUS_STOPPED, "Play status %u",
		      item->play_status);
	zassert_mem_equal(item->feature_bitmask, no_features, sizeof(no_features),
			  "Unexpected features");
	zassert_equal(sys_be16_to_cpu(item->charset_id), BT_AVRCP_CHARSET_UTF8, "Charset 0x%04x",
		      sys_be16_to_cpu(item->charset_id));
	zassert_equal(sys_be16_to_cpu(item->name_len), name_len, "Name length %u",
		      sys_be16_to_cpu(item->name_len));
	zassert_mem_equal(item->name, TEST_PLAYER_NAME, name_len, "Unexpected player name");
	zassert_equal(end, evt->len, "%zu bytes after the item", evt->len - end);
}

/* The folder and the media element item of the extra GetFolderItems response. */
static void check_folder_and_element(const struct test_event *evt, size_t off)
{
	const struct bt_avrcp_folder_item *folder;
	const struct bt_avrcp_media_element_item *element;
	size_t folder_name_len = strlen(TEST_FOLDER_NAME);
	size_t song_name_len = strlen(TEST_SONG_NAME);
	size_t attrs_len = sizeof(struct bt_avrcp_media_attr) + test_attr_item.len;
	size_t element_len;
	size_t end;
	size_t p;

	end = check_item_hdr(evt, off, BT_AVRCP_ITEM_TYPE_FOLDER,
			     sizeof(*folder) - sizeof(struct bt_avrcp_item_hdr) + folder_name_len);
	folder = (const struct bt_avrcp_folder_item *)&evt->data[off];
	zassert_equal(sys_get_be64(folder->uid), TEST_FOLDER_UID, "Folder UID");
	zassert_equal(folder->folder_type, BT_AVRCP_FOLDER_TYPE_TITLES, "Folder type %u",
		      folder->folder_type);
	zassert_equal(folder->playable, 1U, "Playable %u", folder->playable);
	zassert_equal(sys_be16_to_cpu(folder->charset_id), BT_AVRCP_CHARSET_UTF8,
		      "Folder charset 0x%04x", sys_be16_to_cpu(folder->charset_id));
	zassert_equal(sys_be16_to_cpu(folder->name_len), folder_name_len, "Folder name length %u",
		      sys_be16_to_cpu(folder->name_len));
	zassert_mem_equal(folder->name, TEST_FOLDER_NAME, folder_name_len, "Folder name");

	off = end;
	element_len = sizeof(*element) - sizeof(struct bt_avrcp_item_hdr) +
		      sizeof(struct media_element_item_name) + song_name_len + 1U + attrs_len;
	end = check_item_hdr(evt, off, BT_AVRCP_ITEM_TYPE_MEDIA_ELEMENT, element_len);
	element = (const struct bt_avrcp_media_element_item *)&evt->data[off];
	zassert_equal(sys_get_be64(element->uid), TEST_SONG_UID, "Element UID");
	zassert_equal(element->media_type, BT_AVRCP_MEDIA_TYPE_AUDIO, "Media type %u",
		      element->media_type);

	p = off + sizeof(*element);
	zassert_equal(sys_get_be16(&evt->data[p]), BT_AVRCP_CHARSET_UTF8, "Song charset 0x%04x",
		      sys_get_be16(&evt->data[p]));
	zassert_equal(sys_get_be16(&evt->data[p + 2U]), song_name_len, "Song name length %u",
		      sys_get_be16(&evt->data[p + 2U]));
	zassert_mem_equal(&evt->data[p + 4U], TEST_SONG_NAME, song_name_len, "Song name");
	p += sizeof(struct media_element_item_name) + song_name_len;
	zassert_equal(evt->data[p], 1U, "%u song attributes", evt->data[p]);
	test_check_media_attrs(&evt->data[p + 1U], attrs_len, &test_attr_item, 1U);

	zassert_equal(end, evt->len, "%zu bytes after the items", evt->len - end);
}

static void get_folder_items(void)
{
	static const uint32_t ids[] = {BT_AVRCP_MEDIA_ATTR_ID_TITLE};
	struct test_event evt;
	struct net_buf *buf;
	uint8_t tid;

	tid = folder_items_send(BT_AVRCP_SCOPE_VFS, TEST_FOLDER_ITEMS_END, NULL, 0U);
	test_ct_expect(EVT_CT_FOLDER_ITEMS, tid, &evt);
	check_media_player_item(&evt, check_folder_items_hdr(&evt, 1U));

	tid = folder_items_send(BT_AVRCP_SCOPE_VFS, TEST_FOLDER_ITEMS_END, NULL, 0U);
	test_ct_expect_browsing_status(EVT_CT_FOLDER_ITEMS, tid, BT_AVRCP_STATUS_INTERNAL_ERROR);

	/* Extra: a folder and a media element item with one attribute. */
	tid = folder_items_send(BT_AVRCP_SCOPE_NOW_PLAYING, 1U, ids, ARRAY_SIZE(ids));
	test_ct_expect(EVT_CT_FOLDER_ITEMS, tid, &evt);
	check_folder_and_element(&evt, check_folder_items_hdr(&evt, 2U));

	/* An empty command and no buffer are refused by the CT. */
	buf = test_pdu_buf();
	TEST_ERR(bt_avrcp_ct_get_folder_items(test_ct, test_next_tid(), buf), -EINVAL);
	net_buf_unref(buf);
	TEST_ERR(bt_avrcp_ct_get_folder_items(test_ct, test_next_tid(), NULL), -EINVAL);
}

/* b2b: avrcp_ct get_folder_items, avrcp_tg get_folder_items_rsp */
ZTEST(avrcp_ct_browsing, test_002_get_folder_items)
{
	test_ct_run_twice(get_folder_items, true);
}

static uint8_t change_path_send(uint8_t direction, uint64_t uid)
{
	struct bt_avrcp_change_path_cmd *cmd;
	struct net_buf *buf = test_pdu_buf();
	uint8_t tid = test_next_tid();

	cmd = net_buf_add(buf, sizeof(*cmd));
	cmd->uid_counter = sys_cpu_to_be16(TEST_UID_COUNTER);
	cmd->direction = direction;
	sys_put_be64(uid, cmd->folder_uid);

	TEST_SEND(bt_avrcp_ct_change_path(test_ct, tid, buf), buf);

	return tid;
}

static void change_path_cmd(uint8_t direction, uint64_t uid, uint8_t status, uint32_t num_items)
{
	struct test_event evt;
	uint8_t tid = change_path_send(direction, uid);

	test_ct_expect(EVT_CT_CHANGE_PATH, tid, &evt);
	zassert_equal(evt.status, status, "Status 0x%02x", evt.status);
	zassert_equal(evt.value, num_items, "%u items", evt.value);
}

static void change_path(void)
{
	change_path_cmd(BT_AVRCP_CHANGE_PATH_CHILD, TEST_UID_01, BT_AVRCP_STATUS_SUCCESS,
			TEST_CHANGE_PATH_ITEMS);
	change_path_cmd(BT_AVRCP_CHANGE_PATH_CHILD, TEST_UID_01, BT_AVRCP_STATUS_INVALID_PARAMETER,
			0U);
	/* Extra: back to the parent folder. */
	change_path_cmd(BT_AVRCP_CHANGE_PATH_PARENT, 0U, BT_AVRCP_STATUS_SUCCESS,
			TEST_CHANGE_PATH_PARENT_ITEMS);
}

/* b2b: avrcp_ct change_path, avrcp_tg change_path_rsp */
ZTEST(avrcp_ct_browsing, test_003_change_path)
{
	test_ct_run_twice(change_path, true);
}

static uint8_t item_attrs_send(uint8_t scope)
{
	struct bt_avrcp_get_item_attrs_cmd *cmd;
	struct net_buf *buf = test_pdu_buf();
	uint8_t tid = test_next_tid();

	cmd = net_buf_add(buf, sizeof(*cmd));
	cmd->scope = scope;
	sys_put_be64(TEST_UID_01, cmd->uid);
	cmd->uid_counter = sys_cpu_to_be16(TEST_UID_COUNTER);
	cmd->num_attrs = 0U;

	TEST_SEND(bt_avrcp_ct_get_item_attrs(test_ct, tid, buf), buf);

	return tid;
}

static void get_item_attrs(void)
{
	struct test_event evt;
	uint8_t tid;

	tid = item_attrs_send(BT_AVRCP_SCOPE_VFS);
	test_ct_expect(EVT_CT_ITEM_ATTRS, tid, &evt);
	zassert_true(evt.len >= 2U, "Length %u", evt.len);
	zassert_equal(evt.status, BT_AVRCP_STATUS_SUCCESS, "Status 0x%02x", evt.status);
	zassert_equal(evt.data[1], 1U, "%u attributes", evt.data[1]);
	test_check_media_attrs(&evt.data[2], evt.len - 2U, &test_attr_item, 1U);

	tid = item_attrs_send(BT_AVRCP_SCOPE_VFS);
	test_ct_expect_browsing_status(EVT_CT_ITEM_ATTRS, tid, BT_AVRCP_STATUS_INVALID_PARAMETER);

	/* The stack of the CT does not check the scope; the TG rejects it. */
	tid = item_attrs_send(TEST_SCOPE_INVALID);
	test_ct_expect_browsing_status(EVT_CT_ITEM_ATTRS, tid, BT_AVRCP_STATUS_INVALID_SCOPE);
}

/* b2b: avrcp_ct get_item_attrs, avrcp_tg get_item_attributes_rsp */
ZTEST(avrcp_ct_browsing, test_004_get_item_attrs)
{
	test_ct_run_twice(get_item_attrs, true);
}

static uint8_t total_items_send(uint8_t scope)
{
	uint8_t tid = test_next_tid();

	TEST_OK(bt_avrcp_ct_get_total_number_of_items(test_ct, tid, scope));

	return tid;
}

static void get_total_number_of_items(void)
{
	const struct bt_avrcp_get_total_number_of_items_rsp *rsp;
	struct test_event evt;

	for (uint8_t scope = BT_AVRCP_SCOPE_MEDIA_PLAYER_LIST; scope <= BT_AVRCP_SCOPE_NOW_PLAYING;
	     scope++) {
		test_ct_expect(EVT_CT_TOTAL_ITEMS, total_items_send(scope), &evt);
		zassert_equal(evt.len, sizeof(*rsp), "Length %u", evt.len);
		rsp = (const struct bt_avrcp_get_total_number_of_items_rsp *)evt.data;
		zassert_equal(rsp->status, BT_AVRCP_STATUS_SUCCESS, "Status 0x%02x", rsp->status);
		zassert_equal(sys_be16_to_cpu(rsp->uid_counter), TEST_UID_COUNTER, "UID counter %u",
			      sys_be16_to_cpu(rsp->uid_counter));
		zassert_equal(sys_be32_to_cpu(rsp->num_items), TEST_TOTAL_ITEMS, "%u items",
			      sys_be32_to_cpu(rsp->num_items));
	}

	test_ct_expect_browsing_status(EVT_CT_TOTAL_ITEMS, total_items_send(BT_AVRCP_SCOPE_VFS),
				       BT_AVRCP_STATUS_PARAMETER_CONTENT_ERROR);

	TEST_ERR(
		bt_avrcp_ct_get_total_number_of_items(test_ct, test_next_tid(), TEST_SCOPE_INVALID),
		-EINVAL);
	TEST_ERR(bt_avrcp_ct_get_total_number_of_items(test_ct, test_next_tid(), 0xffU), -EINVAL);
}

/* b2b: avrcp_ct get_total_number_of_items, avrcp_tg get_total_num_of_items_rsp */
ZTEST(avrcp_ct_browsing, test_005_get_total_number_of_items)
{
	test_ct_run_twice(get_total_number_of_items, true);
}

static uint8_t search_send(const char *str)
{
	struct net_buf *buf = test_pdu_buf();
	uint8_t tid = test_next_tid();

	net_buf_add_be16(buf, BT_AVRCP_CHARSET_UTF8);
	net_buf_add_be16(buf, strlen(str));
	net_buf_add_mem(buf, str, strlen(str));

	TEST_SEND(bt_avrcp_ct_search(test_ct, tid, buf), buf);

	return tid;
}

static void search(void)
{
	const struct bt_avrcp_search_rsp *rsp;
	struct test_event evt;

	test_ct_expect(EVT_CT_SEARCH, search_send(TEST_SEARCH_STR_1), &evt);
	zassert_equal(evt.len, sizeof(*rsp), "Length %u", evt.len);
	rsp = (const struct bt_avrcp_search_rsp *)evt.data;
	zassert_equal(rsp->status, BT_AVRCP_STATUS_SUCCESS, "Status 0x%02x", rsp->status);
	zassert_equal(sys_be16_to_cpu(rsp->uid_counter), TEST_UID_COUNTER, "UID counter %u",
		      sys_be16_to_cpu(rsp->uid_counter));
	zassert_equal(sys_be32_to_cpu(rsp->num_items), TEST_SEARCH_ITEMS, "%u items",
		      sys_be32_to_cpu(rsp->num_items));

	test_ct_expect_browsing_status(EVT_CT_SEARCH, search_send(TEST_SEARCH_STR_2),
				       BT_AVRCP_STATUS_PARAMETER_CONTENT_ERROR);
}

/* b2b: avrcp_ct search, avrcp_tg search_rsp */
ZTEST(avrcp_ct_browsing, test_006_search)
{
	test_ct_run_twice(search, true);
}

/* PlayItem and AddToNowPlaying have the same command format. */
static void item_cmds(int (*send)(struct bt_avrcp_ct *ct, uint8_t tid, struct net_buf *buf),
		      enum test_evt rsp, const struct test_item_case *cases, size_t count)
{
	for (size_t i = 0; i < count; i++) {
		struct bt_avrcp_play_item_cmd *cmd;
		struct net_buf *buf = test_vendor_buf();
		uint8_t tid = test_next_tid();

		cmd = net_buf_add(buf, sizeof(*cmd));
		cmd->scope = cases[i].scope;
		sys_put_be64(cases[i].uid, cmd->uid);
		cmd->uid_counter = sys_cpu_to_be16(cases[i].uid_counter);

		TEST_SEND(send(test_ct, tid, buf), buf);
		test_ct_expect_status(rsp, tid, cases[i].status);
	}
}

static void play_item(void)
{
	static const struct test_item_case cases[] = {TEST_PLAY_ITEM_CASES};

	item_cmds(bt_avrcp_ct_play_item, EVT_CT_PLAY_ITEM, cases, ARRAY_SIZE(cases));
}

/* b2b: avrcp_ct play_item, avrcp_tg play_item_rsp */
ZTEST(avrcp_ct_browsing, test_007_play_item)
{
	test_ct_run_twice(play_item, false);
	test_ct_run_twice(play_item, true);
}

static void add_to_now_playing(void)
{
	static const struct test_item_case cases[] = {TEST_ADD_TO_NOW_PLAYING_CASES};
	struct net_buf *buf;

	item_cmds(bt_avrcp_ct_add_to_now_playing, EVT_CT_ADD_TO_NOW_PLAYING, cases,
		  ARRAY_SIZE(cases));

	/* No buffer and an empty command are refused by the CT. */
	TEST_ERR(bt_avrcp_ct_add_to_now_playing(test_ct, test_next_tid(), NULL), -EINVAL);
	buf = test_vendor_buf();
	TEST_ERR(bt_avrcp_ct_add_to_now_playing(test_ct, test_next_tid(), buf), -EINVAL);
	net_buf_unref(buf);
}

/* b2b: avrcp_ct add_to_now_playing, avrcp_tg add_to_now_playing_rsp */
ZTEST(avrcp_ct_browsing, test_008_add_to_now_playing)
{
	test_ct_run_twice(add_to_now_playing, false);
	test_ct_run_twice(add_to_now_playing, true);
}

static void expect_reject(uint8_t tid, uint8_t status)
{
	struct test_event evt;

	test_ct_expect(EVT_CT_GENERAL_REJECT, tid, &evt);
	zassert_equal(evt.status, status, "Reject status 0x%02x", evt.status);
}

static void general_reject(void)
{
	expect_reject(browsed_player_send(TEST_PLAYER_UTF8), BT_AVRCP_STATUS_INVALID_COMMAND);
	expect_reject(folder_items_send(BT_AVRCP_SCOPE_VFS, TEST_FOLDER_ITEMS_END, NULL, 0U),
		      BT_AVRCP_STATUS_INVALID_PARAMETER);
	expect_reject(change_path_send(BT_AVRCP_CHANGE_PATH_CHILD, TEST_UID_01),
		      BT_AVRCP_STATUS_INVALID_COMMAND);
	expect_reject(item_attrs_send(BT_AVRCP_SCOPE_VFS), BT_AVRCP_STATUS_INVALID_COMMAND);
	expect_reject(search_send(TEST_SEARCH_STR_1), BT_AVRCP_STATUS_INVALID_COMMAND);
	expect_reject(total_items_send(BT_AVRCP_SCOPE_VFS), BT_AVRCP_STATUS_INVALID_COMMAND);
}

/* b2b: avrcp_tg send_browsing_general_reject */
ZTEST(avrcp_ct_browsing, test_009_general_reject)
{
	test_ct_run_twice(general_reject, true);
}

static void *suite_setup(void)
{
	test_avrcp_suite_setup(TEST_BR_INITIATOR);

	return NULL;
}

static void suite_before(void *f)
{
	ARG_UNUSED(f);

	test_avrcp_before();
}

static void suite_teardown(void *f)
{
	ARG_UNUSED(f);

	test_avrcp_suite_teardown();
}

ZTEST_SUITE(avrcp_ct_browsing, NULL, suite_setup, suite_before, NULL, suite_teardown);
```

## src/test_main.c
```c
/*
 * SPDX-FileCopyrightText: Copyright 2026 NXP
 *
 * SPDX-License-Identifier: Apache-2.0
 */

#include <zephyr/kernel.h>
#include <zephyr/bluetooth/bluetooth.h>
#include <zephyr/logging/log.h>
#include <zephyr/ztest.h>

#include "nsi_host_trampolines.h"
#include "nsi_errno.h"
#include "nsi_main.h"
#include "soc.h"
#include "cmdline.h" /* native_sim command line options header */

#define LOG_MODULE_NAME test_classic_avrcp_sim_main
LOG_MODULE_REGISTER(LOG_MODULE_NAME, CONFIG_TEST_CLASSIC_AVRCP_SIM_LOG_LEVEL);

bt_addr_t peer_addr;

static void cmd_peer_bd_address_found(char *argv, int offset)
{
	char *addr_str = &argv[offset];
	int err;

	err = bt_addr_from_str(addr_str, &peer_addr);
	if (err != 0) {
		LOG_ERR("Failed to parse peer Bluetooth address: %s (err %d)", addr_str, err);
		nsi_exit(err);
	}
}

static void test_avrcp_args(void)
{
	static struct args_struct_t args[] = {
		{
			.is_mandatory = true,
			.option = "peer_bd_address",
			.name = "XX:XX:XX:XX:XX:XX",
			.type = 's',
			.call_when_found = cmd_peer_bd_address_found,
			.descript = "Bluetooth peer device address for AVRCP test",
		},
		ARG_TABLE_ENDMARKER};

	native_add_command_line_opts(args);
}

NATIVE_TASK(test_avrcp_args, PRE_BOOT_1, 20);
```
