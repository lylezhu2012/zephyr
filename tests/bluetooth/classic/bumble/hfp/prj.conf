## CMakeLists.txt
```
# SPDX-FileCopyrightText: Copyright 2026 NXP
#
# SPDX-License-Identifier: Apache-2.0

cmake_minimum_required(VERSION 3.20.0)
set(NO_QEMU_SERIAL_BT_SERVER 1)

find_package(Zephyr REQUIRED HINTS $ENV{ZEPHYR_BASE})
project(bluetooth)

file(GLOB app_sources src/*.c)
target_sources(app PRIVATE ${app_sources})
```

## Kconfig
```
# SPDX-FileCopyrightText: Copyright 2026 NXP
#
# SPDX-License-Identifier: Apache-2.0

source "Kconfig.zephyr"

module = TEST_CLASSIC_HFP_SIM
module-str = test_classic_hfp_sim
source "subsys/logging/Kconfig.template.log_config"

module = TEST_BR
module-str = test_br
source "subsys/logging/Kconfig.template.log_config"
```

## prj.conf
```kconfig
# SPDX-FileCopyrightText: Copyright 2026 NXP
#
# SPDX-License-Identifier: Apache-2.0

CONFIG_BT=y
CONFIG_BT_CLASSIC=y
CONFIG_BT_TESTING=y
CONFIG_LOG=y
CONFIG_ZTEST=y

CONFIG_BT_DEVICE_NAME="test_hfp"

CONFIG_BT_CREATE_CONN_TIMEOUT=30
CONFIG_BT_PAGE_TIMEOUT=0xFFFF

CONFIG_BT_RFCOMM=y
CONFIG_BT_HFP_HF=y
CONFIG_BT_HFP_AG=y

# Feature set of the board-to-board HFP tests
CONFIG_BT_HFP_HF_CLI=y
CONFIG_BT_HFP_HF_VOLUME=y
CONFIG_BT_HFP_HF_CODEC_NEG=y
CONFIG_BT_HFP_HF_CODEC_MSBC=y
CONFIG_BT_HFP_HF_CODEC_LC3_SWB=y
CONFIG_BT_HFP_HF_ECNR=y
CONFIG_BT_HFP_HF_3WAY_CALL=y
CONFIG_BT_HFP_HF_ECS=y
CONFIG_BT_HFP_HF_VOICE_RECG_TEXT=y
CONFIG_BT_HFP_HF_HF_INDICATOR_ENH_SAFETY=y
CONFIG_BT_HFP_HF_HF_INDICATOR_BATTERY=y

CONFIG_BT_HFP_AG_CODEC_NEG=y
CONFIG_BT_HFP_AG_CODEC_MSBC=y
CONFIG_BT_HFP_AG_CODEC_LC3_SWB=y
CONFIG_BT_HFP_AG_ECNR=y
CONFIG_BT_HFP_AG_3WAY_CALL=y
CONFIG_BT_HFP_AG_ECS=y
CONFIG_BT_HFP_AG_VOICE_RECG_TEXT=y
CONFIG_BT_HFP_AG_VOICE_TAG=y
CONFIG_BT_HFP_AG_HF_INDICATOR_ENH_SAFETY=y
CONFIG_BT_HFP_AG_HF_INDICATOR_BATTERY=y
CONFIG_BT_HFP_AG_OUTGOING_TIMEOUT=10
CONFIG_BT_HFP_AG_INCOMING_TIMEOUT=10

# call::test_031_rah_query_then_hold needs the +BTRH sent when the AG holds the incoming call to
# be the first result code after the AT+BTRH? query. The AG holds the call less than 1 second
# after the HF has received RING and +CLIP, so they must not be repeated earlier. This is the
# default value, set explicitly for the test.
CONFIG_BT_HFP_AG_RING_NOTIFY_INTERVAL=3

# The AG queues several unsolicited result codes back to back from the test thread while the HF
# may still send AT commands. With too few buffers, the AG reply to an AT command, allocated in
# the Bluetooth RX work queue, can wait for a buffer that is only released by the AG TX work
# running in the same work queue.
CONFIG_BT_HFP_AG_TX_BUF_COUNT=20

CONFIG_TEST_CLASSIC_HFP_SIM_LOG_LEVEL_DBG=y
```

## src/test_ag.c
```c
/*
 * SPDX-FileCopyrightText: Copyright 2026 NXP
 *
 * SPDX-License-Identifier: Apache-2.0
 */

#include <string.h>

#include <zephyr/kernel.h>
#include <zephyr/bluetooth/bluetooth.h>
#include <zephyr/bluetooth/conn.h>
#include <zephyr/bluetooth/hci.h>
#include <zephyr/bluetooth/classic/sdp.h>
#include <zephyr/bluetooth/classic/hfp_ag.h>
#include <zephyr/logging/log.h>
#include <zephyr/ztest.h>

#include "test_br.h"
#include "test_common.h"
#include "test_ag.h"

LOG_MODULE_REGISTER(test_hfp_ag, CONFIG_TEST_CLASSIC_HFP_SIM_LOG_LEVEL);

struct bt_hfp_ag *ag;
struct bt_conn *ag_sco;
struct ag_config ag_cfg;

static uint32_t phone_number_requests;
static char memory_number[] = TEST_AG_DIAL_NUMBER;
static char voice_tag_number[] = TEST_AG_VOICE_TAG_NUMBER;
static char subscriber_number[] = TEST_AG_SUBSCRIBER_NUMBER;

static uint8_t sco_air_mode(struct bt_conn *sco_conn)
{
	struct bt_conn_info info;

	if (bt_conn_get_info(sco_conn, &info) != 0) {
		return UINT8_MAX;
	}

	return info.sco.air_mode;
}

static void ag_connected_cb(struct bt_conn *conn, struct bt_hfp_ag *hfp_ag)
{
	ag = hfp_ag;
	test_evt_post(EVT_CONNECTED, hfp_ag, 0, 0, NULL);
}

static void ag_disconnected_cb(struct bt_hfp_ag *hfp_ag)
{
	if (ag == hfp_ag) {
		ag = NULL;
	}
	test_evt_post(EVT_DISCONNECTED, hfp_ag, 0, 0, NULL);
}

static void ag_sco_connected_cb(struct bt_hfp_ag *hfp_ag, struct bt_conn *sco_conn)
{
	ag_sco = sco_conn;
	test_evt_post(EVT_SCO_CONNECTED, sco_conn, sco_air_mode(sco_conn), 0, NULL);
}

static void ag_sco_disconnected_cb(struct bt_conn *sco_conn, uint8_t reason)
{
	if (ag_sco == sco_conn) {
		ag_sco = NULL;
	}
	test_evt_post(EVT_SCO_DISCONNECTED, sco_conn, reason, 0, NULL);
}

static int ag_get_indicator_value_cb(struct bt_hfp_ag *hfp_ag, uint8_t *service, uint8_t *strength,
				     uint8_t *roam, uint8_t *battery)
{
	*service = ag_cfg.ind.service;
	*strength = ag_cfg.ind.signal;
	*roam = ag_cfg.ind.roam;
	*battery = ag_cfg.ind.battery;

	return 0;
}

static int ag_get_ongoing_call_cb(struct bt_hfp_ag *hfp_ag)
{
	if (!ag_cfg.ongoing_calls) {
		return -ENOTSUP;
	}

	test_evt_post(EVT_GET_ONGOING_CALL, hfp_ag, 0, 0, NULL);
	return 0;
}

static int ag_memory_dial_cb(struct bt_hfp_ag *hfp_ag, const char *location, char **number)
{
	test_evt_post(EVT_MEMORY_DIAL, hfp_ag, 0, 0, location);

	if (strcmp(location, TEST_AG_MEMORY_LOCATION) != 0) {
		return -ENOTSUP;
	}

	*number = memory_number;
	return 0;
}

static int ag_number_call_cb(struct bt_hfp_ag *hfp_ag, const char *number)
{
	test_evt_post(EVT_NUMBER_CALL, hfp_ag, 0, 0, number);

	return (strcmp(number, TEST_AG_DIAL_NUMBER) == 0) ? 0 : -ENOTSUP;
}

static int ag_redial_cb(struct bt_hfp_ag *hfp_ag,
			char number[CONFIG_BT_HFP_AG_PHONE_NUMBER_MAX_LEN + 1])
{
	test_evt_post(EVT_REDIAL, hfp_ag, 0, 0, NULL);

	if (ag_cfg.last_number[0] == '\0') {
		return -ENOENT;
	}

	strcpy(number, ag_cfg.last_number);
	return 0;
}

static void ag_outgoing_cb(struct bt_hfp_ag *hfp_ag, struct bt_hfp_ag_call *call,
			   const char *number)
{
	test_evt_post(EVT_OUTGOING, call, 0, 0, number);
}

static void ag_incoming_cb(struct bt_hfp_ag *hfp_ag, struct bt_hfp_ag_call *call,
			   const char *number)
{
	test_evt_post(EVT_INCOMING, call, 0, 0, number);
}

static void ag_incoming_held_cb(struct bt_hfp_ag_call *call)
{
	test_evt_post(EVT_INCOMING_HELD, call, 0, 0, NULL);
}

static void ag_ringing_cb(struct bt_hfp_ag_call *call, bool in_band)
{
	test_evt_post(EVT_RINGING, call, in_band, 0, NULL);
}

static void ag_accept_cb(struct bt_hfp_ag_call *call)
{
	test_evt_post(EVT_ACCEPT, call, 0, 0, NULL);
}

static void ag_held_cb(struct bt_hfp_ag_call *call)
{
	test_evt_post(EVT_HELD, call, 0, 0, NULL);
}

static void ag_retrieve_cb(struct bt_hfp_ag_call *call)
{
	test_evt_post(EVT_RETRIEVE, call, 0, 0, NULL);
}

static void ag_reject_cb(struct bt_hfp_ag_call *call)
{
	test_evt_post(EVT_REJECT, call, 0, 0, NULL);
}

static void ag_terminate_cb(struct bt_hfp_ag_call *call)
{
	test_evt_post(EVT_TERMINATE, call, 0, 0, NULL);
}

static void ag_codec_cb(struct bt_hfp_ag *hfp_ag, uint32_t ids)
{
	test_evt_post(EVT_CODEC_IDS, hfp_ag, (int32_t)ids, 0, NULL);
}

static void ag_codec_negotiate_cb(struct bt_hfp_ag *hfp_ag, int err)
{
	test_evt_post(EVT_CODEC_NEGOTIATE, hfp_ag, err, 0, NULL);
}

static void ag_audio_connect_req_cb(struct bt_hfp_ag *hfp_ag)
{
	test_evt_post(EVT_AUDIO_CONNECT_REQ, hfp_ag, 0, 0, NULL);
}

static void ag_vgm_cb(struct bt_hfp_ag *hfp_ag, uint8_t gain)
{
	test_evt_post(EVT_VGM, hfp_ag, gain, 0, NULL);
}

static void ag_vgs_cb(struct bt_hfp_ag *hfp_ag, uint8_t gain)
{
	test_evt_post(EVT_VGS, hfp_ag, gain, 0, NULL);
}

static void ag_ecnr_turn_off_cb(struct bt_hfp_ag *hfp_ag)
{
	test_evt_post(EVT_ECNR_TURN_OFF, hfp_ag, 0, 0, NULL);
}

static void ag_explicit_call_transfer_cb(struct bt_hfp_ag *hfp_ag)
{
	test_evt_post(EVT_EXPLICIT_CALL_TRANSFER, hfp_ag, 0, 0, NULL);
}

static void ag_voice_recognition_cb(struct bt_hfp_ag *hfp_ag, bool activate)
{
	test_evt_post(EVT_VOICE_RECOGNITION, hfp_ag, activate, 0, NULL);
}

static void ag_ready_to_accept_audio_cb(struct bt_hfp_ag *hfp_ag)
{
	test_evt_post(EVT_READY_TO_ACCEPT_AUDIO, hfp_ag, 0, 0, NULL);
}

static int ag_request_phone_number_cb(struct bt_hfp_ag *hfp_ag, char **number)
{
	phone_number_requests++;
	test_evt_post(EVT_REQUEST_PHONE_NUMBER, hfp_ag, (int32_t)phone_number_requests, 0, NULL);

	/* Refuse every odd request, so that both results are seen by the HF. */
	if ((phone_number_requests % 2U) != 0U) {
		return -EINVAL;
	}

	*number = voice_tag_number;
	return 0;
}

static void ag_transmit_dtmf_code_cb(struct bt_hfp_ag *hfp_ag, char code)
{
	test_evt_post(EVT_DTMF_CODE, hfp_ag, code, 0, NULL);
}

static int ag_subscriber_number_cb(struct bt_hfp_ag *hfp_ag, bt_hfp_ag_query_subscriber_func_t func)
{
	test_evt_post(EVT_SUBSCRIBER_NUMBER, hfp_ag, 0, 0, NULL);

	if (ag_cfg.subscriber) {
		(void)func(hfp_ag, subscriber_number, TEST_AG_SUBSCRIBER_TYPE,
			   TEST_AG_SUBSCRIBER_SERVICE);
	}

	return 0;
}

static void ag_hf_indicator_value_cb(struct bt_hfp_ag *hfp_ag, enum hfp_ag_hf_indicators indicator,
				     uint32_t value)
{
	test_evt_post(EVT_HF_INDICATOR_VALUE, hfp_ag, indicator, (int32_t)value, NULL);
}

static struct bt_hfp_ag_cb ag_cb = {
	.connected = ag_connected_cb,
	.disconnected = ag_disconnected_cb,
	.sco_connected = ag_sco_connected_cb,
	.sco_disconnected = ag_sco_disconnected_cb,
	.get_indicator_value = ag_get_indicator_value_cb,
	.get_ongoing_call = ag_get_ongoing_call_cb,
	.memory_dial = ag_memory_dial_cb,
	.number_call = ag_number_call_cb,
	.redial = ag_redial_cb,
	.outgoing = ag_outgoing_cb,
	.incoming = ag_incoming_cb,
	.incoming_held = ag_incoming_held_cb,
	.ringing = ag_ringing_cb,
	.accept = ag_accept_cb,
	.held = ag_held_cb,
	.retrieve = ag_retrieve_cb,
	.reject = ag_reject_cb,
	.terminate = ag_terminate_cb,
	.codec = ag_codec_cb,
	.codec_negotiate = ag_codec_negotiate_cb,
	.audio_connect_req = ag_audio_connect_req_cb,
	.vgm = ag_vgm_cb,
	.vgs = ag_vgs_cb,
	.ecnr_turn_off = ag_ecnr_turn_off_cb,
	.explicit_call_transfer = ag_explicit_call_transfer_cb,
	.voice_recognition = ag_voice_recognition_cb,
	.ready_to_accept_audio = ag_ready_to_accept_audio_cb,
	.request_phone_number = ag_request_phone_number_cb,
	.transmit_dtmf_code = ag_transmit_dtmf_code_cb,
	.subscriber_number = ag_subscriber_number_cb,
	.hf_indicator_value = ag_hf_indicator_value_cb,
};

void ag_suite_setup(void)
{
	int err;

	test_br_setup(TEST_BR_INITIATOR, BT_SECURITY_L1);

	err = bt_hfp_ag_register(&ag_cb);
	zassert_equal(err, 0, "Failed to register AG (err %d)", err);
}

void ag_suite_teardown(void)
{
	test_br_teardown();
}

void ag_test_before(void)
{
	test_evt_reset();

	ag = NULL;
	ag_sco = NULL;
	phone_number_requests = 0;

	memset(&ag_cfg, 0, sizeof(ag_cfg));
	ag_cfg.ind.service = TEST_AG_IND_SERVICE;
	ag_cfg.ind.signal = TEST_AG_IND_SIGNAL;
	ag_cfg.ind.roam = TEST_AG_IND_ROAM;
	ag_cfg.ind.battery = TEST_AG_IND_BATTERY;
}

void ag_test_after(void)
{
	/* The AG objects are released together with the ACL link after the test. */
}

static void ag_slc_settle(void)
{
	/* Let the HF finish the AT commands it sends right after the SLC is established. */
	k_sleep(TEST_SLC_SETTLE_TIME);
}

void ag_slc_connect(void)
{
	struct bt_hfp_ag *new_ag = NULL;
	struct test_event evt;
	uint8_t channel;
	int err;

	channel = test_sdp_get_rfcomm_channel(test_br_conn(), BT_SDP_HANDSFREE_SVCLASS);

	err = bt_hfp_ag_connect(test_br_conn(), &new_ag, channel);
	zassert_equal(err, 0, "Failed to connect AG (err %d)", err);
	zassert_not_null(new_ag, "No AG object");

	TEST_EXPECT(EVT_CONNECTED, TEST_HFP_TIMEOUT, &evt);
	zassert_equal_ptr(evt.obj, new_ag, "Unexpected AG object");

	ag_slc_settle();
}

void ag_slc_wait(void)
{
	TEST_EXPECT(EVT_CONNECTED, TEST_HFP_TIMEOUT, NULL);
	zassert_not_null(ag, "No AG object");

	ag_slc_settle();
}

void ag_slc_disconnect(void)
{
	int err;

	err = bt_hfp_ag_disconnect(ag);
	zassert_equal(err, 0, "Failed to disconnect AG (err %d)", err);

	ag_slc_wait_disconnected();
}

void ag_slc_wait_disconnected(void)
{
	TEST_EXPECT(EVT_DISCONNECTED, TEST_HFP_TIMEOUT, NULL);
	zassert_is_null(ag, "AG object not released");
}

struct bt_hfp_ag_call *ag_wait_call(enum test_evt type)
{
	struct test_event evt;

	TEST_EXPECT(type, TEST_HFP_CALL_TIMEOUT, &evt);
	zassert_not_null(evt.obj, "No call object for %s", test_evt_str(type));

	return evt.obj;
}

void ag_expect_call(enum test_evt type, struct bt_hfp_ag_call *call)
{
	int err;

	/* Events of the same type of other calls (e.g. a first call ringing) are skipped. */
	err = test_evt_wait_obj(type, call, TEST_HFP_CALL_TIMEOUT, NULL);
	zassert_equal(err, 0, "No %s event for the call (err %d)", test_evt_str(type), err);
}

struct bt_hfp_ag_call *ag_incoming(const char *number)
{
	struct test_event evt;
	int err;

	err = bt_hfp_ag_remote_incoming(ag, number);
	zassert_equal(err, 0, "Failed to notify incoming call (err %d)", err);

	TEST_EXPECT(EVT_INCOMING, TEST_HFP_CALL_TIMEOUT, &evt);
	zassert_not_null(evt.obj, "No call object");
	zassert_str_equal(evt.str, number, "Unexpected number %s", evt.str);

	return evt.obj;
}

void ag_wait_sco_connected(uint8_t air_mode)
{
	struct test_event evt;

	TEST_EXPECT(EVT_SCO_CONNECTED, TEST_HFP_CALL_TIMEOUT, &evt);
	/* The HF may already have released the SCO connection, check the reported one. */
	zassert_not_null(evt.obj, "No SCO connection");
	if (air_mode != TEST_AIR_MODE_ANY) {
		zassert_equal(evt.value, air_mode, "Unexpected air mode %d", evt.value);
	}
}

void ag_wait_sco_disconnected(void)
{
	TEST_EXPECT(EVT_SCO_DISCONNECTED, TEST_HFP_CALL_TIMEOUT, NULL);
}

void ag_wait_no_sco(void)
{
	k_timepoint_t end = sys_timepoint_calc(TEST_HFP_CALL_TIMEOUT);

	while ((ag_sco != NULL) && !sys_timepoint_expired(end)) {
		k_sleep(K_MSEC(20));
	}

	zassert_is_null(ag_sco, "SCO connection not released");
}

void ag_sco_disconnect(void)
{
	int err;

	zassert_not_null(ag_sco, "No SCO connection");

	err = bt_conn_disconnect(ag_sco, BT_HCI_ERR_REMOTE_USER_TERM_CONN);
	zassert_equal(err, 0, "Failed to disconnect SCO (err %d)", err);

	ag_wait_sco_disconnected();
}
```

## src/test_ag.h
```c
/*
 * SPDX-FileCopyrightText: Copyright 2026 NXP
 *
 * SPDX-License-Identifier: Apache-2.0
 */

#ifndef TEST_HFP_AG_H_
#define TEST_HFP_AG_H_

#include <stdbool.h>
#include <stdint.h>

#include <zephyr/bluetooth/classic/hfp_ag.h>

#include "test_common.h"

/* SLC of the current test, valid after the AG connected callback. */
extern struct bt_hfp_ag *ag;

/* SCO connection of the current SLC, NULL if there is none. */
extern struct bt_conn *ag_sco;

/* Indicator values returned by the get_indicator_value callback. */
struct ag_indicators {
	uint8_t service;
	uint8_t signal;
	uint8_t roam;
	uint8_t battery;
};

/* Behavior of the AG callbacks, reset before each test. */
struct ag_config {
	struct ag_indicators ind;
	/* Notify the get_ongoing_call callback and wait for bt_hfp_ag_ongoing_calls(). */
	bool ongoing_calls;
	/* Report TEST_AG_SUBSCRIBER_NUMBER from the subscriber_number callback. */
	bool subscriber;
	/* Number returned by the redial callback, empty to fail the request. */
	char last_number[CONFIG_BT_HFP_AG_PHONE_NUMBER_MAX_LEN + 1];
};

extern struct ag_config ag_cfg;

/* Phone number accepted by the number_call callback; others are refused with -ENOTSUP. */
#define TEST_AG_DIAL_NUMBER "123456789"

/* Memory location accepted by the memory_dial callback and the number it maps to. */
#define TEST_AG_MEMORY_LOCATION "0"

#define TEST_AG_SUBSCRIBER_NUMBER  "87654321"
#define TEST_AG_SUBSCRIBER_TYPE    128
#define TEST_AG_SUBSCRIBER_SERVICE 4

/* Number returned by every second request_phone_number callback; the others fail. */
#define TEST_AG_VOICE_TAG_NUMBER "123456789"

void ag_suite_setup(void);
void ag_suite_teardown(void);
void ag_test_before(void);
void ag_test_after(void);

/* Start the SLC from the AG and wait until it is established. */
void ag_slc_connect(void);
/* Wait for the SLC started by the HF. */
void ag_slc_wait(void);
/* Release the SLC from the AG and wait until it is released. */
void ag_slc_disconnect(void);
/* Wait until the SLC is released by the HF. */
void ag_slc_wait_disconnected(void);

/* Wait for a call event and return its call object. */
struct bt_hfp_ag_call *ag_wait_call(enum test_evt type);

/* Wait for a call event of @p call. */
void ag_expect_call(enum test_evt type, struct bt_hfp_ag_call *call);

/* Notify an incoming call and wait until it rings. */
struct bt_hfp_ag_call *ag_incoming(const char *number);

void ag_wait_sco_connected(uint8_t air_mode);
void ag_wait_sco_disconnected(void);
void ag_sco_disconnect(void);
/* Wait until no SCO connection is left, whatever events were reported before. */
void ag_wait_no_sco(void);

#endif /* TEST_HFP_AG_H_ */
```

## src/test_ag_audio.c
```c
/*
 * SPDX-FileCopyrightText: Copyright 2026 NXP
 *
 * SPDX-License-Identifier: Apache-2.0
 */

#include <zephyr/kernel.h>
#include <zephyr/bluetooth/classic/hfp_ag.h>
#include <zephyr/ztest.h>

#include "test_br.h"
#include "test_common.h"
#include "test_ag.h"

static void ag_audio_connect(uint8_t codec)
{
	int err;

	err = bt_hfp_ag_audio_connect(ag, codec);
	zassert_equal(err, 0, "Failed to connect audio with codec %u (err %d)", codec, err);
}

/* Answer the audio connection request of the HF (AT+BCC) with @p codec. */
static void ag_accept_audio_request(uint8_t codec)
{
	TEST_EXPECT(EVT_AUDIO_CONNECT_REQ, TEST_HFP_TIMEOUT, NULL);
	ag_audio_connect(codec);
}

static void ag_expect_codec_negotiated(void)
{
	struct test_event evt;

	TEST_EXPECT(EVT_CODEC_NEGOTIATE, TEST_HFP_TIMEOUT, &evt);
	zassert_equal(evt.value, 0, "Codec negotiation failed (err %d)", evt.value);
}

/* b2b: ACH_001 (AG), ACH_002 (HF) - audio connection set up by the AG. */
ZTEST(hfp_ag_audio, test_001_ach_001_ag)
{
	test_br_sync();
	ag_slc_connect();

	ag_audio_connect(BT_HFP_AG_CODEC_CVSD);
	ag_wait_sco_connected(TEST_AIR_MODE_CVSD);

	test_br_sync();
}

/* b2b: ACH_001 (HF), ACH_002 (AG) - audio connection requested by the HF. */
ZTEST(hfp_ag_audio, test_002_ach_001_hf)
{
	test_br_sync();
	ag_slc_wait();

	ag_accept_audio_request(BT_HFP_AG_CODEC_CVSD);
	ag_wait_sco_connected(TEST_AIR_MODE_CVSD);

	test_br_sync();
}

/* b2b: ACH_003 (AG) - audio connection set up and released by the AG. */
ZTEST(hfp_ag_audio, test_003_ach_003_ag)
{
	test_br_sync();
	ag_slc_connect();

	ag_audio_connect(BT_HFP_AG_CODEC_CVSD);
	ag_wait_sco_connected(TEST_AIR_MODE_CVSD);
	ag_sco_disconnect();

	test_br_sync();
}

/* b2b: ACH_003 (HF) - audio connection requested and released by the HF. */
ZTEST(hfp_ag_audio, test_004_ach_003_hf)
{
	test_br_sync();
	ag_slc_wait();

	ag_accept_audio_request(BT_HFP_AG_CODEC_CVSD);
	ag_wait_sco_connected(TEST_AIR_MODE_CVSD);
	ag_wait_sco_disconnected();

	test_br_sync();
}

/* b2b: ACH_004 (AG) - audio connection set up by the AG, released by the HF. */
ZTEST(hfp_ag_audio, test_005_ach_004_ag)
{
	test_br_sync();
	ag_slc_connect();

	ag_audio_connect(BT_HFP_AG_CODEC_CVSD);
	ag_wait_sco_connected(TEST_AIR_MODE_CVSD);
	ag_wait_sco_disconnected();

	test_br_sync();
}

/* b2b: ACH_004 (HF) - audio connection requested by the HF, released by the AG. */
ZTEST(hfp_ag_audio, test_006_ach_004_hf)
{
	test_br_sync();
	ag_slc_wait();

	ag_accept_audio_request(BT_HFP_AG_CODEC_CVSD);
	ag_wait_sco_connected(TEST_AIR_MODE_CVSD);
	ag_sco_disconnect();

	test_br_sync();
}

/* b2b: ACH_005 (AG) - CVSD selected by the HF application in the codec negotiation. */
ZTEST(hfp_ag_audio, test_007_ach_005_ag)
{
	test_br_sync();
	ag_slc_connect();

	ag_audio_connect(BT_HFP_AG_CODEC_CVSD);
	ag_expect_codec_negotiated();
	ag_wait_sco_connected(TEST_AIR_MODE_CVSD);

	test_br_sync();
}

/*
 * b2b: ACH_005 (HF), CN_001 (HF), WBS_001 (HF), CN_002 (AG) - mSBC audio connection requested
 * by the HF.
 */
ZTEST(hfp_ag_audio, test_008_ach_005_hf)
{
	test_br_sync();
	ag_slc_wait();

	ag_accept_audio_request(BT_HFP_AG_CODEC_MSBC);
	ag_expect_codec_negotiated();
	ag_wait_sco_connected(TEST_AIR_MODE_TRANSPARENT);

	test_br_sync();
}

/*
 * b2b: ACH_006 (HF), CN_002 (HF), CN_001 (AG), WBS_001 (AG) - mSBC audio connection set up by
 * the AG.
 */
ZTEST(hfp_ag_audio, test_009_ach_006_hf)
{
	test_br_sync();
	ag_slc_connect();

	ag_audio_connect(BT_HFP_AG_CODEC_MSBC);
	ag_expect_codec_negotiated();
	ag_wait_sco_connected(TEST_AIR_MODE_TRANSPARENT);

	test_br_sync();
}

/* b2b: ACH_006 (AG) - codec IDs updated by the HF (AT+BAC). */
ZTEST(hfp_ag_audio, test_010_ach_006_ag)
{
	int err;

	test_br_sync();
	ag_slc_connect();

	err = test_evt_wait_value(EVT_CODEC_IDS, BIT(BT_HFP_AG_CODEC_CVSD), TEST_HFP_TIMEOUT, NULL);
	zassert_equal(err, 0, "Codec IDs not updated (err %d)", err);

	test_br_sync();
}

/* b2b: CN_003 (AG) - codec renegotiated by the AG from mSBC to CVSD. */
ZTEST(hfp_ag_audio, test_011_cn_003_ag)
{
	test_br_sync();
	ag_slc_connect();

	ag_audio_connect(BT_HFP_AG_CODEC_MSBC);
	ag_expect_codec_negotiated();
	ag_wait_sco_connected(TEST_AIR_MODE_TRANSPARENT);
	ag_sco_disconnect();

	ag_audio_connect(BT_HFP_AG_CODEC_CVSD);
	ag_expect_codec_negotiated();
	ag_wait_sco_connected(TEST_AIR_MODE_CVSD);

	test_br_sync();
}

/* b2b: CN_003 (HF) - codec renegotiated from mSBC to CVSD on requests of the HF. */
ZTEST(hfp_ag_audio, test_012_cn_003_hf)
{
	test_br_sync();
	ag_slc_wait();

	ag_accept_audio_request(BT_HFP_AG_CODEC_MSBC);
	ag_expect_codec_negotiated();
	ag_wait_sco_connected(TEST_AIR_MODE_TRANSPARENT);
	ag_wait_sco_disconnected();

	ag_accept_audio_request(BT_HFP_AG_CODEC_CVSD);
	ag_expect_codec_negotiated();
	ag_wait_sco_connected(TEST_AIR_MODE_CVSD);

	test_br_sync();
}

/* b2b: CN_004 - the HF application selects an unsupported codec. */
ZTEST(hfp_ag_audio, test_013_cn_004)
{
	test_br_sync();
	ag_slc_connect();

	ag_audio_connect(BT_HFP_AG_CODEC_MSBC);

	/* The HF has refused codec 4 locally; no audio connection is set up. */
	test_br_sync();
	zassert_is_null(ag_sco, "Unexpected SCO connection");
}

/* b2b: SWBS_001 (AG) - LC3-SWB audio connection set up by the AG. */
ZTEST(hfp_ag_audio, test_014_swbs_001_ag)
{
	test_br_sync();
	ag_slc_connect();

	ag_audio_connect(BT_HFP_AG_CODEC_LC3_SWB);
	ag_expect_codec_negotiated();
	ag_wait_sco_connected(TEST_AIR_MODE_TRANSPARENT);

	test_br_sync();
}

/* b2b: SWBS_001 (HF) - LC3-SWB audio connection requested by the HF. */
ZTEST(hfp_ag_audio, test_015_swbs_001_hf)
{
	test_br_sync();
	ag_slc_wait();

	ag_accept_audio_request(BT_HFP_AG_CODEC_LC3_SWB);
	ag_expect_codec_negotiated();
	ag_wait_sco_connected(TEST_AIR_MODE_TRANSPARENT);

	test_br_sync();
}

static void *setup(void)
{
	ag_suite_setup();
	return NULL;
}

static void teardown(void *f)
{
	ag_suite_teardown();
}

static void before(void *f)
{
	ag_test_before();
}

static void after(void *f)
{
	ag_test_after();
}

ZTEST_SUITE(hfp_ag_audio, NULL, setup, before, after, teardown);
```

## src/test_ag_call.c
```c
/*
 * SPDX-FileCopyrightText: Copyright 2026 NXP
 *
 * SPDX-License-Identifier: Apache-2.0
 */

#include <string.h>

#include <zephyr/kernel.h>
#include <zephyr/bluetooth/classic/sdp.h>
#include <zephyr/bluetooth/classic/hfp_ag.h>
#include <zephyr/ztest.h>

#include "test_br.h"
#include "test_common.h"
#include "test_ag.h"

/* Notify an incoming call and wait until it is ringing on the HF. */
static struct bt_hfp_ag_call *ag_ringing_call(const char *number)
{
	struct bt_hfp_ag_call *call = ag_incoming(number);

	ag_expect_call(EVT_RINGING, call);

	/* Act on the call once the HF has seen it ringing (RING and +CLIP). */
	test_br_sync();

	return call;
}

static void ag_call_op(int (*op)(struct bt_hfp_ag_call *call), struct bt_hfp_ag_call *call,
		       const char *name)
{
	int err = op(call);

	zassert_equal(err, 0, "Failed to %s call (err %d)", name, err);
}

/* b2b: PSI_007 (AG) - call status of a call rejected, accepted and terminated by the AG. */
ZTEST(hfp_ag_call, test_001_psi_007_ag)
{
	struct bt_hfp_ag_call *call;

	test_br_sync();
	ag_slc_connect();

	call = ag_ringing_call(TEST_NUMBER_1);
	ag_call_op(bt_hfp_ag_reject, call, "reject");
	ag_expect_call(EVT_REJECT, call);

	call = ag_ringing_call(TEST_NUMBER_1);
	ag_call_op(bt_hfp_ag_accept, call, "accept");
	ag_expect_call(EVT_ACCEPT, call);

	ag_call_op(bt_hfp_ag_terminate, call, "terminate");
	ag_expect_call(EVT_TERMINATE, call);
	ag_wait_no_sco();

	test_br_sync();
}

/* b2b: PSI_007 (HF) - call status of a call rejected, accepted and terminated by the HF. */
ZTEST(hfp_ag_call, test_002_psi_007_hf)
{
	struct bt_hfp_ag_call *call;

	test_br_sync();
	ag_slc_wait();

	call = ag_incoming(TEST_NUMBER_PSI);
	ag_expect_call(EVT_REJECT, call);

	call = ag_incoming(TEST_NUMBER_PSI);
	ag_expect_call(EVT_ACCEPT, call);
	ag_expect_call(EVT_TERMINATE, call);
	ag_wait_no_sco();

	test_br_sync();
}

/* b2b: AIC_001 - incoming call accepted by the HF. */
ZTEST(hfp_ag_call, test_003_aic_001)
{
	struct bt_hfp_ag_call *call;

	test_br_sync();
	ag_slc_wait();

	call = ag_incoming(TEST_NUMBER_1);
	ag_expect_call(EVT_ACCEPT, call);

	test_br_sync();
}

/* b2b: AIC_002 - incoming call accepted by the AG. */
ZTEST(hfp_ag_call, test_004_aic_002)
{
	struct bt_hfp_ag_call *call;

	test_br_sync();
	ag_slc_wait();

	call = ag_ringing_call(TEST_NUMBER_1);
	ag_call_op(bt_hfp_ag_accept, call, "accept");
	ag_expect_call(EVT_ACCEPT, call);

	test_br_sync();
}

/* b2b: RIC_001 - incoming call rejected by the HF. */
ZTEST(hfp_ag_call, test_005_ric_001)
{
	struct bt_hfp_ag_call *call;

	test_br_sync();
	ag_slc_wait();

	call = ag_incoming(TEST_NUMBER_1);
	ag_expect_call(EVT_REJECT, call);

	test_br_sync();
}

/* b2b: RIC_002 - incoming call rejected by the AG. */
ZTEST(hfp_ag_call, test_006_ric_002)
{
	struct bt_hfp_ag_call *call;

	test_br_sync();
	ag_slc_wait();

	call = ag_ringing_call(TEST_NUMBER_1);
	ag_call_op(bt_hfp_ag_reject, call, "reject");
	ag_expect_call(EVT_REJECT, call);

	test_br_sync();
}

/* b2b: TC_001 - call accepted by the AG, terminated by the HF. */
ZTEST(hfp_ag_call, test_007_tc_001)
{
	struct bt_hfp_ag_call *call;

	test_br_sync();
	ag_slc_wait();

	call = ag_ringing_call(TEST_NUMBER_1);
	ag_call_op(bt_hfp_ag_accept, call, "accept");
	ag_expect_call(EVT_ACCEPT, call);
	ag_expect_call(EVT_TERMINATE, call);

	test_br_sync();
}

/* b2b: TC_002 - call accepted and terminated by the AG. */
ZTEST(hfp_ag_call, test_008_tc_002)
{
	struct bt_hfp_ag_call *call;

	test_br_sync();
	ag_slc_wait();

	call = ag_ringing_call(TEST_NUMBER_1);
	ag_call_op(bt_hfp_ag_accept, call, "accept");
	ag_expect_call(EVT_ACCEPT, call);

	ag_call_op(bt_hfp_ag_terminate, call, "terminate");
	ag_expect_call(EVT_TERMINATE, call);

	test_br_sync();
}

/* b2b: ACT_001 - audio connection of an incoming call with in-band ring tone. */
ZTEST(hfp_ag_call, test_009_act_001)
{
	test_br_sync();
	ag_slc_wait();

	(void)ag_incoming(TEST_NUMBER_1);
	ag_wait_sco_connected(TEST_AIR_MODE_ANY);

	test_br_sync();
}

/* b2b: ACT_002 (AG) - audio released by the AG during a call, then the AG terminates. */
ZTEST(hfp_ag_call, test_010_act_002_ag)
{
	struct bt_hfp_ag_call *call;

	test_br_sync();
	ag_slc_wait();

	call = ag_incoming(TEST_NUMBER_1);
	ag_wait_sco_connected(TEST_AIR_MODE_ANY);
	ag_expect_call(EVT_RINGING, call);
	test_br_sync();

	ag_call_op(bt_hfp_ag_accept, call, "accept");
	ag_expect_call(EVT_ACCEPT, call);

	ag_sco_disconnect();

	ag_call_op(bt_hfp_ag_terminate, call, "terminate");
	ag_expect_call(EVT_TERMINATE, call);

	test_br_sync();
}

/* b2b: ACT_002 (HF) - audio released by the HF during a call, then the HF terminates. */
ZTEST(hfp_ag_call, test_011_act_002_hf)
{
	struct bt_hfp_ag_call *call;

	test_br_sync();
	ag_slc_wait();

	call = ag_incoming(TEST_NUMBER_1);
	ag_wait_sco_connected(TEST_AIR_MODE_ANY);
	ag_expect_call(EVT_ACCEPT, call);
	ag_wait_sco_disconnected();
	ag_expect_call(EVT_TERMINATE, call);

	test_br_sync();
}

/* b2b: PCN_001 - phone number call from the HF, refused for an unknown number. */
ZTEST(hfp_ag_call, test_012_pcn_001)
{
	struct test_event evt;

	test_br_sync();
	ag_slc_wait();

	TEST_EXPECT(EVT_NUMBER_CALL, TEST_HFP_TIMEOUT, &evt);
	zassert_str_equal(evt.str, TEST_NUMBER_1, "Unexpected number %s", evt.str);

	TEST_EXPECT(EVT_NUMBER_CALL, TEST_HFP_TIMEOUT, &evt);
	zassert_str_equal(evt.str, TEST_AG_DIAL_NUMBER, "Unexpected number %s", evt.str);

	TEST_EXPECT(EVT_OUTGOING, TEST_HFP_TIMEOUT, &evt);
	zassert_str_equal(evt.str, TEST_AG_DIAL_NUMBER, "Unexpected number %s", evt.str);

	test_br_sync();
}

/* b2b: PMD_001 - memory dialing from the HF, refused for an unknown location. */
ZTEST(hfp_ag_call, test_013_pmd_001)
{
	struct test_event evt;

	test_br_sync();
	ag_slc_wait();

	TEST_EXPECT(EVT_MEMORY_DIAL, TEST_HFP_TIMEOUT, &evt);
	zassert_str_equal(evt.str, "5", "Unexpected location %s", evt.str);

	TEST_EXPECT(EVT_MEMORY_DIAL, TEST_HFP_TIMEOUT, &evt);
	zassert_str_equal(evt.str, TEST_AG_MEMORY_LOCATION, "Unexpected location %s", evt.str);

	TEST_EXPECT(EVT_OUTGOING, TEST_HFP_TIMEOUT, &evt);
	zassert_str_equal(evt.str, TEST_AG_DIAL_NUMBER, "Unexpected number %s", evt.str);

	test_br_sync();
}

/* b2b: PLN_001 - last number redial from the HF. */
ZTEST(hfp_ag_call, test_014_pln_001)
{
	struct test_event evt;

	strcpy(ag_cfg.last_number, TEST_NUMBER_LAST);

	test_br_sync();
	ag_slc_wait();

	TEST_EXPECT(EVT_REDIAL, TEST_HFP_TIMEOUT, NULL);

	TEST_EXPECT(EVT_OUTGOING, TEST_HFP_TIMEOUT, &evt);
	zassert_str_equal(evt.str, TEST_NUMBER_LAST, "Unexpected number %s", evt.str);

	test_br_sync();
}

/* b2b: CLI_001 - calling line identification disabled and enabled by the HF. */
ZTEST(hfp_ag_call, test_015_cli_001)
{
	struct bt_hfp_ag_call *call;

	test_br_sync();
	ag_slc_wait();

	/* The HF has disabled the CLIP notification. */
	test_br_sync();

	call = ag_incoming(TEST_NUMBER_1);
	ag_expect_call(EVT_REJECT, call);

	/* The HF has enabled the CLIP notification. */
	test_br_sync();

	(void)ag_ringing_call(TEST_NUMBER_1);

	test_br_sync();
}

/* b2b: DTMF_001 (AG) - DTMF code sent by the HF during a call accepted by the AG. */
ZTEST(hfp_ag_call, test_016_dtmf_001_ag)
{
	struct bt_hfp_ag_call *call;
	struct test_event evt;

	test_br_sync();
	ag_slc_wait();

	call = ag_ringing_call(TEST_NUMBER_1);
	ag_call_op(bt_hfp_ag_accept, call, "accept");
	ag_expect_call(EVT_ACCEPT, call);

	TEST_EXPECT(EVT_DTMF_CODE, TEST_HFP_TIMEOUT, &evt);
	zassert_equal(evt.value, '3', "Unexpected DTMF code %d", evt.value);

	test_br_sync();
}

/* b2b: DTMF_001 (HF) - DTMF code sent by the HF during a call accepted by the HF. */
ZTEST(hfp_ag_call, test_017_dtmf_001_hf)
{
	struct bt_hfp_ag_call *call;
	struct test_event evt;

	test_br_sync();
	ag_slc_wait();

	call = ag_incoming(TEST_NUMBER_1);
	ag_expect_call(EVT_ACCEPT, call);

	TEST_EXPECT(EVT_DTMF_CODE, TEST_HFP_TIMEOUT, &evt);
	zassert_equal(evt.value, '3', "Unexpected DTMF code %d", evt.value);

	test_br_sync();
}

/* b2b: RAH_001 - incoming call held by the AG, status queried by the HF. */
ZTEST(hfp_ag_call, test_018_rah_001)
{
	struct bt_hfp_ag_call *call;

	test_br_sync();
	ag_slc_wait();

	call = ag_ringing_call(TEST_NUMBER_1);
	ag_call_op(bt_hfp_ag_hold_incoming, call, "hold");
	ag_expect_call(EVT_INCOMING_HELD, call);

	/* The HF queries the response and hold status twice. */
	test_br_sync();
	zassert_not_null(ag, "SLC released");
}

/* b2b: RAH_002 - incoming call held by the HF. */
ZTEST(hfp_ag_call, test_019_rah_002)
{
	struct bt_hfp_ag_call *call;

	test_br_sync();
	ag_slc_wait();

	call = ag_incoming(TEST_NUMBER_1);
	ag_expect_call(EVT_INCOMING_HELD, call);

	test_br_sync();
}

/* b2b: RAH_003 - incoming call held by the AG. */
ZTEST(hfp_ag_call, test_020_rah_003)
{
	struct bt_hfp_ag_call *call;

	test_br_sync();
	ag_slc_wait();

	call = ag_ringing_call(TEST_NUMBER_1);
	ag_call_op(bt_hfp_ag_hold_incoming, call, "hold");
	ag_expect_call(EVT_INCOMING_HELD, call);

	test_br_sync();
}

/* b2b: RAH_004 - incoming call held and then accepted by the HF. */
ZTEST(hfp_ag_call, test_021_rah_004)
{
	struct bt_hfp_ag_call *call;

	test_br_sync();
	ag_slc_wait();

	call = ag_incoming(TEST_NUMBER_1);
	ag_expect_call(EVT_INCOMING_HELD, call);
	ag_expect_call(EVT_ACCEPT, call);

	test_br_sync();
}

/* b2b: RAH_005 - incoming call held and then accepted by the AG. */
ZTEST(hfp_ag_call, test_022_rah_005)
{
	struct bt_hfp_ag_call *call;

	test_br_sync();
	ag_slc_wait();

	call = ag_ringing_call(TEST_NUMBER_1);
	ag_call_op(bt_hfp_ag_hold_incoming, call, "hold");
	ag_expect_call(EVT_INCOMING_HELD, call);

	ag_call_op(bt_hfp_ag_accept, call, "accept");
	ag_expect_call(EVT_ACCEPT, call);

	test_br_sync();
}

/* b2b: RAH_006 - incoming call held and then rejected by the HF. */
ZTEST(hfp_ag_call, test_023_rah_006)
{
	struct bt_hfp_ag_call *call;

	test_br_sync();
	ag_slc_wait();

	call = ag_incoming(TEST_NUMBER_1);
	ag_expect_call(EVT_INCOMING_HELD, call);
	ag_expect_call(EVT_REJECT, call);

	test_br_sync();
}

/* b2b: RAH_007 - incoming call held and then rejected by the AG. */
ZTEST(hfp_ag_call, test_024_rah_007)
{
	struct bt_hfp_ag_call *call;

	test_br_sync();
	ag_slc_wait();

	call = ag_ringing_call(TEST_NUMBER_1);
	ag_call_op(bt_hfp_ag_hold_incoming, call, "hold");
	ag_expect_call(EVT_INCOMING_HELD, call);

	ag_call_op(bt_hfp_ag_reject, call, "reject");
	ag_expect_call(EVT_REJECT, call);

	test_br_sync();
}

/* b2b: RAH_008 - held incoming call terminated by the remote party. */
ZTEST(hfp_ag_call, test_025_rah_008)
{
	struct bt_hfp_ag_call *call;

	test_br_sync();
	ag_slc_wait();

	call = ag_ringing_call(TEST_NUMBER_1);
	ag_call_op(bt_hfp_ag_hold_incoming, call, "hold");
	ag_expect_call(EVT_INCOMING_HELD, call);

	ag_call_op(bt_hfp_ag_remote_terminate, call, "terminate");
	ag_wait_no_sco();

	test_br_sync();
}

/* b2b: ECS_001 (AG) - active call reported by the AG while the SLC is established. */
ZTEST(hfp_ag_call, test_026_ecs_001_ag)
{
	struct bt_hfp_ag_ongoing_call ongoing = {
		.number = TEST_NUMBER_ONGOING,
		.type = 129,
		.dir = BT_HFP_AG_CALL_DIR_OUTGOING,
		.status = BT_HFP_AG_CALL_STATUS_ACTIVE,
	};
	struct bt_hfp_ag *new_ag = NULL;
	struct test_event evt;
	uint8_t channel;
	int err;

	ag_cfg.ongoing_calls = true;

	test_br_sync();

	channel = test_sdp_get_rfcomm_channel(test_br_conn(), BT_SDP_HANDSFREE_SVCLASS);
	err = bt_hfp_ag_connect(test_br_conn(), &new_ag, channel);
	zassert_equal(err, 0, "Failed to connect AG (err %d)", err);

	/* The ongoing calls are requested when the HF reads the indicators. */
	TEST_EXPECT(EVT_GET_ONGOING_CALL, TEST_HFP_TIMEOUT, &evt);
	err = bt_hfp_ag_ongoing_calls(evt.obj, &ongoing, 1);
	zassert_equal(err, 0, "Failed to set ongoing calls (err %d)", err);

	TEST_EXPECT(EVT_CONNECTED, TEST_HFP_TIMEOUT, NULL);
	(void)ag_wait_call(EVT_ACCEPT);

	test_br_sync();
}

/* In-band ring tone disabled by the AG; the audio is set up once the HF accepts. */
ZTEST(hfp_ag_call, test_027_inband_ringtone)
{
	struct bt_hfp_ag_call *call;
	struct test_event evt;
	int err;

	test_br_sync();
	ag_slc_wait();

	err = bt_hfp_ag_inband_ringtone(ag, false);
	zassert_equal(err, 0, "Failed to disable in-band ring tone (err %d)", err);

	call = ag_incoming(TEST_NUMBER_1);
	TEST_EXPECT(EVT_RINGING, TEST_HFP_CALL_TIMEOUT, &evt);
	zassert_equal_ptr(evt.obj, call, "Ringing for another call");
	zassert_equal(evt.value, 0, "In-band ringing");
	zassert_is_null(ag_sco, "SCO connection while ringing");

	ag_expect_call(EVT_ACCEPT, call);
	ag_wait_sco_connected(TEST_AIR_MODE_ANY);

	test_br_sync();
}

/* Outgoing call of the AG, alerting and accepted by the remote party, then terminated by it. */
ZTEST(hfp_ag_call, test_028_ag_outgoing)
{
	struct bt_hfp_ag_call *call;
	int err;

	test_br_sync();
	ag_slc_wait();

	err = bt_hfp_ag_outgoing(ag, TEST_NUMBER_2);
	zassert_equal(err, 0, "Failed to dial (err %d)", err);
	call = ag_wait_call(EVT_OUTGOING);

	ag_call_op(bt_hfp_ag_remote_ringing, call, "ring");
	ag_expect_call(EVT_RINGING, call);
	ag_call_op(bt_hfp_ag_remote_accept, call, "accept");
	ag_expect_call(EVT_ACCEPT, call);

	ag_call_op(bt_hfp_ag_remote_terminate, call, "terminate");
	ag_expect_call(EVT_TERMINATE, call);

	test_br_sync();
}

/* Outgoing call of the AG rejected by the remote party. */
ZTEST(hfp_ag_call, test_029_ag_outgoing_rejected)
{
	struct bt_hfp_ag_call *call;
	int err;

	test_br_sync();
	ag_slc_wait();

	err = bt_hfp_ag_outgoing(ag, TEST_NUMBER_2);
	zassert_equal(err, 0, "Failed to dial (err %d)", err);
	call = ag_wait_call(EVT_OUTGOING);

	ag_call_op(bt_hfp_ag_remote_ringing, call, "ring");
	ag_expect_call(EVT_RINGING, call);
	ag_call_op(bt_hfp_ag_remote_reject, call, "reject");
	ag_expect_call(EVT_REJECT, call);

	test_br_sync();
}

/* Response and hold status queried by the HF without a held call, then an indicator update. */
ZTEST(hfp_ag_call, test_030_rah_query_no_held_call)
{
	int err;

	test_br_sync();
	ag_slc_wait();

	/* The HF has queried the response and hold status. */
	test_br_sync();

	err = bt_hfp_ag_battery_level(ag, 1);
	zassert_equal(err, 0, "Failed to set battery level (err %d)", err);

	test_br_sync();
	zassert_not_null(ag, "SLC released");
}

/* Incoming call held by the AG right after a response and hold status query of the HF. */
ZTEST(hfp_ag_call, test_031_rah_query_then_hold)
{
	struct bt_hfp_ag_call *call;

	test_br_sync();
	ag_slc_wait();

	call = ag_ringing_call(TEST_NUMBER_1);

	/* The HF has queried the response and hold status. */
	test_br_sync();

	ag_call_op(bt_hfp_ag_hold_incoming, call, "hold");
	ag_expect_call(EVT_INCOMING_HELD, call);

	test_br_sync();
}

/*
 * Incoming call rejected twice by the AG. The second request is made before the callsetup
 * indicator of the first one is sent; the call is reported rejected once.
 */
ZTEST(hfp_ag_call, test_032_ag_reject_twice)
{
	struct bt_hfp_ag_call *call;

	test_br_sync();
	ag_slc_wait();

	call = ag_ringing_call(TEST_NUMBER_1);
	ag_call_op(bt_hfp_ag_reject, call, "reject");
	/*
	 * The callsetup indicator is cleared already: the second request rejects the call at once
	 * and returns an error. Its result is not checked.
	 */
	(void)bt_hfp_ag_reject(call);

	ag_expect_call(EVT_REJECT, call);
	test_evt_none(EVT_REJECT, TEST_AT_DELIVERY_TIME);

	test_br_sync();
}

/* Call terminated by the HF (AT+CHUP), the current calls queried by the HF right after it. */
ZTEST(hfp_ag_call, test_033_terminate_then_query)
{
	struct bt_hfp_ag_call *call;

	test_br_sync();
	ag_slc_wait();

	call = ag_ringing_call(TEST_NUMBER_1);
	ag_call_op(bt_hfp_ag_accept, call, "accept");
	ag_expect_call(EVT_ACCEPT, call);
	ag_expect_call(EVT_TERMINATE, call);

	/* The HF has seen the call terminated once. */
	test_br_sync();
}

/*
 * Incoming call held, then rejected by the HF (AT+BTRH=2), the current calls queried by the HF
 * right after it.
 */
ZTEST(hfp_ag_call, test_034_rah_reject_then_query)
{
	struct bt_hfp_ag_call *call;

	test_br_sync();
	ag_slc_wait();

	call = ag_incoming(TEST_NUMBER_1);
	ag_expect_call(EVT_INCOMING_HELD, call);
	ag_expect_call(EVT_REJECT, call);

	/* The HF has seen the call rejected once. */
	test_br_sync();
}

static void *setup(void)
{
	ag_suite_setup();
	return NULL;
}

static void teardown(void *f)
{
	ag_suite_teardown();
}

static void before(void *f)
{
	ag_test_before();
}

static void after(void *f)
{
	ag_test_after();
}

ZTEST_SUITE(hfp_ag_call, NULL, setup, before, after, teardown);
```

## src/test_ag_multicall.c
```c
/*
 * SPDX-FileCopyrightText: Copyright 2026 NXP
 *
 * SPDX-License-Identifier: Apache-2.0
 */

#include <zephyr/kernel.h>
#include <zephyr/bluetooth/classic/hfp_ag.h>
#include <zephyr/ztest.h>

#include "test_br.h"
#include "test_common.h"
#include "test_ag.h"

static void ag_call_op(int (*op)(struct bt_hfp_ag_call *call), struct bt_hfp_ag_call *call,
		       const char *name)
{
	int err = op(call);

	zassert_equal(err, 0, "Failed to %s call (err %d)", name, err);
}

/* First call, accepted by the HF. */
static struct bt_hfp_ag_call *ag_active_call(void)
{
	struct bt_hfp_ag_call *call = ag_incoming(TEST_NUMBER_1);

	ag_expect_call(EVT_ACCEPT, call);

	return call;
}

/* First call, accepted and held by the AG. */
static struct bt_hfp_ag_call *ag_held_call(void)
{
	struct bt_hfp_ag_call *call = ag_incoming(TEST_NUMBER_1);

	ag_expect_call(EVT_RINGING, call);

	/* The HF has seen the call ringing. */
	test_br_sync();

	ag_call_op(bt_hfp_ag_accept, call, "accept");
	ag_expect_call(EVT_ACCEPT, call);

	ag_call_op(bt_hfp_ag_hold, call, "hold");
	ag_expect_call(EVT_HELD, call);

	return call;
}

/* b2b: CWN_001 - call waiting notification enabled by the HF. */
ZTEST(hfp_ag_multicall, test_001_cwn_001)
{
	test_br_sync();
	ag_slc_wait();

	/* The HF has enabled the call waiting notification. */
	test_br_sync();

	(void)ag_active_call();
	(void)ag_incoming(TEST_NUMBER_WAITING);

	test_br_sync();
}

/* b2b: 3WC_001 - active call held and waiting call accepted by the HF (AT+CHLD=2). */
ZTEST(hfp_ag_multicall, test_002_3wc_001)
{
	struct bt_hfp_ag_call *call1;
	struct bt_hfp_ag_call *call2;

	test_br_sync();
	ag_slc_wait();

	call1 = ag_active_call();
	call2 = ag_incoming(TEST_NUMBER_WAITING);

	ag_expect_call(EVT_HELD, call1);
	ag_expect_call(EVT_ACCEPT, call2);

	test_br_sync();
}

/* b2b: 3WC_002 - call held by the HF, then a second outgoing call of the AG. */
ZTEST(hfp_ag_multicall, test_003_3wc_002)
{
	struct bt_hfp_ag_call *call1;
	struct bt_hfp_ag_call *call2;
	int err;

	test_br_sync();
	ag_slc_wait();

	call1 = ag_active_call();
	ag_expect_call(EVT_HELD, call1);

	err = bt_hfp_ag_outgoing(ag, TEST_NUMBER_WAITING);
	zassert_equal(err, 0, "Failed to dial (err %d)", err);
	call2 = ag_wait_call(EVT_OUTGOING);

	ag_call_op(bt_hfp_ag_remote_ringing, call2, "ring");
	ag_expect_call(EVT_RINGING, call2);
	ag_call_op(bt_hfp_ag_remote_accept, call2, "accept");
	ag_expect_call(EVT_ACCEPT, call2);

	test_br_sync();
}

/* b2b: 3WC_003 - calls joined and transferred by the HF (AT+CHLD=3, AT+CHLD=4). */
ZTEST(hfp_ag_multicall, test_004_3wc_003)
{
	struct bt_hfp_ag_call *call1;
	struct bt_hfp_ag_call *call2;

	test_br_sync();
	ag_slc_wait();

	call1 = ag_active_call();
	call2 = ag_incoming(TEST_NUMBER_WAITING);

	ag_expect_call(EVT_HELD, call1);
	ag_expect_call(EVT_ACCEPT, call2);

	/* The HF joins the calls into a conversation. */
	test_br_sync();

	TEST_EXPECT(EVT_EXPLICIT_CALL_TRANSFER, TEST_HFP_TIMEOUT, NULL);
	ag_wait_no_sco();

	test_br_sync();
}

/* b2b: ECS_001 (HF) - list of current calls queried by the HF. */
ZTEST(hfp_ag_multicall, test_005_ecs_001_hf)
{
	struct bt_hfp_ag_call *call;

	test_br_sync();
	ag_slc_wait();

	call = ag_incoming(TEST_NUMBER_1);
	ag_expect_call(EVT_RINGING, call);
	test_br_sync();

	ag_call_op(bt_hfp_ag_accept, call, "accept");
	ag_expect_call(EVT_ACCEPT, call);

	(void)ag_incoming(TEST_NUMBER_2);

	/* The HF queries the list of current calls. */
	test_br_sync();
	test_br_sync();
}

/* b2b: ECS_002 - held and waiting calls released by index (AT+CHLD=1<idx>). */
ZTEST(hfp_ag_multicall, test_006_ecs_002)
{
	struct bt_hfp_ag_call *call1;
	struct bt_hfp_ag_call *call2;

	test_br_sync();
	ag_slc_wait();

	call1 = ag_held_call();
	call2 = ag_incoming(TEST_NUMBER_2);

	/* The HF has seen the waiting call. */
	test_br_sync();

	ag_expect_call(EVT_TERMINATE, call1);
	ag_expect_call(EVT_REJECT, call2);

	test_br_sync();
}

/* Held call released by the HF (AT+CHLD=0). */
ZTEST(hfp_ag_multicall, test_007_release_all_held)
{
	struct bt_hfp_ag_call *call;

	test_br_sync();
	ag_slc_wait();

	call = ag_held_call();

	/* The HF has seen the held call. */
	test_br_sync();

	ag_expect_call(EVT_TERMINATE, call);

	test_br_sync();
}

/* Waiting call rejected by the HF with User Determined User Busy (AT+CHLD=0). */
ZTEST(hfp_ag_multicall, test_008_udub)
{
	struct bt_hfp_ag_call *call2;

	test_br_sync();
	ag_slc_wait();

	(void)ag_active_call();
	call2 = ag_incoming(TEST_NUMBER_2);

	ag_expect_call(EVT_REJECT, call2);
	test_evt_none(EVT_TERMINATE, TEST_AT_DELIVERY_TIME);

	test_br_sync();
}

/* Active call released and waiting call accepted by the HF (AT+CHLD=1). */
ZTEST(hfp_ag_multicall, test_009_release_active_accept_other)
{
	struct bt_hfp_ag_call *call1;
	struct bt_hfp_ag_call *call2;

	test_br_sync();
	ag_slc_wait();

	call1 = ag_active_call();
	call2 = ag_incoming(TEST_NUMBER_2);

	ag_expect_call(EVT_TERMINATE, call1);
	ag_expect_call(EVT_ACCEPT, call2);

	test_br_sync();
}

/* Call held and retrieved by the AG. */
ZTEST(hfp_ag_multicall, test_010_ag_hold_retrieve)
{
	struct bt_hfp_ag_call *call;

	test_br_sync();
	ag_slc_wait();

	call = ag_held_call();

	ag_call_op(bt_hfp_ag_retrieve, call, "retrieve");
	ag_expect_call(EVT_RETRIEVE, call);

	test_br_sync();
}

/* Explicit call transfer by the AG, after the held call is retrieved into the conversation. */
ZTEST(hfp_ag_multicall, test_011_ag_explicit_call_transfer)
{
	struct bt_hfp_ag_call *call1;
	struct bt_hfp_ag_call *call2;
	int err;

	test_br_sync();
	ag_slc_wait();

	call1 = ag_held_call();

	/* A second incoming call is accepted while the first one is held. */
	call2 = ag_incoming(TEST_NUMBER_2);
	ag_call_op(bt_hfp_ag_accept, call2, "accept");
	ag_expect_call(EVT_ACCEPT, call2);

	/* The AG transfers the calls only when all of them are active. */
	ag_call_op(bt_hfp_ag_retrieve, call1, "retrieve");
	ag_expect_call(EVT_RETRIEVE, call1);

	/* The HF has seen both calls active. */
	test_br_sync();

	err = bt_hfp_ag_explicit_call_transfer(ag);
	zassert_equal(err, 0, "Failed to transfer calls (err %d)", err);
	TEST_EXPECT(EVT_EXPLICIT_CALL_TRANSFER, TEST_HFP_TIMEOUT, NULL);
	ag_wait_no_sco();

	test_br_sync();
}

/* UDUB (AT+CHLD=0) with a held and a waiting call: only the waiting call is released. */
ZTEST(hfp_ag_multicall, test_012_udub_with_held_call)
{
	struct bt_hfp_ag_call *call1;
	struct bt_hfp_ag_call *call2;

	test_br_sync();
	ag_slc_wait();

	call1 = ag_held_call();
	call2 = ag_incoming(TEST_NUMBER_2);

	ag_expect_call(EVT_REJECT, call2);
	test_evt_none(EVT_TERMINATE, TEST_AT_DELIVERY_TIME);

	/* The HF has seen the waiting call rejected. */
	test_br_sync();

	/* The held call still exists. */
	ag_call_op(bt_hfp_ag_retrieve, call1, "retrieve");
	ag_expect_call(EVT_RETRIEVE, call1);

	test_br_sync();
}

/* A waiting call after UDUB of a previous waiting call, with an active call. */
ZTEST(hfp_ag_multicall, test_013_udub_then_waiting)
{
	struct bt_hfp_ag_call *call2;

	test_br_sync();
	ag_slc_wait();

	(void)ag_active_call();
	call2 = ag_incoming(TEST_NUMBER_2);
	ag_expect_call(EVT_REJECT, call2);

	/* The HF has seen the waiting call rejected. */
	test_br_sync();

	(void)ag_incoming(TEST_NUMBER_WAITING);

	/* The HF has seen the second waiting call. */
	test_br_sync();
}

/*
 * UDUB of a waiting call, with an active call, and a second waiting call started as soon as the
 * AG reports the first one rejected.
 */
ZTEST(hfp_ag_multicall, test_014_udub_then_waiting_at_once)
{
	struct bt_hfp_ag_call *call2;

	test_br_sync();
	ag_slc_wait();

	(void)ag_active_call();
	call2 = ag_incoming(TEST_NUMBER_2);
	ag_expect_call(EVT_REJECT, call2);

	/* No sync with the HF in between. */
	(void)ag_incoming(TEST_NUMBER_WAITING);

	/* The HF has seen the second waiting call. */
	test_br_sync();
}

/* A waiting call released by index (AT+CHLD=1<idx>) with an active call, then a second one. */
ZTEST(hfp_ag_multicall, test_015_release_waiting_by_index)
{
	struct bt_hfp_ag_call *call2;

	test_br_sync();
	ag_slc_wait();

	(void)ag_active_call();
	call2 = ag_incoming(TEST_NUMBER_2);
	ag_expect_call(EVT_REJECT, call2);

	/* The HF has seen the waiting call released. */
	test_br_sync();

	(void)ag_incoming(TEST_NUMBER_WAITING);

	/* The HF has seen the second waiting call. */
	test_br_sync();
}

/* UDUB of a waiting call, with an active call, and the current calls queried right after it. */
ZTEST(hfp_ag_multicall, test_016_udub_then_query)
{
	struct bt_hfp_ag_call *call2;

	test_br_sync();
	ag_slc_wait();

	(void)ag_active_call();
	call2 = ag_incoming(TEST_NUMBER_2);
	ag_expect_call(EVT_REJECT, call2);

	/* The HF has seen the waiting call rejected once. */
	test_br_sync();
}

/*
 * Waiting call rejected by the AG, with an active call, then a second waiting call. The HF has
 * no AT command pending: it learns the end of the waiting call from +CIEV (callsetup 0) and its
 * own AT+CLCC.
 */
ZTEST(hfp_ag_multicall, test_017_ag_reject_waiting)
{
	struct bt_hfp_ag_call *call2;

	test_br_sync();
	ag_slc_wait();

	(void)ag_active_call();
	call2 = ag_incoming(TEST_NUMBER_2);

	/* The HF has seen the waiting call. */
	test_br_sync();

	ag_call_op(bt_hfp_ag_reject, call2, "reject");
	ag_expect_call(EVT_REJECT, call2);

	/* The HF has seen the waiting call rejected. */
	test_br_sync();

	(void)ag_incoming(TEST_NUMBER_WAITING);

	/* The HF has seen the second waiting call. */
	test_br_sync();
}

static void *setup(void)
{
	ag_suite_setup();
	return NULL;
}

static void teardown(void *f)
{
	ag_suite_teardown();
}

static void before(void *f)
{
	ag_test_before();
}

static void after(void *f)
{
	ag_test_after();
}

ZTEST_SUITE(hfp_ag_multicall, NULL, setup, before, after, teardown);
```
