## Kconfig
```
# SPDX-FileCopyrightText: Copyright 2026 NXP
#
# SPDX-License-Identifier: Apache-2.0

source "Kconfig.zephyr"

config TEST_RFCOMM_CHANNEL_A
	int "First RFCOMM server channel registered by the server role"
	default 10
	range 6 30
	help
	  RFCOMM server channel registered by the server role and used by the
	  client role for the primary DLC. Both roles are built from the same
	  image, so the value is known to both without an SDP query.

config TEST_RFCOMM_CHANNEL_B
	int "Second RFCOMM server channel registered by the server role"
	default 11
	range 6 30
	help
	  RFCOMM server channel used for the second DLC of the multiple DLC
	  scenario.

config TEST_RFCOMM_CHANNEL_CLIENT
	int "RFCOMM server channel registered by the client role"
	default 12
	range 6 30
	help
	  RFCOMM server channel registered by the client role. The server role
	  connects a DLC to it over the RFCOMM session that the client created.

config TEST_RFCOMM_CHANNEL_UNREGISTERED
	int "RFCOMM server channel that is never registered"
	default 20
	range 6 30
	help
	  RFCOMM server channel that no role registers. A DLC connection to it
	  is expected to fail.

config TEST_RFCOMM_TX_POOL_COUNT
	int "Number of RFCOMM TX buffers"
	default 20
	range 1 255
	help
	  Number of buffers in the RFCOMM TX data pool of each role.

config TEST_RFCOMM_FRAME_COUNT
	int "Number of frames sent per direction in the MTU and credit scenario"
	default 16
	range 1 255
	help
	  Number of UIH frames sent in each direction in the MTU and credit
	  scenario. It should exceed the initial credit count so that credits
	  have to be replenished during the transfer.

module = TEST_CLASSIC_RFCOMM_SIM
module-str = test_classic_rfcomm_sim
source "subsys/logging/Kconfig.template.log_config"

module = TEST_BR
module-str = test_br
source "subsys/logging/Kconfig.template.log_config"
```

## prj.conf
```kconfig
# SPDX-FileCopyrightText: Copyright 2026 NXP
#
# SPDX-License-Identifier: Apache-2.0

CONFIG_BT=y
CONFIG_BT_CLASSIC=y
CONFIG_BT_TESTING=y
CONFIG_BT_RFCOMM=y
CONFIG_LOG=y
CONFIG_ZTEST=y

CONFIG_BT_DEVICE_NAME="test_rfcomm"

CONFIG_BT_CREATE_CONN_TIMEOUT=30
CONFIG_BT_PAGE_TIMEOUT=0xFFFF

# More ACL RX buffers allow the RFCOMM stack to grant more than one RX credit per DLC.
CONFIG_BT_BUF_ACL_RX_COUNT_EXTRA=8

CONFIG_TEST_CLASSIC_RFCOMM_SIM_LOG_LEVEL_DBG=y
```

## src/test_client.c
```c
/*
 * SPDX-FileCopyrightText: Copyright 2026 NXP
 *
 * SPDX-License-Identifier: Apache-2.0
 */

#include <zephyr/kernel.h>
#include <zephyr/sys/byteorder.h>
#include <zephyr/bluetooth/bluetooth.h>
#include <zephyr/bluetooth/conn.h>
#include <zephyr/bluetooth/classic/rfcomm.h>
#include <zephyr/logging/log.h>
#include <zephyr/ztest.h>

#include "test_br.h"
#include "test_common.h"

LOG_MODULE_REGISTER(test_rfcomm_client, CONFIG_TEST_CLASSIC_RFCOMM_SIM_LOG_LEVEL);

static struct test_dlc dlc_a;
static struct test_dlc dlc_b;
static struct test_dlc dlc_extra;
static struct test_dlc dlc_rev;

static atomic_t client_accept_count;
static bool client_server_registered;

static int client_accept(struct bt_conn *conn, struct bt_rfcomm_server *server,
			 struct bt_rfcomm_dlc **dlc)
{
	LOG_DBG("Incoming DLC on channel %u (conn %p)", server->channel, (void *)conn);

	if (atomic_inc(&client_accept_count) != 0) {
		LOG_ERR("Channel %u already accepted a DLC", server->channel);
		return -ENOMEM;
	}

	*dlc = &dlc_rev.dlc;
	return 0;
}

static struct bt_rfcomm_server client_server = {
	.channel = TEST_CHANNEL_CLIENT,
	.accept = client_accept,
};

static void dlc_connect(struct test_dlc *td, uint8_t channel)
{
	int err;

	err = bt_rfcomm_dlc_connect(test_br_conn(), &td->dlc, channel);
	zassert_equal(err, 0, "Failed to connect DLC to channel %u (err %d)", channel, err);
	test_dlc_wait_connected(td);
}

static void dlc_disconnect(struct test_dlc *td)
{
	int err;

	err = bt_rfcomm_dlc_disconnect(&td->dlc);
	zassert_equal(err, 0, "Failed to disconnect DLC (err %d)", err);
	test_dlc_wait_disconnected(td);
}

static void test_connect_api(void)
{
	int err;

	err = bt_rfcomm_dlc_connect(test_br_conn(), NULL, TEST_CHANNEL_A);
	zassert_equal(err, -EINVAL, "Connect with NULL DLC returned %d", err);

	err = bt_rfcomm_dlc_connect(test_br_conn(), &dlc_extra.dlc, 0);
	zassert_equal(err, -EINVAL, "Connect to channel 0 returned %d", err);

	err = bt_rfcomm_dlc_connect(test_br_conn(), &dlc_extra.dlc, 31);
	zassert_equal(err, -EINVAL, "Connect to channel 31 returned %d", err);

	dlc_extra.dlc.mtu = 0;
	err = bt_rfcomm_dlc_connect(test_br_conn(), &dlc_extra.dlc, TEST_CHANNEL_A);
	zassert_equal(err, -EINVAL, "Connect with MTU 0 returned %d", err);
	dlc_extra.dlc.mtu = TEST_MTU;
}

ZTEST(rfcomm_client, test_001_basic)
{
	int err;

	err = bt_rfcomm_dlc_connect(NULL, &dlc_a.dlc, TEST_CHANNEL_A);
	zassert_equal(err, -ENOTCONN, "Connect without ACL returned %d", err);

	test_br_sync();
	test_connect_api();

	err = test_dlc_try_send(&dlc_a, TEST_BASIC_C2S_LEN, TEST_BASIC_C2S_SEED);
	zassert_equal(err, -ENOTCONN, "Send on unconnected DLC returned %d", err);

	dlc_connect(&dlc_a, TEST_CHANNEL_A);

	test_dlc_send_pattern(&dlc_a, TEST_BASIC_C2S_LEN, TEST_BASIC_C2S_SEED);
	test_dlc_wait_sent(&dlc_a, 1);
	test_dlc_expect_pattern(&dlc_a, TEST_BASIC_S2C_LEN, TEST_BASIC_S2C_SEED);

	dlc_disconnect(&dlc_a);

	err = test_dlc_try_send(&dlc_a, TEST_BASIC_C2S_LEN, TEST_BASIC_C2S_SEED);
	zassert_equal(err, -ENOTCONN, "Send after disconnect returned %d", err);
}

ZTEST(rfcomm_client, test_002_unregistered_channel)
{
	int err;

	test_br_sync();

	err = bt_rfcomm_dlc_connect(test_br_conn(), &dlc_extra.dlc, TEST_CHANNEL_UNREGISTERED);
	zassert_equal(err, 0, "Failed to start DLC connection (err %d)", err);

	/* The peer refuses the DLC: only the disconnected callback is called. */
	test_dlc_wait_disconnected(&dlc_extra);
	zassert_false(atomic_test_bit(dlc_extra.flags, TEST_DLC_FLAG_EVER_CONNECTED),
		      "DLC to unregistered channel was connected");

	/* The refused DLC was the only one, so the stack closes the RFCOMM
	 * session. Give the session time to be released before opening a new
	 * DLC, since bt_rfcomm_dlc_connect() fails while it is still closing.
	 */
	k_sleep(TEST_SESSION_RELEASE_DELAY);

	dlc_connect(&dlc_a, TEST_CHANNEL_A);

	test_dlc_send_pattern(&dlc_a, TEST_BASIC_C2S_LEN, TEST_BASIC_C2S_SEED);
	test_dlc_expect_pattern(&dlc_a, TEST_BASIC_S2C_LEN, TEST_BASIC_S2C_SEED);

	dlc_disconnect(&dlc_a);
}

ZTEST(rfcomm_client, test_003_multiple_dlcs)
{
	int err;

	test_br_sync();

	dlc_connect(&dlc_a, TEST_CHANNEL_A);

	/* A second DLC to a channel that is already in use is rejected. */
	err = bt_rfcomm_dlc_connect(test_br_conn(), &dlc_extra.dlc, TEST_CHANNEL_A);
	zassert_equal(err, -EBUSY, "Second DLC to channel A returned %d", err);

	dlc_connect(&dlc_b, TEST_CHANNEL_B);

	test_dlc_send_pattern(&dlc_a, TEST_MULTI_A_C2S_LEN, TEST_MULTI_A_C2S_SEED);
	test_dlc_send_pattern(&dlc_b, TEST_MULTI_B_C2S_LEN, TEST_MULTI_B_C2S_SEED);

	test_dlc_expect_pattern(&dlc_a, TEST_MULTI_A_S2C_LEN, TEST_MULTI_A_S2C_SEED);
	test_dlc_expect_pattern(&dlc_b, TEST_MULTI_B_S2C_LEN, TEST_MULTI_B_S2C_SEED);

	/* The server closes DLC B; DLC A must stay usable. */
	test_dlc_wait_disconnected(&dlc_b);
	zassert_true(atomic_test_bit(dlc_a.flags, TEST_DLC_FLAG_CONNECTED),
		     "DLC A disconnected together with DLC B");

	test_dlc_send_pattern(&dlc_a, TEST_MULTI_A_LAST_LEN, TEST_MULTI_A_LAST_SEED);
	test_dlc_wait_sent(&dlc_a, 2);

	dlc_disconnect(&dlc_a);

	zassert_equal(atomic_get(&dlc_a.rx_count), 1, "DLC A received %ld frames",
		      (long)atomic_get(&dlc_a.rx_count));
	zassert_equal(atomic_get(&dlc_b.rx_count), 1, "DLC B received %ld frames",
		      (long)atomic_get(&dlc_b.rx_count));
}

ZTEST(rfcomm_client, test_004_mtu_and_credits)
{
	uint16_t mtu;
	int err;

	test_br_sync();

	dlc_connect(&dlc_a, TEST_CHANNEL_A);
	mtu = dlc_a.dlc.mtu;
	LOG_DBG("Negotiated MTU %u", mtu);

	err = test_dlc_try_send(&dlc_a, mtu + 1, TEST_MTU_C2S_SEED);
	zassert_equal(err, -EMSGSIZE, "Send of MTU + 1 bytes returned %d", err);

	for (uint32_t i = 0; i < CONFIG_TEST_RFCOMM_FRAME_COUNT; i++) {
		test_dlc_send_pattern(&dlc_a, test_mtu_frame_len(i, mtu),
				      (uint8_t)(TEST_MTU_C2S_SEED + i));
	}
	test_dlc_wait_sent(&dlc_a, CONFIG_TEST_RFCOMM_FRAME_COUNT);

	for (uint32_t i = 0; i < CONFIG_TEST_RFCOMM_FRAME_COUNT; i++) {
		test_dlc_expect_pattern(&dlc_a, test_mtu_frame_len(i, mtu),
					(uint8_t)(TEST_MTU_S2C_SEED + i));
	}

	dlc_disconnect(&dlc_a);
}

ZTEST(rfcomm_client, test_005_deferred_recv)
{
	test_br_sync();

	dlc_connect(&dlc_a, TEST_CHANNEL_A);

	/* Queue more frames than the server grants credits for. */
	for (uint32_t i = 0; i < TEST_HOLD_FRAMES; i++) {
		test_dlc_send_pattern(&dlc_a, TEST_HOLD_LEN, (uint8_t)(TEST_HOLD_C2S_SEED + i));
	}

	/* All frames leave only after the server completes the held buffers. */
	test_dlc_wait_sent(&dlc_a, TEST_HOLD_FRAMES);
	test_dlc_expect_pattern(&dlc_a, TEST_HOLD_DONE_LEN, TEST_HOLD_DONE_SEED);

	dlc_disconnect(&dlc_a);
}

ZTEST(rfcomm_client, test_006_rpn_rls)
{
	struct bt_rfcomm_rpn rpn = {
		.baud_rate = BT_RFCOMM_RPN_BAUD_RATE_115200,
		.line_settings = BT_RFCOMM_SET_LINE_SETTINGS(BT_RFCOMM_RPN_DATA_BITS_8,
							     BT_RFCOMM_RPN_STOP_BITS_1,
							     BT_RFCOMM_RPN_PARITY_NONE),
		.flow_control = BT_RFCOMM_RPN_FLOW_NONE,
		.xon_char = BT_RFCOMM_RPN_XON_CHAR,
		.xoff_char = BT_RFCOMM_RPN_XOFF_CHAR,
		.param_mask = sys_cpu_to_le16(BT_RFCOMM_RPN_PARAM_MASK_ALL),
	};
	struct bt_rfcomm_rpn bad_rpn = rpn;
	int err;

	test_br_sync();

	err = bt_rfcomm_send_rpn_cmd(&dlc_a.dlc, &rpn);
	zassert_equal(err, -ENOTCONN, "RPN on unconnected DLC returned %d", err);
	err = bt_rfcomm_send_rls_cmd(&dlc_a.dlc, BT_RFCOMM_RLS_NO_ERR);
	zassert_equal(err, -ENOTCONN, "RLS on unconnected DLC returned %d", err);

	dlc_connect(&dlc_a, TEST_CHANNEL_A);

	/* Argument validation */
	err = bt_rfcomm_send_rpn_cmd(&dlc_a.dlc, NULL);
	zassert_equal(err, -EINVAL, "RPN with NULL params returned %d", err);
	bad_rpn.baud_rate = BT_RFCOMM_RPN_BAUD_RATE_230400 + 1;
	err = bt_rfcomm_send_rpn_cmd(&dlc_a.dlc, &bad_rpn);
	zassert_equal(err, -EINVAL, "RPN with invalid baud rate returned %d", err);
	err = bt_rfcomm_send_rls_cmd(NULL, BT_RFCOMM_RLS_NO_ERR);
	zassert_equal(err, -EINVAL, "RLS with NULL DLC returned %d", err);
	err = bt_rfcomm_send_rls_cmd(&dlc_a.dlc, BIT(4));
	zassert_equal(err, -EINVAL, "RLS with reserved bit returned %d", err);
	err = bt_rfcomm_send_rls_cmd(&dlc_a.dlc, BIT(0));
	zassert_equal(err, -EINVAL, "RLS with error flag but no error returned %d", err);

	/* Valid commands; the peer answers them inside its RFCOMM stack. */
	err = bt_rfcomm_send_rpn_cmd(&dlc_a.dlc, &rpn);
	zassert_equal(err, 0, "Failed to send RPN (err %d)", err);
	err = bt_rfcomm_send_rls_cmd(&dlc_a.dlc, BT_RFCOMM_RLS_NO_ERR);
	zassert_equal(err, 0, "Failed to send RLS (err %d)", err);
	err = bt_rfcomm_send_rls_cmd(&dlc_a.dlc, BT_RFCOMM_RLS_ERR(BT_RFCOMM_RLS_ERR_PARITY_ERROR));
	zassert_equal(err, 0, "Failed to send RLS with error (err %d)", err);

	/* Data still flows in both directions after the control commands. */
	test_dlc_send_pattern(&dlc_a, TEST_BASIC_C2S_LEN, TEST_BASIC_C2S_SEED);
	test_dlc_expect_pattern(&dlc_a, TEST_BASIC_S2C_LEN, TEST_BASIC_S2C_SEED);

	dlc_disconnect(&dlc_a);

	err = bt_rfcomm_send_rpn_cmd(&dlc_a.dlc, &rpn);
	zassert_equal(err, -ENOTCONN, "RPN after disconnect returned %d", err);
	err = bt_rfcomm_send_rls_cmd(&dlc_a.dlc, BT_RFCOMM_RLS_NO_ERR);
	zassert_equal(err, -ENOTCONN, "RLS after disconnect returned %d", err);
}

ZTEST(rfcomm_client, test_007_acceptor_initiated_dlc)
{
	int err;

	err = bt_rfcomm_server_register(&client_server);
	zassert_equal(err, 0, "Failed to register client channel (err %d)", err);
	client_server_registered = true;

	test_br_sync();

	dlc_connect(&dlc_a, TEST_CHANNEL_A);

	/* Tell the server that the client channel is ready. */
	test_dlc_send_pattern(&dlc_a, TEST_BASIC_C2S_LEN, TEST_BASIC_C2S_SEED);

	/* The server opens a DLC to this side over the same session. */
	test_dlc_wait_connected(&dlc_rev);
	zassert_equal(atomic_get(&client_accept_count), 1, "Unexpected accept count");

	test_dlc_expect_pattern(&dlc_rev, TEST_REV_S2C_LEN, TEST_REV_S2C_SEED);
	test_dlc_send_pattern(&dlc_rev, TEST_REV_C2S_LEN, TEST_REV_C2S_SEED);

	/* The server closes the reverse DLC; DLC A must stay usable. */
	test_dlc_wait_disconnected(&dlc_rev);
	test_dlc_expect_pattern(&dlc_a, TEST_REV_DONE_LEN, TEST_REV_DONE_SEED);

	dlc_disconnect(&dlc_a);
}

static void *setup(void)
{
	test_br_setup(TEST_BR_INITIATOR, BT_SECURITY_L1);
	return NULL;
}

static void teardown(void *f)
{
	test_br_teardown();
}

static void before(void *f)
{
	test_dlc_init(&dlc_a);
	test_dlc_init(&dlc_b);
	test_dlc_init(&dlc_extra);
	test_dlc_init(&dlc_rev);
	atomic_set(&client_accept_count, 0);
}

static void after(void *f)
{
	int err;

	if (client_server_registered) {
		err = bt_rfcomm_server_unregister(&client_server);
		if (err != 0) {
			LOG_ERR("Failed to unregister client channel (err %d)", err);
		}
		client_server_registered = false;
	}
}

ZTEST_SUITE(rfcomm_client, NULL, setup, before, after, teardown);
```

## src/test_common.c
```c
/*
 * SPDX-FileCopyrightText: Copyright 2026 NXP
 *
 * SPDX-License-Identifier: Apache-2.0
 */

#include <string.h>

#include <zephyr/kernel.h>
#include <zephyr/bluetooth/bluetooth.h>
#include <zephyr/bluetooth/conn.h>
#include <zephyr/bluetooth/classic/rfcomm.h>
#include <zephyr/logging/log.h>
#include <zephyr/net_buf.h>
#include <zephyr/ztest.h>

#include "test_br.h"
#include "test_common.h"

LOG_MODULE_REGISTER(test_rfcomm_common, CONFIG_TEST_CLASSIC_RFCOMM_SIM_LOG_LEVEL);

NET_BUF_POOL_FIXED_DEFINE(test_tx_pool, CONFIG_TEST_RFCOMM_TX_POOL_COUNT,
			  BT_RFCOMM_BUF_SIZE(TEST_MTU), CONFIG_BT_CONN_TX_USER_DATA_SIZE, NULL);

void test_fill_pattern(uint8_t *data, size_t len, uint8_t seed)
{
	for (size_t i = 0; i < len; i++) {
		data[i] = (uint8_t)(seed + (i * 3U) + (i >> 8));
	}
}

uint16_t test_mtu_frame_len(uint32_t index, uint16_t mtu)
{
	/* A one-octet frame, 127 and 128 octets (the stack encodes the UIH
	 * length in one octet up to 127 and in two octets above that) and a
	 * frame of the full DLC MTU (0 in the table).
	 */
	static const uint16_t lens[] = {1, 127, 128, 0};
	uint16_t len = lens[index % ARRAY_SIZE(lens)];

	return (len == 0 || len > mtu) ? mtu : len;
}

static void test_dlc_flush_held(struct test_dlc *td)
{
	struct net_buf *buf;

	while ((buf = k_fifo_get(&td->held_fifo, K_NO_WAIT)) != NULL) {
		net_buf_unref(buf);
	}
}

static void dlc_connected(struct bt_rfcomm_dlc *dlc)
{
	struct test_dlc *td = CONTAINER_OF(dlc, struct test_dlc, dlc);

	LOG_DBG("DLC %p connected, mtu %u", (void *)dlc, dlc->mtu);

	atomic_set_bit(td->flags, TEST_DLC_FLAG_CONNECTED);
	atomic_set_bit(td->flags, TEST_DLC_FLAG_EVER_CONNECTED);
	k_sem_give(&td->connected_sem);
}

static void dlc_disconnected(struct bt_rfcomm_dlc *dlc)
{
	struct test_dlc *td = CONTAINER_OF(dlc, struct test_dlc, dlc);

	LOG_DBG("DLC %p disconnected", (void *)dlc);

	atomic_clear_bit(td->flags, TEST_DLC_FLAG_CONNECTED);
	/* The application owns held buffers once the DLC is gone. */
	test_dlc_flush_held(td);
	k_sem_give(&td->disconnected_sem);
}

static int dlc_recv(struct bt_rfcomm_dlc *dlc, struct net_buf *buf)
{
	struct test_dlc *td = CONTAINER_OF(dlc, struct test_dlc, dlc);
	atomic_val_t slot;

	LOG_DBG("DLC %p received %u bytes", (void *)dlc, buf->len);

	slot = atomic_get(&td->rx_count);
	if (slot >= TEST_RX_SLOTS || buf->len > TEST_MTU) {
		LOG_ERR("RX overflow (slot %ld len %u)", (long)slot, buf->len);
		atomic_set_bit(td->flags, TEST_DLC_FLAG_RX_OVERFLOW);
		k_sem_give(&td->rx_sem);
		return 0;
	}

	td->rx_len[slot] = buf->len;
	memcpy(td->rx_data[slot], buf->data, buf->len);
	atomic_inc(&td->rx_count);

	if (atomic_test_bit(td->flags, TEST_DLC_FLAG_HOLD_RX)) {
		k_fifo_put(&td->held_fifo, buf);
		k_sem_give(&td->rx_sem);
		return -EINPROGRESS;
	}

	k_sem_give(&td->rx_sem);
	return 0;
}

static void dlc_sent(struct bt_rfcomm_dlc *dlc, int err)
{
	struct test_dlc *td = CONTAINER_OF(dlc, struct test_dlc, dlc);

	if (err != 0) {
		LOG_ERR("DLC %p send failed (err %d)", (void *)dlc, err);
		atomic_inc(&td->sent_err_count);
	}

	atomic_inc(&td->sent_count);
	k_sem_give(&td->sent_sem);
}

static struct bt_rfcomm_dlc_ops test_dlc_ops = {
	.connected = dlc_connected,
	.disconnected = dlc_disconnected,
	.recv = dlc_recv,
	.sent = dlc_sent,
};

void test_dlc_init(struct test_dlc *td)
{
	memset(td, 0, sizeof(*td));

	k_sem_init(&td->connected_sem, 0, 1);
	k_sem_init(&td->disconnected_sem, 0, 1);
	k_sem_init(&td->rx_sem, 0, K_SEM_MAX_LIMIT);
	k_sem_init(&td->sent_sem, 0, K_SEM_MAX_LIMIT);
	k_fifo_init(&td->held_fifo);

	td->dlc.ops = &test_dlc_ops;
	td->dlc.mtu = TEST_MTU;
	td->dlc.required_sec_level = BT_SECURITY_L1;
}

void test_dlc_release_held(struct test_dlc *td)
{
	struct net_buf *buf;
	int err;

	while ((buf = k_fifo_get(&td->held_fifo, K_NO_WAIT)) != NULL) {
		err = bt_rfcomm_dlc_recv_complete(&td->dlc, buf);
		zassert_equal(err, 0, "Failed to complete RX (err %d)", err);
	}
}

void test_dlc_wait_connected(struct test_dlc *td)
{
	int err;

	err = test_br_wait(&td->connected_sem, TEST_DLC_TIMEOUT);
	zassert_equal(err, 0, "DLC connection timeout (err %d)", err);
	zassert_true(atomic_test_bit(td->flags, TEST_DLC_FLAG_CONNECTED), "DLC not connected");
	zassert_true(td->dlc.mtu >= TEST_MIN_MTU && td->dlc.mtu <= TEST_MTU,
		     "Unexpected DLC MTU %u", td->dlc.mtu);
}

void test_dlc_wait_disconnected(struct test_dlc *td)
{
	int err;

	err = k_sem_take(&td->disconnected_sem, TEST_DLC_TIMEOUT);
	zassert_equal(err, 0, "DLC disconnection timeout (err %d)", err);
	zassert_false(atomic_test_bit(td->flags, TEST_DLC_FLAG_CONNECTED), "DLC still connected");
}

int test_dlc_try_send(struct test_dlc *td, uint16_t len, uint8_t seed)
{
	struct net_buf *buf;
	int err;

	buf = bt_rfcomm_create_pdu(&test_tx_pool);
	zassert_not_null(buf, "Failed to allocate TX buffer");
	zassert_true(net_buf_tailroom(buf) >= len + BT_RFCOMM_FCS_SIZE,
		     "TX buffer too small (%zu < %u)", net_buf_tailroom(buf), len);

	test_fill_pattern(net_buf_add(buf, len), len, seed);

	err = bt_rfcomm_dlc_send(&td->dlc, buf);
	if (err < 0) {
		net_buf_unref(buf);
	}

	return err;
}

void test_dlc_send_pattern(struct test_dlc *td, uint16_t len, uint8_t seed)
{
	int err;

	err = test_dlc_try_send(td, len, seed);
	zassert_true(err >= 0, "Failed to send %u bytes (err %d)", len, err);
}

void test_dlc_expect_pattern(struct test_dlc *td, uint16_t len, uint8_t seed)
{
	static uint8_t expected[TEST_MTU];
	uint32_t idx;
	int err;

	zassert_true(len <= sizeof(expected), "Expected length %u too large", len);

	err = test_br_wait(&td->rx_sem, TEST_RX_TIMEOUT);
	zassert_equal(err, 0, "RX timeout waiting for %u bytes (err %d)", len, err);
	zassert_false(atomic_test_bit(td->flags, TEST_DLC_FLAG_RX_OVERFLOW), "RX overflow");

	idx = td->rx_read++;
	zassert_true(idx < (uint32_t)atomic_get(&td->rx_count), "No RX frame recorded");
	zassert_equal(td->rx_len[idx], len, "RX frame %u length %u != %u", idx, td->rx_len[idx],
		      len);

	test_fill_pattern(expected, len, seed);
	zassert_mem_equal(td->rx_data[idx], expected, len, "RX frame %u payload mismatch", idx);
}

void test_dlc_wait_sent(struct test_dlc *td, uint32_t count)
{
	int err;

	while ((uint32_t)atomic_get(&td->sent_count) < count) {
		err = test_br_wait(&td->sent_sem, TEST_RX_TIMEOUT);
		zassert_equal(err, 0, "TX complete timeout (%ld of %u sent)",
			      (long)atomic_get(&td->sent_count), count);
	}

	zassert_equal(atomic_get(&td->sent_err_count), 0, "TX completed with errors");
}
```

## src/test_common.h
```c
/*
 * SPDX-FileCopyrightText: Copyright 2026 NXP
 *
 * SPDX-License-Identifier: Apache-2.0
 */

#ifndef TEST_RFCOMM_COMMON_H_
#define TEST_RFCOMM_COMMON_H_

#include <zephyr/kernel.h>
#include <zephyr/bluetooth/bluetooth.h>
#include <zephyr/bluetooth/conn.h>
#include <zephyr/bluetooth/classic/rfcomm.h>
#include <zephyr/net_buf.h>

#define TEST_CHANNEL_A            CONFIG_TEST_RFCOMM_CHANNEL_A
#define TEST_CHANNEL_B            CONFIG_TEST_RFCOMM_CHANNEL_B
#define TEST_CHANNEL_CLIENT       CONFIG_TEST_RFCOMM_CHANNEL_CLIENT
#define TEST_CHANNEL_UNREGISTERED CONFIG_TEST_RFCOMM_CHANNEL_UNREGISTERED

/* MTU requested by both roles; the stack lowers it to what the session supports. */
#define TEST_MTU CONFIG_BT_RFCOMM_L2CAP_MTU

/* Smallest DLC MTU that the Zephyr RFCOMM stack accepts. */
#define TEST_MIN_MTU 23

/* Number of RX frames recorded per DLC. */
#define TEST_RX_SLOTS 24

#define TEST_DLC_TIMEOUT K_SECONDS(30)
#define TEST_RX_TIMEOUT  K_SECONDS(10)

/* Time for an RFCOMM session without DLCs to be torn down by the stack. */
#define TEST_SESSION_RELEASE_DELAY K_SECONDS(3)

/* Payload lengths and pattern seeds shared by both roles. */
#define TEST_BASIC_C2S_LEN  48
#define TEST_BASIC_C2S_SEED 0x10
#define TEST_BASIC_S2C_LEN  64
#define TEST_BASIC_S2C_SEED 0x20

#define TEST_MULTI_A_C2S_SEED  0x31
#define TEST_MULTI_B_C2S_SEED  0x32
#define TEST_MULTI_A_S2C_SEED  0x41
#define TEST_MULTI_B_S2C_SEED  0x42
#define TEST_MULTI_A_C2S_LEN   40
#define TEST_MULTI_B_C2S_LEN   50
#define TEST_MULTI_A_S2C_LEN   60
#define TEST_MULTI_B_S2C_LEN   70
#define TEST_MULTI_A_LAST_SEED 0x51
#define TEST_MULTI_A_LAST_LEN  33

#define TEST_MTU_C2S_SEED 0x60
#define TEST_MTU_S2C_SEED 0x90

/* Frames sent by the client while the server defers RX completion. */
#define TEST_HOLD_CREDITS   3
#define TEST_HOLD_FRAMES    8
#define TEST_HOLD_LEN       20
#define TEST_HOLD_C2S_SEED  0xa0
#define TEST_HOLD_DONE_SEED 0xb0
#define TEST_HOLD_DONE_LEN  10

#define TEST_REV_S2C_SEED  0xc0
#define TEST_REV_S2C_LEN   24
#define TEST_REV_C2S_SEED  0xd0
#define TEST_REV_C2S_LEN   36
#define TEST_REV_DONE_SEED 0xe0
#define TEST_REV_DONE_LEN  12

enum {
	TEST_DLC_FLAG_CONNECTED,
	TEST_DLC_FLAG_EVER_CONNECTED,
	TEST_DLC_FLAG_HOLD_RX,
	TEST_DLC_FLAG_RX_OVERFLOW,

	TEST_DLC_NUM_FLAGS,
};

struct test_dlc {
	struct bt_rfcomm_dlc dlc;
	struct k_sem connected_sem;
	struct k_sem disconnected_sem;
	struct k_sem rx_sem;
	struct k_sem sent_sem;
	/* Buffers whose processing was deferred with -EINPROGRESS. */
	struct k_fifo held_fifo;
	ATOMIC_DEFINE(flags, TEST_DLC_NUM_FLAGS);
	atomic_t rx_count;
	uint32_t rx_read;
	atomic_t sent_count;
	atomic_t sent_err_count;
	uint16_t rx_len[TEST_RX_SLOTS];
	uint8_t rx_data[TEST_RX_SLOTS][TEST_MTU];
};

void test_fill_pattern(uint8_t *data, size_t len, uint8_t seed);
uint16_t test_mtu_frame_len(uint32_t index, uint16_t mtu);

void test_dlc_init(struct test_dlc *td);
void test_dlc_release_held(struct test_dlc *td);
void test_dlc_wait_connected(struct test_dlc *td);
void test_dlc_wait_disconnected(struct test_dlc *td);
int test_dlc_try_send(struct test_dlc *td, uint16_t len, uint8_t seed);
void test_dlc_send_pattern(struct test_dlc *td, uint16_t len, uint8_t seed);
void test_dlc_expect_pattern(struct test_dlc *td, uint16_t len, uint8_t seed);
void test_dlc_wait_sent(struct test_dlc *td, uint32_t count);

#endif /* TEST_RFCOMM_COMMON_H_ */
```

## src/test_main.c
```c
/*
 * SPDX-FileCopyrightText: Copyright 2026 NXP
 *
 * SPDX-License-Identifier: Apache-2.0
 */

#include <zephyr/kernel.h>
#include <zephyr/bluetooth/bluetooth.h>
#include <zephyr/bluetooth/conn.h>
#include <zephyr/logging/log.h>
#include <zephyr/ztest.h>

#include "nsi_host_trampolines.h"
#include "nsi_errno.h"
#include "nsi_main.h"
#include "soc.h"
#include "cmdline.h" /* native_sim command line options header */

#define LOG_MODULE_NAME test_classic_rfcomm_sim_main
LOG_MODULE_REGISTER(LOG_MODULE_NAME, CONFIG_TEST_CLASSIC_RFCOMM_SIM_LOG_LEVEL);

bt_addr_t peer_addr;

static void cmd_peer_bd_address_found(char *argv, int offset)
{
	char *addr_str = &argv[offset];
	int err;

	err = bt_addr_from_str(addr_str, &peer_addr);
	if (err != 0) {
		LOG_ERR("Failed to parse peer Bluetooth address: %s (err %d)", addr_str, err);
		nsi_exit(err);
	}
}

static void test_rfcomm_args(void)
{
	static struct args_struct_t args[] = {
		{
			.is_mandatory = true,
			.option = "peer_bd_address",
			.name = "XX:XX:XX:XX:XX:XX",
			.type = 's',
			.call_when_found = cmd_peer_bd_address_found,
			.descript = "Bluetooth peer device address for RFCOMM test",
		},
		ARG_TABLE_ENDMARKER
	};

	native_add_command_line_opts(args);
}

NATIVE_TASK(test_rfcomm_args, PRE_BOOT_1, 20);
```

## src/test_server.c
```c
/*
 * SPDX-FileCopyrightText: Copyright 2026 NXP
 *
 * SPDX-License-Identifier: Apache-2.0
 */

#include <zephyr/kernel.h>
#include <zephyr/bluetooth/bluetooth.h>
#include <zephyr/bluetooth/conn.h>
#include <zephyr/bluetooth/classic/rfcomm.h>
#include <zephyr/logging/log.h>
#include <zephyr/ztest.h>

#include "test_br.h"
#include "test_common.h"

LOG_MODULE_REGISTER(test_rfcomm_server, CONFIG_TEST_CLASSIC_RFCOMM_SIM_LOG_LEVEL);

struct test_server {
	struct bt_rfcomm_server server;
	struct test_dlc *td;
	atomic_t accept_count;
	bool registered;
};

static struct test_dlc dlc_a;
static struct test_dlc dlc_b;
static struct test_dlc dlc_rev;

static struct test_server server_a;
static struct test_server server_b;

static int server_accept(struct bt_conn *conn, struct bt_rfcomm_server *server,
			 struct bt_rfcomm_dlc **dlc)
{
	struct test_server *ts = CONTAINER_OF(server, struct test_server, server);

	LOG_DBG("Incoming DLC on channel %u (conn %p)", server->channel, (void *)conn);

	if (atomic_inc(&ts->accept_count) != 0) {
		LOG_ERR("Channel %u already accepted a DLC", server->channel);
		return -ENOMEM;
	}

	*dlc = &ts->td->dlc;
	return 0;
}

static void server_register(struct test_server *ts, uint8_t channel, struct test_dlc *td)
{
	int err;

	ts->server.channel = channel;
	ts->server.accept = server_accept;
	ts->td = td;
	atomic_set(&ts->accept_count, 0);

	err = bt_rfcomm_server_register(&ts->server);
	zassert_equal(err, 0, "Failed to register channel %u (err %d)", channel, err);
	ts->registered = true;
}

static void server_unregister(struct test_server *ts)
{
	int err;

	if (!ts->registered) {
		return;
	}

	err = bt_rfcomm_server_unregister(&ts->server);
	if (err != 0) {
		LOG_ERR("Failed to unregister channel %u (err %d)", ts->server.channel, err);
	}
	ts->registered = false;
}

static void test_server_register_api(void)
{
	struct bt_rfcomm_server tmp = {0};
	int err;

	/* No accept callback */
	tmp.channel = TEST_CHANNEL_B;
	err = bt_rfcomm_server_register(&tmp);
	zassert_equal(err, -EINVAL, "Register without accept returned %d", err);

	/* Channel above the valid range */
	tmp.channel = 31;
	tmp.accept = server_accept;
	err = bt_rfcomm_server_register(&tmp);
	zassert_equal(err, -EINVAL, "Register of channel 31 returned %d", err);

	/* Channel already registered */
	tmp.channel = TEST_CHANNEL_A;
	err = bt_rfcomm_server_register(&tmp);
	zassert_equal(err, -EADDRINUSE, "Duplicate register returned %d", err);

	/* Channel 0 requests a dynamically allocated channel */
	tmp.channel = 0;
	err = bt_rfcomm_server_register(&tmp);
	zassert_equal(err, 0, "Dynamic register failed (err %d)", err);
	zassert_true(tmp.channel >= BT_RFCOMM_CHAN_DYNAMIC_START && tmp.channel <= 30,
		     "Dynamic channel %u out of range", tmp.channel);
	zassert_not_equal(tmp.channel, TEST_CHANNEL_A, "Dynamic channel reused channel A");

	err = bt_rfcomm_server_unregister(&tmp);
	zassert_equal(err, 0, "Unregister failed (err %d)", err);

	err = bt_rfcomm_server_unregister(&tmp);
	zassert_equal(err, -ENOENT, "Second unregister returned %d", err);
}

ZTEST(rfcomm_server, test_001_basic)
{
	server_register(&server_a, TEST_CHANNEL_A, &dlc_a);
	test_server_register_api();

	test_br_sync();

	test_dlc_wait_connected(&dlc_a);

	test_dlc_expect_pattern(&dlc_a, TEST_BASIC_C2S_LEN, TEST_BASIC_C2S_SEED);
	test_dlc_send_pattern(&dlc_a, TEST_BASIC_S2C_LEN, TEST_BASIC_S2C_SEED);
	test_dlc_wait_sent(&dlc_a, 1);

	/* The client disconnects the DLC. */
	test_dlc_wait_disconnected(&dlc_a);

	zassert_equal(atomic_get(&server_a.accept_count), 1, "Unexpected accept count");
}

ZTEST(rfcomm_server, test_002_unregistered_channel)
{
	server_register(&server_a, TEST_CHANNEL_A, &dlc_a);

	test_br_sync();

	/* The DLC to the unregistered channel is refused by the stack without
	 * reaching any accept callback; the client then connects to channel A.
	 */
	test_dlc_wait_connected(&dlc_a);
	test_dlc_expect_pattern(&dlc_a, TEST_BASIC_C2S_LEN, TEST_BASIC_C2S_SEED);
	test_dlc_send_pattern(&dlc_a, TEST_BASIC_S2C_LEN, TEST_BASIC_S2C_SEED);

	test_dlc_wait_disconnected(&dlc_a);

	zassert_equal(atomic_get(&server_a.accept_count), 1, "Unexpected accept count");
}

ZTEST(rfcomm_server, test_003_multiple_dlcs)
{
	int err;

	server_register(&server_a, TEST_CHANNEL_A, &dlc_a);
	server_register(&server_b, TEST_CHANNEL_B, &dlc_b);

	test_br_sync();

	test_dlc_wait_connected(&dlc_a);
	test_dlc_wait_connected(&dlc_b);

	/* Each DLC must receive only its own payload. */
	test_dlc_expect_pattern(&dlc_a, TEST_MULTI_A_C2S_LEN, TEST_MULTI_A_C2S_SEED);
	test_dlc_expect_pattern(&dlc_b, TEST_MULTI_B_C2S_LEN, TEST_MULTI_B_C2S_SEED);

	test_dlc_send_pattern(&dlc_a, TEST_MULTI_A_S2C_LEN, TEST_MULTI_A_S2C_SEED);
	test_dlc_send_pattern(&dlc_b, TEST_MULTI_B_S2C_LEN, TEST_MULTI_B_S2C_SEED);
	test_dlc_wait_sent(&dlc_a, 1);
	test_dlc_wait_sent(&dlc_b, 1);

	/* The acceptor closes DLC B; DLC A must stay usable. */
	err = bt_rfcomm_dlc_disconnect(&dlc_b.dlc);
	zassert_equal(err, 0, "Failed to disconnect DLC B (err %d)", err);
	test_dlc_wait_disconnected(&dlc_b);
	zassert_true(atomic_test_bit(dlc_a.flags, TEST_DLC_FLAG_CONNECTED),
		     "DLC A disconnected together with DLC B");

	test_dlc_expect_pattern(&dlc_a, TEST_MULTI_A_LAST_LEN, TEST_MULTI_A_LAST_SEED);

	test_dlc_wait_disconnected(&dlc_a);

	zassert_equal(atomic_get(&dlc_a.rx_count), 2, "DLC A received %ld frames",
		      (long)atomic_get(&dlc_a.rx_count));
	zassert_equal(atomic_get(&dlc_b.rx_count), 1, "DLC B received %ld frames",
		      (long)atomic_get(&dlc_b.rx_count));
}

ZTEST(rfcomm_server, test_004_mtu_and_credits)
{
	uint16_t mtu;

	server_register(&server_a, TEST_CHANNEL_A, &dlc_a);

	test_br_sync();

	test_dlc_wait_connected(&dlc_a);
	mtu = dlc_a.dlc.mtu;
	LOG_DBG("Negotiated MTU %u", mtu);

	for (uint32_t i = 0; i < CONFIG_TEST_RFCOMM_FRAME_COUNT; i++) {
		test_dlc_expect_pattern(&dlc_a, test_mtu_frame_len(i, mtu),
					(uint8_t)(TEST_MTU_C2S_SEED + i));
	}

	for (uint32_t i = 0; i < CONFIG_TEST_RFCOMM_FRAME_COUNT; i++) {
		test_dlc_send_pattern(&dlc_a, test_mtu_frame_len(i, mtu),
				      (uint8_t)(TEST_MTU_S2C_SEED + i));
	}
	test_dlc_wait_sent(&dlc_a, CONFIG_TEST_RFCOMM_FRAME_COUNT);

	test_dlc_wait_disconnected(&dlc_a);
}

ZTEST(rfcomm_server, test_005_deferred_recv)
{
	struct net_buf *buf;
	int err;

	server_register(&server_a, TEST_CHANNEL_A, &dlc_a);
	/* Small RX credit window, and keep every received buffer. */
	dlc_a.dlc.rx_credit_limit = TEST_HOLD_CREDITS;
	atomic_set_bit(dlc_a.flags, TEST_DLC_FLAG_HOLD_RX);

	test_br_sync();

	test_dlc_wait_connected(&dlc_a);
	zassert_equal(dlc_a.dlc.rx_credit_limit, TEST_HOLD_CREDITS, "RX credit limit %u",
		      dlc_a.dlc.rx_credit_limit);

	for (uint32_t i = 0; i < TEST_HOLD_CREDITS; i++) {
		err = test_br_wait(&dlc_a.rx_sem, TEST_RX_TIMEOUT);
		zassert_equal(err, 0, "Held frame %u not received (err %d)", i, err);
	}

	/* No more frames may arrive while all credits are held. */
	err = k_sem_take(&dlc_a.rx_sem, K_SECONDS(2));
	zassert_equal(err, -EAGAIN, "Frame received while credits were held");
	zassert_equal(atomic_get(&dlc_a.rx_count), TEST_HOLD_CREDITS,
		      "Received %ld frames while credits were held",
		      (long)atomic_get(&dlc_a.rx_count));

	err = bt_rfcomm_dlc_recv_complete(NULL, NULL);
	zassert_equal(err, -EINVAL, "recv_complete(NULL) returned %d", err);
	err = bt_rfcomm_dlc_recv_complete(&dlc_a.dlc, NULL);
	zassert_equal(err, -EINVAL, "recv_complete(buf NULL) returned %d", err);

	/* Complete the held buffers and consume the rest synchronously. */
	atomic_clear_bit(dlc_a.flags, TEST_DLC_FLAG_HOLD_RX);
	test_dlc_release_held(&dlc_a);

	/* The held frames were already counted by rx_sem above. */
	for (uint32_t i = 0; i < TEST_HOLD_CREDITS; i++) {
		k_sem_give(&dlc_a.rx_sem);
	}

	for (uint32_t i = 0; i < TEST_HOLD_FRAMES; i++) {
		test_dlc_expect_pattern(&dlc_a, TEST_HOLD_LEN, (uint8_t)(TEST_HOLD_C2S_SEED + i));
	}

	buf = k_fifo_get(&dlc_a.held_fifo, K_NO_WAIT);
	zassert_is_null(buf, "Buffer still held after release");

	test_dlc_send_pattern(&dlc_a, TEST_HOLD_DONE_LEN, TEST_HOLD_DONE_SEED);

	test_dlc_wait_disconnected(&dlc_a);
}

ZTEST(rfcomm_server, test_006_rpn_rls)
{
	int err;

	server_register(&server_a, TEST_CHANNEL_A, &dlc_a);

	test_br_sync();

	test_dlc_wait_connected(&dlc_a);

	test_dlc_expect_pattern(&dlc_a, TEST_BASIC_C2S_LEN, TEST_BASIC_C2S_SEED);

	/* The acceptor side sends an RLS command too before replying. */
	err = bt_rfcomm_send_rls_cmd(&dlc_a.dlc,
				     BT_RFCOMM_RLS_ERR(BT_RFCOMM_RLS_ERR_OVERRUN_ERROR));
	zassert_equal(err, 0, "Failed to send RLS (err %d)", err);

	test_dlc_send_pattern(&dlc_a, TEST_BASIC_S2C_LEN, TEST_BASIC_S2C_SEED);

	test_dlc_wait_disconnected(&dlc_a);
}

ZTEST(rfcomm_server, test_007_acceptor_initiated_dlc)
{
	int err;

	server_register(&server_a, TEST_CHANNEL_A, &dlc_a);

	test_br_sync();

	test_dlc_wait_connected(&dlc_a);

	/* The client sends on DLC A once its own server channel is ready. */
	test_dlc_expect_pattern(&dlc_a, TEST_BASIC_C2S_LEN, TEST_BASIC_C2S_SEED);

	/* Open a DLC from this side over the session the client created. */
	err = bt_rfcomm_dlc_connect(test_br_conn(), &dlc_rev.dlc, TEST_CHANNEL_CLIENT);
	zassert_equal(err, 0, "Failed to connect reverse DLC (err %d)", err);
	test_dlc_wait_connected(&dlc_rev);

	test_dlc_send_pattern(&dlc_rev, TEST_REV_S2C_LEN, TEST_REV_S2C_SEED);
	test_dlc_expect_pattern(&dlc_rev, TEST_REV_C2S_LEN, TEST_REV_C2S_SEED);

	err = bt_rfcomm_dlc_disconnect(&dlc_rev.dlc);
	zassert_equal(err, 0, "Failed to disconnect reverse DLC (err %d)", err);
	test_dlc_wait_disconnected(&dlc_rev);

	test_dlc_send_pattern(&dlc_a, TEST_REV_DONE_LEN, TEST_REV_DONE_SEED);

	test_dlc_wait_disconnected(&dlc_a);
}

static void *setup(void)
{
	test_br_setup(TEST_BR_ACCEPTOR, BT_SECURITY_L1);
	return NULL;
}

static void teardown(void *f)
{
	test_br_teardown();
}

static void before(void *f)
{
	test_dlc_init(&dlc_a);
	test_dlc_init(&dlc_b);
	test_dlc_init(&dlc_rev);
}

static void after(void *f)
{
	server_unregister(&server_a);
	server_unregister(&server_b);
}

ZTEST_SUITE(rfcomm_server, NULL, setup, before, after, teardown);
```
