## CMakeLists.txt
```
# SPDX-FileCopyrightText: Copyright 2026 NXP
# SPDX-License-Identifier: Apache-2.0

cmake_minimum_required(VERSION 3.20.0)
find_package(Zephyr REQUIRED HINTS $ENV{ZEPHYR_BASE})
project(bluetooth_classic_goep_sim)

target_sources(app PRIVATE
  src/test_main.c
  src/test_br.c
  src/test_connect.c
  src/test_put_get.c
  src/test_misc.c
  src/test_regressions.c
)

if(CONFIG_TEST_GOEP_L2CAP)
  zephyr_link_libraries(
    -Wl,--wrap=l2cap_br_data_pull
    -Wl,--wrap=bt_l2cap_br_recv
    -Wl,--wrap=bt_l2cap_chan_connect
    -Wl,--wrap=bt_l2cap_chan_disconnect
  )
endif()
```

## Kconfig
```
# SPDX-FileCopyrightText: Copyright 2026 NXP
# SPDX-License-Identifier: Apache-2.0

source "Kconfig.zephyr"

config TEST_GOEP_L2CAP
	bool "Use GOEP over L2CAP instead of RFCOMM"
	default n

module = TEST_CLASSIC_GOEP_SIM
module-str = test_classic_goep_sim
source "subsys/logging/Kconfig.template.log_config"

module = TEST_BR
module-str = test_br
source "subsys/logging/Kconfig.template.log_config"
```

## prj.conf
```kconfig
# SPDX-FileCopyrightText: Copyright 2026 NXP
# SPDX-License-Identifier: Apache-2.0

CONFIG_BT=y
CONFIG_BT_CLASSIC=y
CONFIG_BT_TESTING=y
CONFIG_BT_RFCOMM=y
CONFIG_BT_GOEP=y
CONFIG_BT_OBEX_AUTH=y
CONFIG_LOG=y
CONFIG_ZTEST=y
CONFIG_BT_DEVICE_NAME="test_goep"
CONFIG_BT_CREATE_CONN_TIMEOUT=30
CONFIG_BT_PAGE_TIMEOUT=0xFFFF
CONFIG_BT_BUF_ACL_RX_COUNT_EXTRA=8
CONFIG_TEST_CLASSIC_GOEP_SIM_LOG_LEVEL_DBG=y
```

## src/test_br.c
```c
/*
 * SPDX-FileCopyrightText: Copyright 2026 NXP
 *
 * SPDX-License-Identifier: Apache-2.0
 */

#include <string.h>

#include <zephyr/kernel.h>
#include <zephyr/sys/byteorder.h>
#include <zephyr/bluetooth/bluetooth.h>
#include <zephyr/bluetooth/conn.h>
#include <zephyr/bluetooth/hci.h>
#include <zephyr/bluetooth/l2cap.h>
#include <zephyr/bluetooth/classic/classic.h>
#include <zephyr/bluetooth/classic/l2cap_br.h>
#include <zephyr/logging/log.h>
#include <zephyr/net_buf.h>
#include <zephyr/ztest.h>

#include "test_br.h"

LOG_MODULE_REGISTER(test_br, CONFIG_TEST_BR_LOG_LEVEL);

#define POLL_INTERVAL K_MSEC(20)

/* Time for the peer to reach the next test, including its own ACL release. */
#define SYNC_TIMEOUT K_SECONDS(60)

/* Time the acceptor waits for the initiator to release the ACL link after a test. */
#define RELEASE_TIMEOUT K_SECONDS(30)

#define DISCONNECT_TIMEOUT K_SECONDS(10)

#define DISCOVERY_RESULT_COUNT 10

NET_BUF_POOL_FIXED_DEFINE(sync_pool, 2, BT_L2CAP_BUF_SIZE(4 + TEST_BR_SYNC_LEN),
			  CONFIG_BT_CONN_TX_USER_DATA_SIZE, NULL);

struct sync_msg {
	uint8_t ident;
	uint8_t len;
	char name[TEST_BR_SYNC_LEN];
};

K_MSGQ_DEFINE(sync_req_msgq, sizeof(struct sync_msg), 4, 4);
K_MSGQ_DEFINE(sync_rsp_msgq, sizeof(struct sync_msg), 4, 4);

static bool active;
static enum test_br_role role;
static bt_security_t required_sec = BT_SECURITY_L1;
static const char *current_test;

static struct bt_conn *default_conn;
static atomic_t conn_err;
static atomic_t sec_err;
static atomic_t connection_generation;
static atomic_t disconnected_generation;
static atomic_val_t test_generation;
static atomic_t accepting;

/* A sync request of a later test, kept until this side reaches that test. */
static struct sync_msg pending_req;
static bool pending_valid;

static struct bt_br_discovery_param discovery_param;
static struct bt_br_discovery_result discovery_result[DISCOVERY_RESULT_COUNT];
static K_SEM_DEFINE(peer_found_sem, 0, 1);

static enum bt_br_conn_req_rsp connection_requested(const bt_addr_t *addr, uint32_t cod)
{
	ARG_UNUSED(cod);

	if (role != TEST_BR_ACCEPTOR || !bt_addr_eq(addr, &peer_addr)) {
		return BT_BR_CONN_REQ_REJECT_ADDR;
	}
	if (!atomic_cas(&accepting, 1, 0)) {
		return BT_BR_CONN_REQ_REJECT_NO_RESOURCES;
	}
	return BT_BR_CONN_REQ_ACCEPT_PERIPHERAL;
}

static void acl_connected(struct bt_conn *conn, uint8_t err)
{
	struct bt_conn_info info;

	if ((bt_conn_get_info(conn, &info) != 0) || (info.type != BT_CONN_TYPE_BR)) {
		return;
	}

	LOG_DBG("ACL connected: conn %p err 0x%02x", (void *)conn, err);

	if (err != 0) {
		atomic_set(&conn_err, err);
		return;
	}

	if (default_conn == NULL) {
		atomic_inc(&connection_generation);
		default_conn = bt_conn_ref(conn);
	}
}

static void acl_disconnected(struct bt_conn *conn, uint8_t reason)
{
	LOG_DBG("ACL disconnected: conn %p reason 0x%02x", (void *)conn, reason);

	if (conn == default_conn) {
		atomic_set(&disconnected_generation, atomic_get(&connection_generation));
		bt_conn_unref(default_conn);
		default_conn = NULL;
	}
}

static void security_changed(struct bt_conn *conn, bt_security_t level, enum bt_security_err err)
{
	LOG_DBG("Security changed: conn %p level %u err %d", (void *)conn, level, err);

	if ((conn == default_conn) && (err != BT_SECURITY_ERR_SUCCESS)) {
		atomic_set(&sec_err, err);
	}
}

BT_CONN_CB_DEFINE(test_br_conn_cb) = {
	.connected = acl_connected,
	.disconnected = acl_disconnected,
	.security_changed = security_changed,
};

static void sync_msg_from_buf(struct sync_msg *msg, uint8_t ident, struct net_buf *buf)
{
	msg->ident = ident;
	msg->len = MIN(buf->len, TEST_BR_SYNC_LEN);
	memcpy(msg->name, buf->data, msg->len);
}

static void echo_req(struct bt_conn *conn, uint8_t identifier, struct net_buf *buf)
{
	struct sync_msg msg;

	sync_msg_from_buf(&msg, identifier, buf);
	if (k_msgq_put(&sync_req_msgq, &msg, K_NO_WAIT) != 0) {
		LOG_WRN("Sync request queue full");
	}
}

static void echo_rsp(struct bt_conn *conn, struct net_buf *buf)
{
	struct sync_msg msg;

	sync_msg_from_buf(&msg, 0, buf);
	if (k_msgq_put(&sync_rsp_msgq, &msg, K_NO_WAIT) != 0) {
		LOG_WRN("Sync response queue full");
	}
}

static struct bt_l2cap_br_echo_cb echo_cb = {
	.req = echo_req,
	.rsp = echo_rsp,
};

static void discovery_recv(const struct bt_br_discovery_result *result)
{
	if (bt_addr_eq(&peer_addr, &result->addr)) {
		k_sem_give(&peer_found_sem);
	}
}

static struct bt_br_discovery_cb discovery_cb = {
	.recv = discovery_recv,
};

static void sync_token(const char *name, struct sync_msg *msg)
{
	msg->len = MIN(strlen(name), TEST_BR_SYNC_LEN);
	memcpy(msg->name, name, msg->len);
}

static int sync_cmp(const struct sync_msg *a, const struct sync_msg *b)
{
	int cmp = memcmp(a->name, b->name, MIN(a->len, b->len));

	if (cmp != 0) {
		return cmp;
	}

	return (int)a->len - (int)b->len;
}

static struct net_buf *sync_buf(const struct sync_msg *msg)
{
	struct net_buf *buf;

	buf = net_buf_alloc(&sync_pool, K_SECONDS(1));
	if (buf != NULL) {
		net_buf_reserve(buf, BT_L2CAP_BR_ECHO_REQ_RESERVE);
		net_buf_add_mem(buf, msg->name, msg->len);
	}

	return buf;
}

static void sync_send_req(const struct sync_msg *own)
{
	struct net_buf *buf;
	int err;

	/* The signaling channel serves one request at a time; the Information Request sent after
	 * the ACL connection is established makes the stack log "Waiting for ECHO RSP" and return
	 * -EBUSY until it is answered.
	 */
	for (int i = 0; i < 50; i++) {
		buf = sync_buf(own);
		zassert_not_null(buf, "No sync buffer");

		err = bt_l2cap_br_echo_req(default_conn, buf);
		if (err == 0) {
			break;
		}

		net_buf_unref(buf);
		if (err != -EBUSY) {
			break;
		}
		k_sleep(K_MSEC(200));
	}
	zassert_equal(err, 0, "Failed to send sync request (err %d)", err);
}

static void sync_initiator(const char *name)
{
	struct sync_msg own;
	struct sync_msg rsp;
	int err;

	sync_token(name, &own);
	k_msgq_purge(&sync_rsp_msgq);
	sync_send_req(&own);

	err = -EAGAIN;
	for (k_timepoint_t end = sys_timepoint_calc(SYNC_TIMEOUT); !sys_timepoint_expired(end);) {
		err = k_msgq_get(&sync_rsp_msgq, &rsp, POLL_INTERVAL);
		if ((err == 0) || (default_conn == NULL)) {
			break;
		}
	}
	zassert_equal(err, 0, "No sync response from peer for %s", name);
	zassert_equal(sync_cmp(&rsp, &own), 0, "Peer is at test %.*s, this side at %s", rsp.len,
		      rsp.name, name);
}

static void sync_send_rsp(const struct sync_msg *req, const struct sync_msg *own)
{
	struct net_buf *buf;
	int err;

	if (default_conn == NULL) {
		return;
	}

	buf = sync_buf(own);
	if (buf == NULL) {
		LOG_ERR("No sync buffer");
		return;
	}

	err = bt_l2cap_br_echo_rsp(default_conn, req->ident, buf);
	if (err != 0) {
		LOG_ERR("Failed to send sync response (err %d)", err);
		net_buf_unref(buf);
	}
}

static void sync_acceptor(const char *name)
{
	k_timepoint_t end = sys_timepoint_calc(SYNC_TIMEOUT);
	struct sync_msg own;
	struct sync_msg req;
	int cmp;
	int err;

	sync_token(name, &own);

	while (true) {
		if (pending_valid) {
			req = pending_req;
			pending_valid = false;
		} else {
			err = k_msgq_get(&sync_req_msgq, &req, sys_timepoint_timeout(end));
			zassert_equal(err, 0, "No sync request from peer for %s", name);
		}

		cmp = sync_cmp(&req, &own);
		if (cmp == 0) {
			sync_send_rsp(&req, &own);
			return;
		}

		if (cmp < 0) {
			/* The peer is behind; it fails its test and connects again. */
			LOG_WRN("Peer is at earlier test %.*s, this side at %s", req.len, req.name,
				name);
			sync_send_rsp(&req, &own);
			continue;
		}

		/* The peer is ahead; answer it once this side reaches the same test. */
		pending_req = req;
		pending_valid = true;
		zassert_unreachable("Peer is at test %.*s, this side at %s", req.len, req.name,
				    name);
	}
}

static bool wait_for(bool (*cond)(void), k_timeout_t timeout)
{
	k_timepoint_t end = sys_timepoint_calc(timeout);

	while (!cond()) {
		if (sys_timepoint_expired(end)) {
			return false;
		}
		k_sleep(POLL_INTERVAL);
	}

	return true;
}

static bool is_connected(void)
{
	return default_conn != NULL;
}

static bool is_disconnected(void)
{
	return atomic_get(&disconnected_generation) >= test_generation;
}

static bool is_released(void)
{
	struct bt_conn *conn = bt_conn_lookup_addr_br(&peer_addr);

	if (conn != NULL) {
		bt_conn_unref(conn);
		return false;
	}

	return true;
}

static bt_security_t wait_sec_level;

static bool is_secure(void)
{
	return (default_conn == NULL) || (atomic_get(&sec_err) != 0) ||
	       (bt_conn_get_security(default_conn) >= wait_sec_level);
}

enum test_br_role test_br_role(void)
{
	return role;
}

struct bt_conn *test_br_conn(void)
{
	return default_conn;
}

bool test_br_connected(void)
{
	return default_conn != NULL;
}

void test_br_sync(void)
{
	zassert_not_null(current_test, "No test running");
	zassert_not_null(default_conn, "ACL not connected");

	if (role == TEST_BR_INITIATOR) {
		sync_initiator(current_test);
	} else {
		sync_acceptor(current_test);
	}
}

int test_br_wait(struct k_sem *sem, k_timeout_t timeout)
{
	k_timepoint_t end = sys_timepoint_calc(timeout);

	while (k_sem_take(sem, POLL_INTERVAL) != 0) {
		if (default_conn == NULL) {
			return (k_sem_take(sem, K_NO_WAIT) == 0) ? 0 : -ENOTCONN;
		}

		if (sys_timepoint_expired(end)) {
			return -EAGAIN;
		}
	}

	return 0;
}

void test_br_connect(void)
{
	struct bt_conn *conn;
	k_timepoint_t end = sys_timepoint_calc(K_SECONDS(CONFIG_BT_CREATE_CONN_TIMEOUT));

	zassert_is_null(default_conn, "ACL already connected");

	do {
		zassert_true(wait_for(is_released, sys_timepoint_timeout(end)),
			     "Previous ACL connection object not released");
		atomic_set(&conn_err, 0);
		conn = bt_conn_create_br(&peer_addr, BT_BR_CONN_PARAM_DEFAULT);
		zassert_not_null(conn, "Failed to create ACL connection");
		bt_conn_unref(conn);
		while (!is_connected() && atomic_get(&conn_err) == 0 &&
		       !sys_timepoint_expired(end)) {
			k_sleep(POLL_INTERVAL);
		}
		if (is_connected()) {
			test_generation = atomic_get(&connection_generation);
			return;
		}
		zassert_equal(atomic_get(&conn_err), BT_HCI_ERR_INSUFFICIENT_RESOURCES,
			      "ACL connection failed");
		k_sleep(POLL_INTERVAL);
	} while (!sys_timepoint_expired(end));
	zassert_unreachable("Peer did not finish ACL cleanup before connection timeout");
}

void test_br_wait_connected(k_timeout_t timeout)
{
	bool ok;

	if (role == TEST_BR_ACCEPTOR && default_conn == NULL) {
		atomic_set(&accepting, 1);
	}
	ok = wait_for(is_connected, timeout);

	zassert_true(ok, "ACL connection timeout (err 0x%02lx)", atomic_get(&conn_err));
	test_generation = atomic_get(&connection_generation);
}

void test_br_disconnect(void)
{
	int err;

	zassert_not_null(default_conn, "ACL not connected");

	err = bt_conn_disconnect(default_conn, BT_HCI_ERR_REMOTE_USER_TERM_CONN);
	zassert_equal(err, 0, "Failed to disconnect ACL (err %d)", err);

	test_br_wait_disconnected(DISCONNECT_TIMEOUT);
}

void test_br_wait_disconnected(k_timeout_t timeout)
{
	bool ok = wait_for(is_disconnected, timeout);

	zassert_true(ok, "ACL disconnection timeout");
}

void test_br_acceptor_disconnect(void)
{
	if (role == TEST_BR_INITIATOR) {
		sync_acceptor(current_test);
		test_br_wait_disconnected(DISCONNECT_TIMEOUT);
	} else {
		sync_initiator(current_test);
		test_br_disconnect();
	}
}

void test_br_security(bt_security_t sec_level)
{
	int err;
	bool ok;

	zassert_not_null(default_conn, "ACL not connected");

	atomic_set(&sec_err, 0);
	if (role == TEST_BR_INITIATOR) {
		err = bt_conn_set_security(default_conn, sec_level);
		zassert_equal(err, 0, "Failed to set security (err %d)", err);
	}

	wait_sec_level = sec_level;
	ok = wait_for(is_secure, K_SECONDS(30));
	zassert_true(ok, "Security timeout");
	zassert_not_null(default_conn, "ACL lost during pairing");
	zassert_equal(atomic_get(&sec_err), 0, "Security failed (err %ld)", atomic_get(&sec_err));
}

void test_br_set_security(bt_security_t sec_level)
{
	required_sec = sec_level;
}

void test_br_setup(enum test_br_role test_role, bt_security_t sec_level)
{
	int err;

	role = test_role;
	required_sec = sec_level;
	pending_valid = false;

	err = bt_enable(NULL);
	zassert_equal(err, 0, "bt_enable failed (err %d)", err);

	err = bt_l2cap_br_echo_cb_register(&echo_cb);
	zassert_true((err == 0) || (err == -EEXIST), "Failed to register echo cb (err %d)", err);

	atomic_set(&accepting, 0);
	err = bt_br_set_connectable(true, connection_requested);
	zassert_equal(err, 0, "Failed to set connectable (err %d)", err);

	err = bt_br_set_discoverable(true, false);
	zassert_equal(err, 0, "Failed to set discoverable (err %d)", err);

	if (role == TEST_BR_INITIATOR) {
		/* The peer is discoverable once its host is up and able to accept connections. */
		bt_br_discovery_cb_register(&discovery_cb);

		discovery_param.length = DISCOVERY_RESULT_COUNT;
		discovery_param.limited = false;
		err = bt_br_discovery_start(&discovery_param, discovery_result,
					    ARRAY_SIZE(discovery_result));
		zassert_equal(err, 0, "Failed to start inquiry (err %d)", err);

		err = k_sem_take(&peer_found_sem, K_MSEC(DISCOVERY_RESULT_COUNT * 1280));
		zassert_equal(err, 0, "Peer not found by inquiry");

		err = bt_br_discovery_stop();
		if ((err != 0) && (err != -EALREADY)) {
			LOG_WRN("Failed to stop inquiry (err %d)", err);
		}

		bt_br_discovery_cb_unregister(&discovery_cb);
	}

	active = true;
}

void test_br_teardown(void)
{
	int err;

	active = false;

	err = bt_disable();
	if (err != 0) {
		LOG_ERR("bt_disable failed (err %d)", err);
	}
}

static void before_each(const struct ztest_unit_test *test, void *data)
{
	ARG_UNUSED(data);

	if (!active) {
		return;
	}

	LOG_INF("=== %s", test->name);
	current_test = test->name;

	if (role == TEST_BR_INITIATOR) {
		if (default_conn == NULL) {
			test_br_connect();
		}
	} else {
		test_br_wait_connected(K_SECONDS(30));
	}
	test_generation = atomic_get(&connection_generation);

	if (required_sec > BT_SECURITY_L1) {
		test_br_security(required_sec);
	}
}

static void release(void)
{
	int err;

	if (default_conn != NULL) {
		err = bt_conn_disconnect(default_conn, BT_HCI_ERR_REMOTE_USER_TERM_CONN);
		if (err != 0) {
			LOG_ERR("Failed to disconnect ACL (err %d)", err);
		}

		if (!wait_for(is_disconnected, DISCONNECT_TIMEOUT)) {
			LOG_ERR("ACL disconnection timeout");
		}
	}
}

static void after_each(const struct ztest_unit_test *test, void *data)
{
	int err;

	ARG_UNUSED(data);

	if (!active) {
		return;
	}

	if ((role == TEST_BR_ACCEPTOR) && is_disconnected()) {
		current_test = NULL;
		return;
	}

	if (role == TEST_BR_INITIATOR) {
		release();

		/* The connection object is reused only after every reference is gone. */
		if (!wait_for(is_released, DISCONNECT_TIMEOUT)) {
			LOG_ERR("ACL connection object of %s not released", test->name);
		}
	} else if (!pending_valid) {
		/* The initiator releases the link; take over if it does not. */
		if (!wait_for(is_disconnected, RELEASE_TIMEOUT)) {
			LOG_WRN("Initiator did not release the ACL link");
			release();
		}
	}

	if ((required_sec > BT_SECURITY_L1) && !pending_valid) {
		err = bt_br_unpair(&peer_addr);
		if ((err != 0) && (err != -ENOENT)) {
			LOG_WRN("Failed to unpair (err %d)", err);
		}
	}

	current_test = NULL;
}

ZTEST_RULE(test_br_rule, before_each, after_each);
```

## src/test_br.h
```c
/*
 * SPDX-FileCopyrightText: Copyright 2026 NXP
 *
 * SPDX-License-Identifier: Apache-2.0
 */

#ifndef TEST_BR_H_
#define TEST_BR_H_

#include <stdbool.h>

#include <zephyr/kernel.h>
#include <zephyr/bluetooth/bluetooth.h>
#include <zephyr/bluetooth/conn.h>

/*
 * ACL lifecycle and test synchronization shared by the two simulated devices.
 *
 * Both devices run a suite with the same test names, ztest runs them in name order. Before each
 * test the initiator (device 0) creates the ACL connection and the acceptor waits for it. Each
 * test then calls test_br_sync() once this side is ready (e.g. servers registered): both sides
 * exchange the test name in an L2CAP ECHO request/response, the initiator only returns when the
 * acceptor is in the same test. After each test the ACL connection is released, so every test
 * starts from a fresh ACL link.
 *
 * Test names must start with a unique, zero-padded index (test_NNN_...), the first
 * TEST_BR_SYNC_LEN characters are exchanged and compared in name order.
 */

enum test_br_role {
	TEST_BR_INITIATOR,
	TEST_BR_ACCEPTOR,
};

#define TEST_BR_SYNC_LEN 40

/* Default wait for a protocol step of the peer. */
#define TEST_BR_STEP_TIMEOUT K_SECONDS(10)

extern bt_addr_t peer_addr;

/* Enable Bluetooth and set the role of this device; the initiator waits until the peer is found. */
void test_br_setup(enum test_br_role role, bt_security_t sec_level);
void test_br_teardown(void);

/* Security level the ACL link is raised to before each test (BT_SECURITY_L1 for none). */
void test_br_set_security(bt_security_t sec_level);

enum test_br_role test_br_role(void);
struct bt_conn *test_br_conn(void);
bool test_br_connected(void);

/* Wait until the peer reached the same test; call once per test when this side is ready. */
void test_br_sync(void);

/* Take @p sem; return -ENOTCONN as soon as the ACL link is lost, -EAGAIN on timeout. */
int test_br_wait(struct k_sem *sem, k_timeout_t timeout);

/* ACL operations inside a test body; failures are reported with zassert. */
void test_br_connect(void);
void test_br_disconnect(void);
void test_br_acceptor_disconnect(void);
void test_br_wait_connected(k_timeout_t timeout);
void test_br_wait_disconnected(k_timeout_t timeout);
void test_br_security(bt_security_t sec_level);

#endif /* TEST_BR_H_ */
```

## src/test_common.h
```c
/*
 * SPDX-FileCopyrightText: Copyright 2026 NXP
 * SPDX-License-Identifier: Apache-2.0
 */

#ifndef TEST_GOEP_COMMON_H_
#define TEST_GOEP_COMMON_H_

#include <zephyr/bluetooth/classic/goep.h>

enum test_goep_operation {
	TEST_GOEP_CONNECT,
	TEST_GOEP_PUT,
	TEST_GOEP_GET,
	TEST_GOEP_ACTION,
	TEST_GOEP_ABORT,
	TEST_GOEP_SETPATH,
};

extern struct bt_obex_client test_client;
extern struct bt_obex_server test_server;
extern void (*test_goep_get_hook)(void);

void *test_goep_client_setup(void);
void *test_goep_server_setup(void);
void test_goep_teardown(void *fixture);
void test_goep_open(void);
void test_goep_reopen(void);
void test_goep_close(bool server_initiated);
void test_goep_expect_transport_closed(void);
bool test_goep_is_client(void);
struct net_buf *test_goep_pdu(void);
void test_goep_send(int err, struct net_buf *buf);
int test_goep_try_send_raw(struct net_buf *buf);
void test_goep_send_raw(struct net_buf *buf);
struct net_buf *test_goep_expect(enum test_goep_operation operation, uint8_t status);

#if defined(CONFIG_TEST_GOEP_L2CAP)
struct net_buf *__real_l2cap_br_data_pull(struct bt_conn *conn, size_t amount, size_t *length);
void __real_bt_l2cap_br_recv(struct bt_conn *conn, struct net_buf *buf);
int __real_bt_l2cap_chan_connect(struct bt_conn *conn, struct bt_l2cap_chan *chan, uint16_t psm);
int __real_bt_l2cap_chan_disconnect(struct bt_l2cap_chan *chan);
#endif

#endif
```

## src/test_main.c
```c
/*
 * SPDX-FileCopyrightText: Copyright 2026 NXP
 * SPDX-License-Identifier: Apache-2.0
 */

#include <zephyr/bluetooth/bluetooth.h>
#include <zephyr/ztest.h>

#include "cmdline.h"
#include "nsi_main.h"
#include "soc.h"

bt_addr_t peer_addr;

static void peer_address_found(char *argv, int offset)
{
	int err = bt_addr_from_str(&argv[offset], &peer_addr);

	if (err != 0) {
		nsi_exit(err);
	}
}

static void test_goep_args(void)
{
	static struct args_struct_t args[] = {
		{
			.is_mandatory = true,
			.option = "peer_bd_address",
			.name = "XX:XX:XX:XX:XX:XX",
			.type = 's',
			.call_when_found = peer_address_found,
			.descript = "Bluetooth peer address for GOEP test",
		},
		ARG_TABLE_ENDMARKER
	};

	native_add_command_line_opts(args);
}

NATIVE_TASK(test_goep_args, PRE_BOOT_1, 20);
```

## src/test_misc.c
```c
/*
 * SPDX-FileCopyrightText: Copyright 2026 NXP
 * SPDX-License-Identifier: Apache-2.0
 */

#include <errno.h>

#include <zephyr/ztest.h>

#include "test_common.h"

static const uint8_t source_name[] = {
	0, 's', 0, 'o', 0, 'u', 0, 'r', 0, 'c', 0, 'e', 0, 0,
};
static const uint8_t destination_name[] = {0, 'd', 0, 'e', 0, 's', 0, 't', 0, 0};
static const uint8_t child_name[] = {0, 'c', 0, 'h', 0, 'i', 0, 'l', 0, 'd', 0, 0};

enum action_mode {
	ACTION_NAMES,
	ACTION_SRM,
	ACTION_SRMP,
};

static void action_headers(struct net_buf *buf, enum action_mode mode)
{
	if (mode >= ACTION_SRM) {
		zassert_ok(bt_obex_add_header_srm(buf, 1));
	}
	if (mode == ACTION_SRMP) {
		zassert_ok(bt_obex_add_header_srm_param(buf, 1));
	}
}

static void check_action_headers(struct net_buf *buf, enum action_mode mode)
{
	uint8_t value;

	if (mode >= ACTION_SRM) {
		zassert_ok(bt_obex_get_header_srm(buf, &value));
		zassert_equal(value, 1);
	}
	if (mode == ACTION_SRMP) {
		zassert_ok(bt_obex_get_header_srm_param(buf, &value));
		zassert_equal(value, 1);
	}
}

static void action(uint8_t requested_action, uint8_t response, enum action_mode mode)
{
	struct net_buf *buf;
	const uint8_t *name;
	uint16_t length;
	uint8_t action_id;

	for (int repetition = 0; repetition < 2; repetition++) {
		test_goep_open();
		if (test_goep_is_client()) {
			buf = test_goep_pdu();
			zassert_ok(bt_obex_add_header_action_id(buf, requested_action));
			action_headers(buf, mode);
			if (mode == ACTION_NAMES) {
				zassert_ok(bt_obex_add_header_name(buf, sizeof(source_name),
								   source_name));
				zassert_ok(bt_obex_add_header_dest_name(
					buf, sizeof(destination_name), destination_name));
			}
			test_goep_send(bt_obex_action(&test_client, true, buf), buf);
			buf = test_goep_expect(TEST_GOEP_ACTION, response);
			check_action_headers(buf, mode);
			if (mode == ACTION_NAMES) {
				zassert_equal(buf->len, 0);
			}
		} else {
			buf = test_goep_expect(TEST_GOEP_ACTION, true);
			zassert_ok(bt_obex_get_header_action_id(buf, &action_id));
			zassert_equal(action_id, requested_action);
			check_action_headers(buf, mode);
			if (mode == ACTION_NAMES) {
				zassert_ok(bt_obex_get_header_name(buf, &length, &name));
				zassert_equal(length, sizeof(source_name));
				zassert_mem_equal(name, source_name, length);
				zassert_ok(bt_obex_get_header_dest_name(buf, &length, &name));
				zassert_equal(length, sizeof(destination_name));
				zassert_mem_equal(name, destination_name, length);
			}
			buf = test_goep_pdu();
			action_headers(buf, mode);
			test_goep_send(bt_obex_action_rsp(&test_server, response, buf), buf);
		}
		test_goep_close(repetition != 0);
	}
}

static void abort_request(bool active)
{
	static const uint8_t message[] = "test_message_continue";
	struct net_buf *buf;
	const uint8_t *body;
	uint16_t length;

	for (int repetition = 0; repetition < 2; repetition++) {
		test_goep_open();
		if (!active) {
			if (test_goep_is_client()) {
				zassert_equal(bt_obex_abort(&test_client, NULL), -EINVAL);
			}
		} else if (test_goep_is_client()) {
			buf = test_goep_pdu();
			zassert_ok(bt_obex_add_header_end_body(buf, sizeof(message), message));
			test_goep_send(bt_obex_put(&test_client, false, buf), buf);
			buf = test_goep_expect(TEST_GOEP_PUT, BT_OBEX_RSP_CODE_CONTINUE);
			zassert_equal(buf->len, 0);
			buf = test_goep_pdu();
			test_goep_send(bt_obex_abort(&test_client, buf), buf);
			buf = test_goep_expect(TEST_GOEP_ABORT, BT_OBEX_RSP_CODE_SUCCESS);
			zassert_equal(buf->len, 0);
		} else {
			buf = test_goep_expect(TEST_GOEP_PUT, false);
			zassert_ok(bt_obex_get_header_end_body(buf, &length, &body));
			zassert_equal(length, sizeof(message));
			zassert_mem_equal(body, message, length);
			buf = test_goep_pdu();
			test_goep_send(
				bt_obex_put_rsp(&test_server, BT_OBEX_RSP_CODE_CONTINUE, buf), buf);
			buf = test_goep_expect(TEST_GOEP_ABORT, 0);
			zassert_equal(buf->len, 0);
			buf = test_goep_pdu();
			test_goep_send(
				bt_obex_abort_rsp(&test_server, BT_OBEX_RSP_CODE_SUCCESS, buf),
				buf);
		}
		test_goep_close(repetition != 0);
	}
}

static void setpath(bool parent, bool child, uint8_t response)
{
	uint8_t flags = BT_OBEX_SETPATH_FLAG_NO_CREATE;
	struct net_buf *buf;
	const uint8_t *name;
	uint16_t length;

	if (parent) {
		flags |= BT_OBEX_SETPATH_FLAG_BACKUP;
	}
	for (int repetition = 0; repetition < 2; repetition++) {
		test_goep_open();
		if (test_goep_is_client()) {
			buf = test_goep_pdu();
			if (child) {
				zassert_ok(bt_obex_add_header_name(buf, sizeof(child_name),
								   child_name));
			}
			test_goep_send(bt_obex_setpath(&test_client, flags, buf), buf);
			buf = test_goep_expect(TEST_GOEP_SETPATH, response);
			zassert_equal(buf->len, 0);
		} else {
			buf = test_goep_expect(TEST_GOEP_SETPATH, flags);
			if (child) {
				zassert_ok(bt_obex_get_header_name(buf, &length, &name));
				zassert_equal(length, sizeof(child_name));
				zassert_mem_equal(name, child_name, length);
			} else {
				zassert_equal(buf->len, 0);
			}
			buf = test_goep_pdu();
			test_goep_send(bt_obex_setpath_rsp(&test_server, response, buf), buf);
		}
		test_goep_close(repetition != 0);
	}
}

ZTEST(goep_client_misc, test_001_action_copy)
{
	action(BT_OBEX_ACTION_COPY, BT_OBEX_RSP_CODE_SUCCESS, ACTION_NAMES);
}

ZTEST(goep_server_misc, test_001_action_copy)
{
	action(BT_OBEX_ACTION_COPY, BT_OBEX_RSP_CODE_SUCCESS, ACTION_NAMES);
}

ZTEST(goep_client_misc, test_002_action_move)
{
	action(BT_OBEX_ACTION_MOVE_RENAME, BT_OBEX_RSP_CODE_SUCCESS, ACTION_NAMES);
}

ZTEST(goep_server_misc, test_002_action_move)
{
	action(BT_OBEX_ACTION_MOVE_RENAME, BT_OBEX_RSP_CODE_SUCCESS, ACTION_NAMES);
}

ZTEST(goep_client_misc, test_003_action_permission_source_variant)
{
	action(BT_OBEX_ACTION_SET_PERM, BT_OBEX_RSP_CODE_SUCCESS, ACTION_NAMES);
}

ZTEST(goep_server_misc, test_003_action_permission_source_variant)
{
	action(BT_OBEX_ACTION_SET_PERM, BT_OBEX_RSP_CODE_SUCCESS, ACTION_NAMES);
}

ZTEST(goep_client_misc, test_004_action_move_not_found)
{
	action(BT_OBEX_ACTION_MOVE_RENAME, BT_OBEX_RSP_CODE_NOT_FOUND, ACTION_NAMES);
}

ZTEST(goep_server_misc, test_004_action_move_not_found)
{
	action(BT_OBEX_ACTION_MOVE_RENAME, BT_OBEX_RSP_CODE_NOT_FOUND, ACTION_NAMES);
}

ZTEST(goep_client_misc, test_005_action_permission_not_found)
{
	action(BT_OBEX_ACTION_SET_PERM, BT_OBEX_RSP_CODE_NOT_FOUND, ACTION_NAMES);
}

ZTEST(goep_server_misc, test_005_action_permission_not_found)
{
	action(BT_OBEX_ACTION_SET_PERM, BT_OBEX_RSP_CODE_NOT_FOUND, ACTION_NAMES);
}

ZTEST(goep_client_misc, test_006_action_move_srm)
{
	action(BT_OBEX_ACTION_MOVE_RENAME, BT_OBEX_RSP_CODE_SUCCESS, ACTION_SRM);
}

ZTEST(goep_server_misc, test_006_action_move_srm)
{
	action(BT_OBEX_ACTION_MOVE_RENAME, BT_OBEX_RSP_CODE_SUCCESS, ACTION_SRM);
}

ZTEST(goep_client_misc, test_007_action_permission_srm)
{
	action(BT_OBEX_ACTION_SET_PERM, BT_OBEX_RSP_CODE_SUCCESS, ACTION_SRM);
}

ZTEST(goep_server_misc, test_007_action_permission_srm)
{
	action(BT_OBEX_ACTION_SET_PERM, BT_OBEX_RSP_CODE_SUCCESS, ACTION_SRM);
}

ZTEST(goep_client_misc, test_008_action_srmp)
{
	action(BT_OBEX_ACTION_SET_PERM, BT_OBEX_RSP_CODE_SUCCESS, ACTION_SRMP);
}

ZTEST(goep_server_misc, test_008_action_srmp)
{
	action(BT_OBEX_ACTION_SET_PERM, BT_OBEX_RSP_CODE_SUCCESS, ACTION_SRMP);
}

ZTEST(goep_client_misc, test_009_abort_active)
{
	abort_request(true);
}

ZTEST(goep_server_misc, test_009_abort_active)
{
	abort_request(true);
}

ZTEST(goep_client_misc, test_010_abort_idle)
{
	abort_request(false);
}

ZTEST(goep_server_misc, test_010_abort_idle)
{
	abort_request(false);
}

ZTEST(goep_client_misc, test_011_setpath_root)
{
	setpath(false, false, BT_OBEX_RSP_CODE_SUCCESS);
}

ZTEST(goep_server_misc, test_011_setpath_root)
{
	setpath(false, false, BT_OBEX_RSP_CODE_SUCCESS);
}

ZTEST(goep_client_misc, test_012_setpath_down)
{
	setpath(false, true, BT_OBEX_RSP_CODE_SUCCESS);
}

ZTEST(goep_server_misc, test_012_setpath_down)
{
	setpath(false, true, BT_OBEX_RSP_CODE_SUCCESS);
}

ZTEST(goep_client_misc, test_013_setpath_up)
{
	setpath(true, false, BT_OBEX_RSP_CODE_SUCCESS);
}

ZTEST(goep_server_misc, test_013_setpath_up)
{
	setpath(true, false, BT_OBEX_RSP_CODE_SUCCESS);
}

ZTEST(goep_client_misc, test_014_setpath_no_create)
{
	setpath(false, true, BT_OBEX_RSP_CODE_NOT_FOUND);
}

ZTEST(goep_server_misc, test_014_setpath_no_create)
{
	setpath(false, true, BT_OBEX_RSP_CODE_NOT_FOUND);
}

ZTEST(goep_client_misc, test_015_setpath_forbidden)
{
	setpath(false, true, BT_OBEX_RSP_CODE_FORBIDDEN);
}

ZTEST(goep_server_misc, test_015_setpath_forbidden)
{
	setpath(false, true, BT_OBEX_RSP_CODE_FORBIDDEN);
}

ZTEST_SUITE(goep_client_misc, NULL, test_goep_client_setup, NULL, NULL, test_goep_teardown);
ZTEST_SUITE(goep_server_misc, NULL, test_goep_server_setup, NULL, NULL, test_goep_teardown);
```

## src/test_put_get.c
```c
/*
 * SPDX-FileCopyrightText: Copyright 2026 NXP
 * SPDX-License-Identifier: Apache-2.0
 */

#include <string.h>

#include <zephyr/ztest.h>

#include "test_common.h"

enum transfer_mode {
	TRANSFER_FINAL,
	TRANSFER_CONTINUE,
	TRANSFER_ERROR,
	TRANSFER_SRM,
	TRANSFER_SRMP,
};

static void add_srm(struct net_buf *buf, enum transfer_mode mode)
{
	if (mode >= TRANSFER_SRM) {
		zassert_ok(bt_obex_add_header_srm(buf, 1));
	}
	if (mode == TRANSFER_SRMP) {
		zassert_ok(bt_obex_add_header_srm_param(buf, 1));
	}
}

static void check_srm(struct net_buf *buf, enum transfer_mode mode)
{
	uint8_t value;

	if (mode >= TRANSFER_SRM) {
		zassert_ok(bt_obex_get_header_srm(buf, &value));
		zassert_equal(value, 1);
	}
	if (mode == TRANSFER_SRMP) {
		zassert_ok(bt_obex_get_header_srm_param(buf, &value));
		zassert_equal(value, 1);
	}
}

static void add_body(struct net_buf *buf, const char *message, bool end_body)
{
	uint16_t len = strlen(message) + 1;

	if (end_body) {
		zassert_ok(bt_obex_add_header_end_body(buf, len, (const uint8_t *)message));
	} else {
		zassert_ok(bt_obex_add_header_body(buf, len, (const uint8_t *)message));
	}
}

static void check_body(struct net_buf *buf, const char *message, bool end_body)
{
	const uint8_t *body;
	uint16_t len;

	if (end_body) {
		zassert_ok(bt_obex_get_header_end_body(buf, &len, &body));
	} else {
		zassert_ok(bt_obex_get_header_body(buf, &len, &body));
	}
	zassert_equal(len, strlen(message) + 1);
	zassert_mem_equal(body, message, len);
}

static void transfer(bool put, enum transfer_mode mode)
{
	enum test_goep_operation operation = put ? TEST_GOEP_PUT : TEST_GOEP_GET;
	unsigned int steps = mode == TRANSFER_CONTINUE ? 2 : 1;

	for (unsigned int repetition = 0; repetition < 2; repetition++) {
		test_goep_open();
		for (unsigned int step = 0; step < steps; step++) {
			bool last = step == steps - 1;
			bool final = !put || last;
			uint8_t response =
				last ? BT_OBEX_RSP_CODE_SUCCESS : BT_OBEX_RSP_CODE_CONTINUE;
			const char *message;
			struct net_buf *buf;

			if (mode == TRANSFER_CONTINUE) {
				message = !last ? "test_message_continue"
						: (put ? "test_message_final"
						       : "test_message_success");
			} else {
				message = put ? "test_message" : "test_get_message";
			}
			if (mode == TRANSFER_ERROR) {
				response = put ? BT_OBEX_RSP_CODE_FORBIDDEN
					       : BT_OBEX_RSP_CODE_NOT_FOUND;
			}
			if (test_goep_is_client()) {
				buf = test_goep_pdu();
				add_srm(buf, mode);
				if (put) {
					add_body(buf, message, true);
					test_goep_send(bt_obex_put(&test_client, final, buf), buf);
				} else {
					test_goep_send(bt_obex_get(&test_client, final, buf), buf);
				}
				buf = test_goep_expect(operation, response);
				check_srm(buf, mode);
				if (!put && mode < TRANSFER_ERROR) {
					check_body(buf, message, last);
				}
			} else {
				buf = test_goep_expect(operation, final);
				check_srm(buf, mode);
				if (put) {
					check_body(buf, message, true);
				}
				buf = test_goep_pdu();
				add_srm(buf, mode);
				if (put) {
					test_goep_send(bt_obex_put_rsp(&test_server, response, buf),
						       buf);
				} else {
					if (mode < TRANSFER_ERROR) {
						add_body(buf, message, last);
					}
					test_goep_send(bt_obex_get_rsp(&test_server, response, buf),
						       buf);
				}
			}
		}
		test_goep_close(repetition != 0);
	}
}

ZTEST(goep_client_put_get, test_001_put_success_final)
{
	transfer(true, TRANSFER_FINAL);
}

ZTEST(goep_server_put_get, test_001_put_success_final)
{
	transfer(true, TRANSFER_FINAL);
}

ZTEST(goep_client_put_get, test_002_put_continue_non_final)
{
	transfer(true, TRANSFER_CONTINUE);
}

ZTEST(goep_server_put_get, test_002_put_continue_non_final)
{
	transfer(true, TRANSFER_CONTINUE);
}

ZTEST(goep_client_put_get, test_003_put_error)
{
	transfer(true, TRANSFER_ERROR);
}

ZTEST(goep_server_put_get, test_003_put_error)
{
	transfer(true, TRANSFER_ERROR);
}

ZTEST(goep_client_put_get, test_004_put_srm_enable)
{
	transfer(true, TRANSFER_SRM);
}

ZTEST(goep_server_put_get, test_004_put_srm_enable)
{
	transfer(true, TRANSFER_SRM);
}

ZTEST(goep_client_put_get, test_005_put_srm_param)
{
	transfer(true, TRANSFER_SRMP);
}

ZTEST(goep_server_put_get, test_005_put_srm_param)
{
	transfer(true, TRANSFER_SRMP);
}

ZTEST(goep_client_put_get, test_006_get_success_final)
{
	transfer(false, TRANSFER_FINAL);
}

ZTEST(goep_server_put_get, test_006_get_success_final)
{
	transfer(false, TRANSFER_FINAL);
}

ZTEST(goep_client_put_get, test_007_get_continue_non_final)
{
	transfer(false, TRANSFER_CONTINUE);
}

ZTEST(goep_server_put_get, test_007_get_continue_non_final)
{
	transfer(false, TRANSFER_CONTINUE);
}

ZTEST(goep_client_put_get, test_008_get_not_found)
{
	transfer(false, TRANSFER_ERROR);
}

ZTEST(goep_server_put_get, test_008_get_not_found)
{
	transfer(false, TRANSFER_ERROR);
}

ZTEST(goep_client_put_get, test_009_get_srm_enable)
{
	transfer(false, TRANSFER_SRM);
}

ZTEST(goep_server_put_get, test_009_get_srm_enable)
{
	transfer(false, TRANSFER_SRM);
}

ZTEST(goep_client_put_get, test_010_get_srm_param)
{
	transfer(false, TRANSFER_SRMP);
}

ZTEST(goep_server_put_get, test_010_get_srm_param)
{
	transfer(false, TRANSFER_SRMP);
}

ZTEST_SUITE(goep_client_put_get, NULL, test_goep_client_setup, NULL, NULL, test_goep_teardown);
ZTEST_SUITE(goep_server_put_get, NULL, test_goep_server_setup, NULL, NULL, test_goep_teardown);
```
